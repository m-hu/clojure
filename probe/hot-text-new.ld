/* Generated by scripts/bench/hot-text from 394 snippet profiles; see
   scripts/bench/hot-text/hot_text.py. Do not edit. */
SECTIONS
{
  .text.hot :
  {
    *(.text*._RNvNtNtCs*_3std6thread7current12init_current*)
    *(.text*._RNvNtNtCs*_4core5slice6memchr15memrchr_aligned*)
    *(.text*._RNvNtNtNtCs*_3std3sys6random5linux19hashmap_random_keys*)
    *(.text*._RNCINvMs*_NtNtCs*_3std4sync4onceNtB*_4Once15call_once_forceNCINvMNtB*_9once_lockINtB*_8OnceLockyE10initializeNCINvB*_11get_or_initNCNvB*_10try_insert0E0zE0E0B*_*)
    *(.text*._RNCINvMs*_NtNtCs*_3std4sync4onceNtB*_4Once15call_once_forceNCINvMNtB*_9once_lockINtB*_8OnceLockINtNtB*_14reentrant_lock13ReentrantLockINtNtCs*_4core4cell7RefCellINtNtNtNtCs*_5alloc2io8buffered10linewriter10LineWriterNtNtNtB*_2io5stdio9StdoutRawEEEE10initializeNCINvB*_11get_or_initNCNvB*_6stdout0E0zE0E0B*_*)
    *(.text*._RNvNvMs*_NtCs*_4core3fmtNtB*_9Formatter12pad_integral12write_prefix*)
    *(.text*._RNvNtCs*_4core3fmt5write*)
    *(.text*._RNvMs*_NtCs*_4core3fmtNtB*_9Formatter12pad_integral*)
    *(.text*._RINvMNtNtCs*_3std4sync9once_lockINtB*_8OnceLockyE10initializeNCINvB*_11get_or_initNCNvB*_10try_insert0E0zEB*_*)
    *(.text*._RINvMNtNtCs*_3std4sync9once_lockINtB*_8OnceLockINtNtB*_14reentrant_lock13ReentrantLockINtNtCs*_4core4cell7RefCellINtNtNtNtCs*_5alloc2io8buffered10linewriter10LineWriterNtNtNtB*_2io5stdio9StdoutRawEEEE10initializeNCINvB*_11get_or_initNCNvB*_6stdout0E0zEB*_*)
    *(.text*._RNvMs*_NtCs*_5alloc7raw_vecINtB*_11RawVecInnerNtNtCs*_3std5alloc6SystemE14grow_amortizedB*_*)
    *(.text*._RNvMs*_NtCs*_5alloc7raw_vecINtB*_11RawVecInnerNtNtCs*_3std5alloc6SystemE11finish_growB*_*)
    *(.text*._RNvMs*_NtNtNtCs*_5alloc2io8buffered9bufwriterINtB*_9BufWriterNtNtNtCs*_3std2io5stdio9StdoutRawE9flush_bufB*_*)
    *(.text*._RNvNtNtNtNtCs*_3std3sys12thread_local11destructors10linux_like8register*)
    *(.text*._RNvXs*_NtNtNtCs*_4core3fmt3num3impxNtB*_7Display3fmt*)
    *(.text*._dl_early_allocate)
    *(.text*._dl_init_paths)
    *(.text*.free)
    *(.text*._dl_find_object_from_map)
    *(.text*._RNvMs*_NtCs*_8clj_eval3envNtB*_14SharedRegistry10lookup_str*)
    *(.text*._RNvXs*_NtCs*_9clj_value5valueNtB*_5ValueNtNtCs*_4core5clone5Clone5clone*)
    *(.text*._RNvMs*_NtCs*_9clj_value9fast_varsNtB*_10BindCounts11alloc_chunk*)
    *(.text*._RINvNtCs*_4core3ptr9drop_glueINtCs*_8smallvec8SmallVecANtNtCs*_9clj_value5value5Valuej4_EECs*_8clj_eval*)
    *(.text*._RNvXNtCs*_4core3anyNtNtCs*_8clj_eval2io6WriterNtB*_3Any7type_idB*_*)
    *(.text*._RNvNtCs*_8clj_eval8printsys17write_meta_prefix*)
    *(.text*._RINvNvMs*_NtCs*_5alloc7raw_vecINtB*_11RawVecInnerpE7reserve21do_reserve_and_handleNtNtB*_5alloc6GlobalECs*_9clj_value*)
    *(.text*.__memset_avx2_unaligned)
    *(.text*.__pthread_tunables_init)
    *(.text*.__libc_init_first)
    *(.text*.__strrchr_avx2)
    *(.text*._RNvMs*_NtCs*_5alloc7raw_vecNtB*_11RawVecInner11finish_growCs*_8clj_eval*)
    *(.text*._RNvMs*_NtCs*_8clj_eval3envNtB*_17NamespaceRegistry6intern*)
    *(.text*._RINvYINtNtCs*_4core4hash18BuildHasherDefaultNtCs*_10rustc_hash8FxHasherENtB*_11BuildHasher8hash_oneRNtNtCs*_9clj_value6symbol6SymbolECs*_8clj_eval*)
    *(.text*._RINvNtCs*_4core3ptr9drop_glueINtNtNtCs*_5alloc3vec9into_iter8IntoIterINtNtNtCs*_3std6thread11join_handle10JoinHandleuEEECs*_8clj_eval*)
    *(.text*.call_fini)
    *(.text*.update_active.constprop.0)
    *(.text*.intel_check_word.constprop.0)
    *(.text*.__wrap___register_frame_info)
    *(.text*._RNvMs*_NtCs*_5alloc7raw_vecNtB*_11RawVecInner11finish_growCs*_5cljrt*)
    *(.text*.pthread_key_create)
    *(.text*._RNvNtCs*_8clj_eval3env12ensure_ns_in*)
    *(.text*._RINvMs*_NtCs*_9hashbrown3rawINtB*_8RawTableTyINtNtCs*_5alloc4sync3ArcNtNtCs*_8clj_eval3env12VarAlterLockEEE14reserve_rehashNCINvNtB*_3map11make_hasheryB*_INtNtCs*_4core4hash18BuildHasherDefaultNtCs*_10rustc_hash8FxHasherEE0EB*_*)
    *(.text*._RNvMs*_NtNtCs*_4core3str4iterINtB*_13SplitInternalAcj2_E9next_backCs*_8clj_eval*)
    *(.text*._RNvMs*_NtCs*_5alloc4syncINtB*_3ArcShE9drop_slowCs*_14regex_automata*)
    *(.text*._RNCINvMs*_NtNtCs*_3std4sync4onceNtB*_4Once15call_once_forceNCINvMNtB*_9once_lockINtB*_8OnceLockINtNtCs*_5alloc5boxed3BoxAINtNtNtCs*_4core4sync6atomic6AtomicjEj40_EE10initializeNCINvB*_11get_or_initNvMs*_NtCs*_9clj_value9fast_varsNtB*_10BindCounts11alloc_chunkE0zE0E0Cs*_8clj_eval*)
    *(.text*.calloc)
    *(.text*._RNvNtCs*_5cljrt6native6tables*)
    *(.text*._RNvNtCs*_5cljrt6native13call_core_var*)
    *(.text*._RINvMNtNtCs*_3std4sync9once_lockINtB*_8OnceLockINtNtCs*_4core6option6OptionNtNtCs*_8clj_eval10native_abi9CoreEntryEE10initializeNCINvB*_11get_or_initNCNvNtCs*_5cljrt6native10core_entry0E0zEB*_*)
    *(.text*._RNvNtCs*_8clj_eval2io14native_println*)
    *(.text*._RNvNtCs*_8clj_eval8printsys25maybe_bind_print_readably*)
    *(.text*._RNvNtCs*_9clj_value5print12pr_to_string*)
    *(.text*._RNvNtCs*_9clj_value5print17print_meta_prefix*)
    *(.text*._RNvMs*_NtCs*_8clj_eval3envNtB*_8Bindings8truncate*)
    *(.text*._RINvNtCs*_4core3ptr9drop_glueSTNtNtCs*_9clj_value9extension3VarNtNtB*_5value5ValueEECs*_8clj_eval*)
    *(.text*.__tls_pre_init_tp)
    *(.text*._dl_cet_setup_features)
    *(.text*.__libc_malloc2)
    *(.text*.__strcspn_sse42)
    *(.text*._dl_protect_relro)
    *(.text*.__new_exitfn)
    *(.text*._IO_stdfiles_init)
    *(.text*._dl_debug_initialize)
    *(.text*._RNvNtCs*_5cljrt4nabi12argv_strings*)
    *(.text*.pthread_key_delete)
    *(.text*._RNvMs*_NtCs*_8clj_eval3envNtB*_14SharedRegistry9ensure_ns*)
    *(.text*._RNvMs*_NtCs*_9hashbrown3mapINtB*_7HashMapyINtNtCs*_5alloc4sync3ArceEINtNtCs*_4core4hash18BuildHasherDefaultNtCs*_10rustc_hash8FxHasherEE6insertCs*_8clj_eval*)
    *(.text*._RINvMs*_NtCs*_9hashbrown3rawINtB*_8RawTableTyINtNtCs*_5alloc4sync3ArceEEE14reserve_rehashNCINvNtB*_3map11make_hasheryB*_INtNtCs*_4core4hash18BuildHasherDefaultNtCs*_10rustc_hash8FxHasherEE0ECs*_8clj_eval*)
    *(.text*._RINvMs*_NtCs*_9hashbrown3mapINtB*_7HashMapNtNtCs*_5alloc6string6StringNtNtCs*_8clj_eval3env9NamespaceINtNtCs*_4core4hash18BuildHasherDefaultNtCs*_10rustc_hash8FxHasherEE3geteEB*_*)
    *(.text*.btree_destroy)
    *(.text*.__tunable_set_val)
    *(.text*._dl_tls_static_surplus_init)
    *(.text*.__mempcpy_avx_unaligned_erms)
    *(.text*.__strchr_avx2)
    *(.text*.__init_misc)
    *(.text*._RNvNtCs*_5cljrt6native19reset_thread_caches*)
    *(.text*.getrandom)
    *(.text*._RINvMs*_NtCs*_9hashbrown3rawNtB*_13RawTableInner22fallible_with_capacityNtNtCs*_5alloc5alloc6GlobalECs*_8clj_eval*)
    *(.text*._RNCINvMs*_NtNtCs*_3std4sync4onceNtB*_4Once15call_once_forceNCINvMNtB*_9once_lockINtB*_8OnceLockINtNtCs*_4core6option6OptionNtNtCs*_8clj_eval10native_abi9CoreEntryEE10initializeNCINvB*_11get_or_initNCNvNtCs*_5cljrt6native10core_entry0E0zE0E0B*_*)
    *(.text*._RNvNtCs*_8clj_eval4core10print_opts*)
    *(.text*._RNvNtCs*_8clj_eval2io12check_writer*)
    *(.text*._dl_handle_execstack_tunable)
    *(.text*._RINvMs*_NtCs*_9hashbrown3mapINtB*_7HashMapINtNtCs*_5alloc4sync3ArceETNtNtCs*_9clj_value6symbol6SymbolyEINtNtCs*_4core4hash18BuildHasherDefaultNtCs*_10rustc_hash8FxHasherEE12contains_keyeECs*_8clj_eval*)
    *(.text*._RINvMs*_NtCs*_9hashbrown3rawINtB*_8RawTableTNtNtCs*_9clj_value6symbol6SymbolyEE4findNCINvNtB*_3map14equivalent_keyB*_B*_yE0ECs*_8clj_eval*)
    *(.text*._RNvMs*_NtCs*_8clj_eval4evalNtB*_9Evaluator13join_drainers*)
    *(.text*.gettid)
    *(.text*._IO_cleanup)
    *(.text*.__libc_setup_tls)
    *(.text*.__memset_avx2_unaligned_erms)
    *(.text*.__ctype_init)
    *(.text*.alloc_perturb)
    *(.text*.strdup)
    *(.text*.__memcpy_chk)
    *(.text*._dl_find_object_init)
    *(.text*.mprotect)
    *(.text*._RNvMs*_NtCs*_5alloc7raw_vecINtB*_6RawVecINtNtB*_3vec3VecNtNtCs*_9clj_value5value5ValueEE8grow_oneCs*_8clj_eval*)
    *(.text*._RNvYFG0_QL1_NtNtCs*_8clj_eval4eval9EvaluatorRL0_SNtNtCs*_9clj_value5value5ValueEINtNtCs*_4core6result6ResultB*_NtNtB*_5error11NativeErrorEINtNtNtB*_3ops8function2FnTQB*_RB*_EE4callB*_*)
    *(.text*._RNvNtCs*_8clj_eval2io10print_impl*)
    *(.text*._RNvNtCs*_8clj_eval8printsys12pr_on_method*)
    *(.text*._RNvMs*_NtCs*_9clj_value5valueNtB*_5Value9with_meta*)
    *(.text*._RNvNtCs*_8clj_eval2io9flush_out*)
    *(.text*._dl_determine_tlsoffset)
    *(.text*._RINvMs*_NtCs*_9hashbrown3rawINtB*_8RawTableTyNtNtCs*_8clj_eval3env8VarStateEE14reserve_rehashNCINvNtB*_3map11make_hasheryB*_INtNtCs*_4core4hash18BuildHasherDefaultNtCs*_10rustc_hash8FxHasherEE0EB*_*)
    *(.text*._dl_allocate_tls_init)
    *(.text*.fillin_rpath.isra.0)
    *(.text*.tcache_free_init)
    *(.text*.__cxa_atexit)
    *(.text*._RNvMs*_NtCs*_8clj_eval3envNtB*_8Bindings10push_frame*)
    *(.text*._RNCINvMs*_NtNtCs*_3std4sync4onceNtB*_4Once15call_once_forceNCINvMNtB*_9once_lockINtB*_8OnceLockINtNtCs*_5alloc4sync3ArcNtNtCs*_9clj_value9fast_vars10BindCountsEE10initializeNCINvB*_11get_or_initNCNvNtCs*_8clj_eval3env11bind_counts0E0zE0E0B*_*)
    *(.text*.rt_n_core_call)
    *(.text*._RNvMs*_NtCs*_8clj_eval3envNtB*_17NamespaceRegistry5state*)
    *(.text*._RNvNtCs*_8clj_eval2ns10deref_core*)
    *(.text*._RNvNtCs*_9clj_value5print13print_scalars*)
    *(.text*.init_cpu_features.constprop.0)
    *(.text*.__memcpy_avx_unaligned_erms)
    *(.text*.malloc)
    *(.text*._int_malloc)
    *(.text*.sbrk)
    *(.text*._RNvMs*_NtCs*_8clj_eval4evalNtB*_9Evaluator8new_bare*)
    *(.text*.getrandom_vdso)
    *(.text*._RINvMs*_NtCs*_9hashbrown3mapINtB*_7HashMapNtNtCs*_5alloc6string6StringNtNtCs*_8clj_eval3env9NamespaceINtNtCs*_4core4hash18BuildHasherDefaultNtCs*_10rustc_hash8FxHasherEE12contains_keyeEB*_*)
    *(.text*._RINvMs*_NtCs*_9hashbrown3mapINtB*_7HashMapNtNtCs*_5alloc6string6StringNtNtCs*_8clj_eval3env9NamespaceINtNtCs*_4core4hash18BuildHasherDefaultNtCs*_10rustc_hash8FxHasherEE7get_muteEB*_*)
    *(.text*._RNvMs*_NtCs*_8clj_eval3envNtB*_14SharedRegistry6intern*)
    *(.text*._RNvMs*_NtCs*_9hashbrown3mapINtB*_7HashMapyNtNtCs*_8clj_eval3env8VarStateINtNtCs*_4core4hash18BuildHasherDefaultNtCs*_10rustc_hash8FxHasherEE6insertB*_*)
    *(.text*.__run_exit_handlers)
    *(.text*._dl_aux_init)
    *(.text*.__tunable_get_val)
    *(.text*.getrlimit)
    *(.text*.__getrandom_early_init)
    *(.text*._dl_non_dynamic_init)
    *(.text*._RINvYINtNtCs*_4core4hash18BuildHasherDefaultNtCs*_10rustc_hash8FxHasherENtB*_11BuildHasher8hash_oneRDNtNtCs*_9clj_value6symbol6SymKeyEL_ECs*_8clj_eval*)
    *(.text*._RNvMs*_NtCs*_8clj_eval4evalNtB*_9Evaluator12push_binding*)
    *(.text*._RNvMs*_NtCs*_8clj_eval3envNtB*_14SharedRegistry11set_current*)
    *(.text*._RINvNtCs*_4core3ptr9drop_glueNtNtCs*_9clj_value5value5ValueECs*_8clj_eval*)
    *(.text*._RNvNtCs*_8clj_eval2ns17source_path_value*)
    *(.text*._RNvMs*_NtCs*_5alloc4syncINtB*_3ArcNtNtCs*_9clj_value6symbol10SymbolDataE9drop_slowB*_*)
    *(.text*._RNvXs*_NtCs*_8clj_eval2ioNtB*_6WriterNtNtCs*_9clj_value9extension14ExtensionValue6as_any*)
    *(.text*._RNvNtCs*_8clj_eval8printsys10value_meta*)
    *(.text*._RNvMs*_NtCs*_9clj_value5valueNtB*_5Value4meta*)
    *(.text*._RNvNtCs*_8clj_eval8printsys11token_value*)
    *(.text*.get_common_indices.constprop.0)
    *(.text*.__libc_early_init)
    *(.text*.strsep)
    *(.text*.__sigjmp_save)
    *(.text*.main)
    *(.text*._RNvMs*_NtCs*_8clj_eval3envNtB*_14SharedRegistry12reserve_vars*)
    *(.text*._RINvMs*_NtCs*_9hashbrown3rawINtB*_8RawTableTNtNtCs*_9clj_value6symbol6SymbolyEE14reserve_rehashNCINvNtB*_3map11make_hasherB*_yINtNtCs*_4core4hash18BuildHasherDefaultNtCs*_10rustc_hash8FxHasherEE0ECs*_8clj_eval*)
    *(.text*.exit)
    *(.text*.__wrap___deregister_frame_info)
    *(.text*._IO_flush_all)
    *(.text*.__libc_cleanup_push_defer)
    *(.text*._dl_relocate_static_pie)
    *(.text*.pthread_mutex_lock)
    *(.text*.__strncmp_avx2)
    *(.text*._dlfo_process_initial)
    *(.text*.__sigsetjmp)
    *(.text*.pthread_setspecific)
    *(.text*._RNvMs*_NtCs*_5alloc7raw_vecINtB*_6RawVecTyjEE8grow_oneCs*_8clj_eval*)
    *(.text*._RNvNtCs*_8clj_eval2ns10absolutize*)
    *(.text*._RINvMNtNtCs*_3std4sync9once_lockINtB*_8OnceLockINtNtCs*_5alloc5boxed3BoxAINtNtNtCs*_4core4sync6atomic6AtomicjEj40_EE10initializeNCINvB*_11get_or_initNvMs*_NtCs*_9clj_value9fast_varsNtB*_10BindCounts11alloc_chunkE0zECs*_8clj_eval*)
    *(.text*._RNvNtCs*_5cljrt4nabi13core_fallback*)
    *(.text*._RNvMs*_NtCs*_5alloc4syncINtB*_3ArceE9drop_slowCs*_9clj_value*)
    *(.text*._RNvNtCs*_8clj_eval8printsys21method_dispatch_value*)
    *(.text*._RNvNtCs*_9clj_value5print10print_into*)
    *(.text*.write)
    *(.text*._RNvNtCs*_8clj_eval3env13unbind_counts*)
    *(.text*.__tls_init_tp)
    *(.text*.__ptmalloc_init)
    *(.text*.expand_dynamic_string_token)
    *(.text*._RINvMs*_NtCs*_9hashbrown3rawINtB*_8RawTableTNtNtCs*_5alloc6string6StringNtNtCs*_8clj_eval3env9NamespaceEE14reserve_rehashNCINvNtB*_3map11make_hasherB*_B*_INtNtCs*_4core4hash18BuildHasherDefaultNtCs*_10rustc_hash8FxHasherEE0EB*_*)
    *(.text*._RNvMs*_NtCs*_9clj_value6symbolNtB*_6Symbol3new*)
    *(.text*._RNvMs*_NtCs*_8clj_eval3envNtB*_9Namespace6intern*)
    *(.text*._RNvMs*_NtCs*_8clj_eval3envNtB*_17NamespaceRegistry9state_mut*)
    *(.text*._RNvMNtCs*_8clj_eval11concurrencyNtB*_11AgentSystem14latch_and_park*)
    *(.text*._Exit)
    *(.text*.__strlen_avx2)
    *(.text*._RNvMs*_NtCs*_9hashbrown3mapINtB*_7HashMapNtNtCs*_5alloc6string6StringNtNtCs*_8clj_eval3env9NamespaceINtNtCs*_4core4hash18BuildHasherDefaultNtCs*_10rustc_hash8FxHasherEE6insertB*_*)
    *(.text*._RNvNtCs*_8clj_eval3env10track_bind*)
    *(.text*.rt_n_fast_vars)
    *(.text*._RNvMs*_NtCs*_8clj_eval3envNtB*_14SharedRegistry15root_or_unbound*)
    *(.text*._RNvNtCs*_8clj_eval4lazy12realize_deep*)
    *(.text*._RNvXs*_NtCs*_4core3fmtRxNtB*_7Display3fmtCs*_9clj_value*)
    *(.text*._RNvNtCs*_8clj_eval2io15write_to_writer*)
    *(.text*.__tunables_init)
    *(.text*._dl_get_origin)
    *(.text*.brk)
    *(.text*._setjmp)
    *(.text*.__memcmp_avx2_movbe)
    *(.text*.release_registered_frames)
    *(.text*.pthread_mutex_unlock)
    *(.text*.rt_n_declare_vars)
    *(.text*.__syscall_cancel)
    *(.text*._RNvMs*_NtCs*_8clj_eval3envNtB*_14SharedRegistry7current*)
    *(.text*._RNvNtCs*_5cljrt6native13execute_units*)
    *(.text*._RINvNtCs*_4core3ptr9drop_glueNtNtCs*_9clj_value5value5ValueECs*_5cljrt*)
    *(.text*._RINvMNtNtCs*_3std4sync9once_lockINtB*_8OnceLockINtNtCs*_5alloc4sync3ArcNtNtCs*_9clj_value9fast_vars10BindCountsEE10initializeNCINvB*_11get_or_initNCNvNtCs*_8clj_eval3env11bind_counts0E0zEB*_*)
    *(.text*._RNvNtCs*_8clj_eval8printsys14scalar_default*)
    *(.text*._RNvMs*_NtCs*_5alloc7raw_vecNtB*_11RawVecInner11finish_growCs*_9clj_value*)
    *(.text*.handle_intel.constprop.0)
    *(.text*.get_common_cache_info.constprop.0)
    *(.text*.getenv)
    *(.text*._RNvMs*_NtCs*_8clj_eval3envNtB*_9Namespace11drop_import*)
    *(.text*._RNvNtCs*_8clj_eval11concurrency8join_all*)
    *(.text*.__libc_cleanup_pop_restore)
    *(.text*._RNvNvNtNtNtNtCs*_3std3sys4args4unix3imp15ARGV_INIT_ARRAY12init_wrapper*)
    *(.text*._RNvMs*_NtNtCs*_3std6thread6threadNtB*_6Thread11new_current*)
    *(.text*._RNvMs*_NtNtCs*_3std6thread6threadNtB*_6Thread3new*)
    *(.text*._RNvMs*_NtNtNtNtCs*_3std3sys4sync4once5futexNtB*_4Once4call*)
    *(.text*._RNvXs*_NtNtCs*_3std2io5stdioNtB*_10StdoutLockNtNtNtCs*_4core2io5write5Write9write_all*)
    *(.text*._RNvXs*_NtNtCs*_3std2io5stdioNtB*_6StdoutNtNtNtCs*_4core2io5write5Write5flush*)
    *(.text*._RNvNtNtCs*_4core3str8converts9from_utf8*)
    *(.text*._RNvMNtNtNtNtCs*_3std3sys12thread_local3key4racyNtB*_7LazyKey9lazy_init*)
    *(.text*._int_realloc)
    *(.text*._int_free_merge_chunk)
    *(.text*._int_free_maybe_trim)
    *(.text*.realloc)
    *(.text*._int_free_chunk)
    *(.text*.unlink_chunk.isra.0)
    *(.text*._RNvMs*_NtCs*_5alloc7raw_vecINtB*_6RawVecTmRSRSTReFG0_QL1_NtNtCs*_8clj_eval4eval9EvaluatorRL0_SNtNtCs*_9clj_value5value5ValueEINtNtCs*_4core6result6ResultB*_NtNtB*_5error11NativeErrorEEEE8grow_oneCs*_5cljrt*)
    *(.text*.rt_n_main_lite)
    *(.text*._RNvNtCs*_5cljrt6native21declare_lite_core_cap*)
    *(.text*._RNvNtCs*_8clj_eval8aot_boot8lite_row*)
    *(.text*.rt_n_cap_io)
    *(.text*._RNvNtCs*_8clj_eval8aot_boot20install_core_dynamic*)
    *(.text*.__libc_calloc2)
    *(.text*._RNvMs*_NtCs*_5alloc7raw_vecINtB*_6RawVecNtNtCs*_8clj_eval4expr10KeyBindingE8grow_oneB*_*)
    *(.text*._RNvMs*_NtCs*_5alloc7raw_vecNtB*_11RawVecInner11finish_growCs*_3std*)
    *(.text*._RNvMNtCs*_5alloc6stringNtB*_6String15from_utf8_lossy*)
    *(.text*._RNvXs*_NtCs*_9clj_value5valueNtB*_5ValueNtNtCs*_4core5clone5Clone5clone.698*)
    *(.text*._RINvNtCs*_4core3ptr9drop_glueSNtNtCs*_5cljrt6native7VarSlotEB*_*)
    *(.text*._RNvXs*_NtNtCs*_4core3str5lossyNtB*_10Utf8ChunksNtNtNtNtB*_4iter6traits8iterator8Iterator4next*)
    *(.text*.getcwd)
    *(.text*._RNvNtCs*_3std3env11current_dir*)
    *(.text*._RNvMs*_NtCs*_3std4pathNtB*_4Path5__join*)
    *(.text*._RINvNvMs*_NtCs*_5alloc7raw_vecINtB*_11RawVecInnerpE7reserve21do_reserve_and_handleNtNtB*_5alloc6GlobalECs*_3std*)
    *(.text*.rt_n_consts_base)
    *(.text*._RNvXs*_NtCs*_5alloc6stringNtB*_6StringNtNtCs*_4core3fmt5Write9write_str.2221*)
    *(.text*._RINvMNtNtCs*_3std4sync9once_lockINtB*_8OnceLockINtNtNtB*_6poison5mutex5MutexINtNtNtNtCs*_5alloc2io8buffered9bufreader9BufReaderNtNtNtB*_2io5stdio8StdinRawEEE10initializeNCINvB*_11get_or_initNCNvB*_5stdin0E0zEB*_*)
    *(.text*._RINvMNtNtCs*_3std4sync9once_lockINtB*_8OnceLockNtNtCs*_9clj_value9extension3VarE10initializeNCINvB*_11get_or_initNCNvNtCs*_5cljrt6native3var0E0zEB*_*)
    *(.text*._RINvMs*_NtCs*_9hashbrown3rawINtB*_8RawTableTINtNtCs*_5alloc4sync3ArceEIB*_NtNtCs*_9clj_value7keyword11KeywordDataEEE14reserve_rehashNCINvNtB*_3map11make_hasherB*_B*_INtNtCs*_4core4hash18BuildHasherDefaultNtCs*_10rustc_hash8FxHasherEE0EB*_*)
    *(.text*._RINvMs*_NtCs*_9hashbrown3rawINtB*_8RawTableTNtNtCs*_9clj_value7keyword7KeyworduEE14reserve_rehashNCINvNtB*_3map11make_hasherB*_uNtNtNtCs*_3std4hash6random11RandomStateE0ECs*_10clj_reader*)
    *(.text*._RINvMs*_NtCs*_9hashbrown3rawINtB*_8RawTableTyNtNtCs*_9clj_value5value5ValueEE14reserve_rehashNCINvNtB*_3map11make_hasheryB*_INtNtCs*_4core4hash18BuildHasherDefaultNtCs*_10rustc_hash8FxHasherEE0ECs*_8clj_eval*)
    *(.text*._RINvMs*_NtCs*_9hashbrown3rawNtB*_13RawTableInner22fallible_with_capacityNtNtCs*_5alloc5alloc6GlobalECs*_9clj_value*)
    *(.text*._RINvNtCs*_4core3ptr9drop_glueINtNtCs*_5alloc3vec3VecNtNtB*_6string6StringEECs*_5cljrt*)
    *(.text*._RINvNtCs*_4core3ptr9drop_glueINtNtCs*_5alloc3vec3VecNtNtCs*_5cljrt6native7VarSlotEEB*_*)
    *(.text*._RINvNtCs*_4core3ptr9drop_glueINtNtCs*_5alloc3vec3VecNtNtCs*_9clj_value5value5ValueEEB*_*)
    *(.text*._RINvNtCs*_4core3ptr9drop_glueINtNtCs*_5alloc3vec3VecNtNtCs*_9clj_value5value5ValueEECs*_5cljrt*)
    *(.text*._RINvNtCs*_4core3ptr9drop_glueINtNtCs*_5alloc3vec3VecNtNtCs*_9clj_value5value5ValueEECs*_8clj_eval*)
    *(.text*._RINvNtCs*_4core3ptr9drop_glueINtNtCs*_5alloc3vec3VecTNtNtCs*_9clj_value9extension3VarNtNtB*_5value5ValueEEECs*_8clj_eval*)
    *(.text*._RINvNtCs*_4core3ptr9drop_glueINtNtCs*_9hashbrown10scopeguard10ScopeGuardNtNtB*_3raw13RawTableInnerNCINvMs*_B*_B*_14prepare_resizeNtNtCs*_5alloc5alloc6GlobalE0EECs*_9clj_value*)
    *(.text*._RINvNtCs*_4core3ptr9drop_glueINtNtNtCs*_5alloc3vec5drain5DrainINtB*_3VecTNtNtCs*_9clj_value9extension3VarNtNtB*_5value5ValueEEEECs*_8clj_eval*)
    *(.text*._RINvNtCs*_4core3ptr9drop_glueINtNtNtNtB*_4iter8adapters3map3MapINtNtNtCs*_5alloc3vec9into_iter8IntoIterINtNtB*_6option6OptionNtNtCs*_5cljrt6native6FnDescEENCNvB*_6freeze0EEB*_*)
    *(.text*._RINvNtCs*_4core3ptr9drop_glueNtNtCs*_9clj_value5value5ValueEB*_*)
    *(.text*._RINvNtCs*_4core3ptr9drop_glueNtNtCs*_10clj_reader4opts10ReaderOptsECs*_8clj_eval*)
    *(.text*._RINvNtCs*_4core3ptr9drop_glueSNtNtCs*_9clj_value5value5ValueEB*_*)
    *(.text*._RINvNtCs*_4core3ptr9drop_glueSTNtNtCs*_9clj_value6symbol6SymbolNtNtB*_5value5ValueEECs*_8clj_eval*)
    *(.text*._RINvNtCs*_4core3ptr9drop_glueTNtNtCs*_9clj_value9extension3VarNtNtB*_5value5ValueEECs*_8clj_eval*)
    *(.text*._RINvNtNtNtNtCs*_3std3sys12thread_local6native5eager7destroyINtNtCs*_4core4cell7RefCellINtNtCs*_5alloc3vec3VecINtNtB*_6option6OptionTTyyENtNtCs*_9clj_value5value5ValueEEEEECs*_5cljrt*)
    *(.text*._RINvNtNtNtNtCs*_3std3sys12thread_local6native5eager7destroyINtNtCs*_4core4cell7RefCellINtNtCs*_5alloc3vec3VecjEEECs*_5cljrt*)
    *(.text*._RINvNvMs*_NtCs*_5alloc7raw_vecINtB*_11RawVecInnerpE7reserve21do_reserve_and_handleNtNtB*_5alloc6GlobalECs*_5cljrt*)
    *(.text*._RINvXNvMNtCs*_5alloc5sliceSp9to_vec_inNtNtCs*_9clj_value5value5ValueNtB*_10ConvertVec6to_vecNtNtB*_5alloc6GlobalECs*_8clj_eval*)
    *(.text*._RINvXs*_NtCs*_5alloc6stringNtB*_6StringINtNtNtNtCs*_4core4iter6traits7collect12FromIteratorRcE9from_iterINtNtNtB*_5slice4iter4ItercEECs*_10clj_reader*)
    *(.text*._RINvYNtNtNtCs*_3std4hash6random11RandomStateNtNtCs*_4core4hash11BuildHasher8hash_oneRNtNtCs*_9clj_value6symbol6SymbolECs*_10clj_reader*)
    *(.text*._RNCINvMs*_NtNtCs*_3std4sync4onceNtB*_4Once15call_once_forceNCINvMNtB*_9once_lockINtB*_8OnceLockINtNtNtB*_6poison5mutex5MutexINtNtNtNtCs*_5alloc2io8buffered9bufreader9BufReaderNtNtNtB*_2io5stdio8StdinRawEEE10initializeNCINvB*_11get_or_initNCNvB*_5stdin0E0zE0E0B*_*)
    *(.text*._RNCINvMs*_NtNtCs*_3std4sync4onceNtB*_4Once15call_once_forceNCINvMNtB*_9once_lockINtB*_8OnceLockNtNtCs*_9clj_value9extension3VarE10initializeNCINvB*_11get_or_initNCNvNtCs*_5cljrt6native3var0E0zE0E0B*_*)
    *(.text*._RNCINvMs*_NtNtCs*_3std4sync4onceNtB*_4Once15call_once_forceNCINvMNtB*_9once_lockINtB*_8OnceLockTyyNtNtCs*_9clj_value5value5ValueEE10initializeNCINvB*_11get_or_initNCNvB*_10try_insert0E0zE0E0B*_*)
    *(.text*._RNCINvMs*_NtNtCs*_3std4sync4onceNtB*_4Once15call_once_forceNCNvMNtB*_9lazy_lockINtB*_8LazyLockINtNtCs*_5alloc4sync3ArcSNtNtCs*_9clj_value5value5ValueEE5force0E0Cs*_5cljrt*)
    *(.text*._RNCINvMs*_NtNtCs*_3std4sync4onceNtB*_4Once15call_once_forceNCNvMNtB*_9lazy_lockINtB*_8LazyLockINtNtNtB*_6poison5mutex5MutexNtNtCs*_9clj_value7keyword12KeywordTableEE5force0E0B*_*)
    *(.text*._RNvCs*_7___rustc12___rust_alloc*)
    *(.text*._RNvCs*_7___rustc14___rust_realloc*)
    *(.text*._RNvCs*_7___rustc19___rust_alloc_zeroed*)
    *(.text*._RNvCs*_6clj_bc10clone_rare*)
    *(.text*._RNvMCs*_10clj_readerNtB*_6Reader3new*)
    *(.text*._RNvMNtCs*_10clj_reader6streamNtB*_10CharStream6extend*)
    *(.text*._RNvMs*_NtCs*_9hashbrown3mapINtB*_7HashMapNtNtCs*_9clj_value7keyword7KeyworduNtNtNtCs*_3std4hash6random11RandomStateE6insertCs*_10clj_reader*)
    *(.text*._RNvMs*_NtCs*_9hashbrown3mapINtB*_7HashMapyNtNtCs*_9clj_value5value5ValueINtNtCs*_4core4hash18BuildHasherDefaultNtCs*_10rustc_hash8FxHasherEE6insertCs*_8clj_eval*)
    *(.text*._RNvMs*_NtCs*_8clj_eval4evalNtB*_9Evaluator10def_finish*)
    *(.text*._RNvMs*_NtCs*_8clj_eval4evalNtB*_9Evaluator10force_lazy*)
    *(.text*._RNvMs*_NtCs*_8clj_eval4evalNtB*_9Evaluator16deref_var_cached*)
    *(.text*._RNvMs*_NtCs*_8clj_eval4evalNtB*_9Evaluator19install_native_rows*)
    *(.text*._RNvMs*_NtCs*_8clj_eval3envNtB*_14SharedRegistry14take_meta_lazy*)
    *(.text*._RNvMs*_NtCs*_5alloc7raw_vecINtB*_6RawVecRSTReFG_QL0_NtNtCs*_8clj_eval4eval9EvaluatorINtCs*_8smallvec8SmallVecANtNtCs*_9clj_value5value5Valuej4_EEINtNtCs*_4core6result6ResultB*_NtNtB*_5error11NativeErrorEEE8grow_oneCs*_5cljrt*)
    *(.text*._RNvMs*_NtCs*_5alloc7raw_vecINtB*_6RawVecTReRSRSTB*_FG0_QL1_NtNtCs*_8clj_eval4eval9EvaluatorRL0_SNtNtCs*_9clj_value5value5ValueEINtNtCs*_4core6result6ResultB*_NtNtB*_5error11NativeErrorEEEE8grow_oneCs*_5cljrt*)
    *(.text*._RNvMs*_NtCs*_5alloc7raw_vecNtB*_11RawVecInner14grow_amortizedCs*_5gimli*)
    *(.text*._RNvMs*_NtCs*_9clj_value5valueNtB*_6Vector8from_vec*)
    *(.text*._RNvMs*_NtCs*_9clj_value7keywordNtB*_7Keyword3new*)
    *(.text*._RNvMs*_NtCs*_5alloc4syncINtB*_3ArcShE15copy_from_sliceCs*_8clj_eval*)
    *(.text*._RNvNtCs*_5cljrt4nabi16def_finish_named*)
    *(.text*._RNvNtCs*_5cljrt6native4root*)
    *(.text*._RNvNtCs*_8clj_eval2ns8ns_value*)
    *(.text*._RNvNtCs*_8clj_eval4eval17qualified_display*)
    *(.text*._RNvNtCs*_8clj_eval6reader12stdin_reader*)
    *(.text*._RNvNtCs*_8clj_eval6reader17check_reader_open*)
    *(.text*._RNvNtCs*_8clj_eval8printsys5pr_on*)
    *(.text*._RNvXNtCs*_4core3anyNtNtCs*_8clj_eval6reader12StreamReaderNtB*_3Any7type_idB*_*)
    *(.text*._RNvXNtCs*_9hashbrown3mapINtB*_7HashMapNtNtCs*_9clj_value6symbol6SymboluNtNtNtCs*_3std4hash6random11RandomStateENtNtCs*_4core5clone5Clone5cloneCs*_10clj_reader*)
    *(.text*._RNvXs*_NtCs*_10clj_reader4optsNtB*_10ReaderOptsNtNtCs*_4core7default7Default7default*)
    *(.text*._RNvXs*_NtCs*_5alloc4syncINtB*_3ArcSNtNtCs*_9clj_value5value5ValueEINtNtCs*_4core7convert4FromINtNtB*_3vec3VecB*_EE4fromCs*_8clj_eval*)
    *(.text*._RNvXs*_NtNtCs*_4core4hash3sipINtB*_6HasherNtB*_11Sip13RoundsENtB*_6Hasher5writeCs*_14regex_automata*)
    *(.text*._RNvXs*_NtCs*_8clj_eval6readerNtB*_12StreamReaderNtNtCs*_9clj_value9extension14ExtensionValue6as_any*)
    *(.text*._RNvXs*_NtCs*_10clj_reader4optsNtB*_10ReaderOptsNtNtCs*_4core5clone5Clone5clone*)
    *(.text*._RNvYNCNvNtCs*_9clj_value7keyword13KEYWORD_TABLE0INtNtNtCs*_4core3ops8function6FnOnceuE9call_onceB*_*)
    *(.text*._RNvYNCNvNvNtCs*_5cljrt6native14captured_slice11NO_CAPTURES0INtNtNtCs*_4core3ops8function6FnOnceuE9call_onceB*_*)
    *(.text*.read)
    *(.text*.rt_bc_clone)
    *(.text*.rt_n_cap_core)
    *(.text*.rt_n_cap_string)
    *(.text*.rt_n_declare_fn)
    *(.text*.rt_n_def_begin_var)
    *(.text*.rt_n_def_finish_var)
    *(.text*.rt_n_deref)
    *(.text*.rt_n_drop)
    *(.text*.rt_n_enter)
    *(.text*.rt_n_leave)
    *(.text*.rt_n_make_fn)
    *(.text*.rt_n_set_const)
    *(.text*._RINvNtCs*_4core3ptr9drop_glueINtNtNtCs*_5alloc3vec9into_iter8IntoIterTReFG0_QL1_NtNtCs*_8clj_eval4eval9EvaluatorRL0_SNtNtCs*_9clj_value5value5ValueEINtNtB*_6result6ResultB*_NtNtB*_5error11NativeErrorEINtNtB*_6option6OptionINtNtB*_4sync3ArcDG_INtNtNtB*_3ops8function2FnTQL0_B*_INtCs*_8smallvec8SmallVecAB*_j4_EEEp6OutputB*_NtNtB*_6marker4SendNtB*_4SyncEL_EEEEEB*_*)
    *(.text*._RINvNtCs*_4core3ptr9drop_glueNtNtCs*_9clj_value5value11VectorInnerEB*_*)
    *(.text*._RINvNvMs*_NtCs*_5alloc7raw_vecINtB*_11RawVecInnerpE7reserve21do_reserve_and_handleNtNtB*_5alloc6GlobalECs*_8clj_eval*)
    *(.text*._RNvMs*_NtCs*_5alloc4syncINtB*_3ArcINtNtB*_3vec3VecNtNtCs*_9clj_value5value5ValueEE9drop_slowB*_*)
    *(.text*._RNvMs*_NtCs*_5alloc4syncINtB*_3ArcNtNtCs*_9clj_value5value10VectorDataE9drop_slowB*_*)
    *(.text*._RNvNtCs*_8clj_eval2ns14owned_entry_in*)
    *(.text*._RNvXNtCs*_4core3anyNtNtCs*_8clj_eval3ext8NativeFnNtB*_3Any7type_idB*_*)
    *(.text*._RNvXs*_NtCs*_8clj_eval3extNtB*_8NativeFnNtNtCs*_9clj_value9extension14ExtensionValue6as_any*)
    *(.text*.rt_n_cap_seq)
    *(.text*.rt_n_str)
    *(.text*._RNvMs*_NtCs*_5alloc7raw_vecINtB*_6RawVecTmmEE8grow_oneCs*_8clj_eval*)
    *(.text*._RNvNtCs*_5cljrt4nabi9take_args*)
    *(.text*._RNvNtCs*_9clj_value3seq11piece_value*)
    *(.text*._RNvNtCs*_8clj_eval2re13pattern_split*)
    *(.text*._RNvNtCs*_8clj_eval2re8cut_kind*)
    *(.text*._RNvYFG_QL0_NtNtCs*_8clj_eval4eval9EvaluatorINtCs*_8smallvec8SmallVecANtNtCs*_9clj_value5value5Valuej4_EEINtNtCs*_4core6result6ResultB*_NtNtB*_5error11NativeErrorEINtNtNtB*_3ops8function2FnTQB*_B*_EE4callB*_*)
    *(.text*.rt_n_core_own)
    *(.text*._RNvNtCs*_8clj_eval2io12native_slurp*)
    *(.text*._RNvNtCs*_8clj_eval2io9file_opts*)
    *(.text*._RNvXs*_NtNtNtCs*_5alloc2io8buffered9bufreaderINtB*_9BufReaderINtNtB*_5boxed3BoxDNtNtB*_4read4ReadNtNtCs*_4core6marker4SendEL_EEB*_11read_to_endCs*_8clj_eval*)
    *(.text*._RNvXs*_NtCs*_9clj_value5valueNtB*_5ValueNtNtCs*_4core5clone5Clone5clone.2227*)
    *(.text*._RINvMNtNtCs*_3std4sync9once_lockINtB*_8OnceLockTyyNtNtCs*_9clj_value5value5ValueEE10initializeNCINvB*_11get_or_initNCNvB*_10try_insert0E0zEB*_*)
    *(.text*._RINvNvNtNtCs*_5alloc2io4read19default_read_to_end16small_probe_readNtNtNtNtCs*_3std3sys5stdio4unix5StdinEB*_*)
    *(.text*._RNvMs*_NtCs*_5alloc4syncINtB*_3ArcNtNtCs*_9clj_value5value10VectorDataE8make_mutB*_*)
    *(.text*._RNvXs*_NtNtCs*_3std2io5stdioNtB*_5StdinNtNtNtCs*_5alloc2io4read4Read11read_to_end*)
    *(.text*._RNvXs*_NtNtNtCs*_5alloc2io8buffered9bufreaderINtB*_9BufReaderNtNtNtCs*_3std2io5stdio8StdinRawENtNtB*_4read4Read11read_to_endB*_*)
    *(.text*.rt_bc_deref)
    *(.text*.rt_n_regex)
    *(.text*._RNvMs*_NtCs*_9clj_value5valueNtB*_6Vector9with_meta*)
    *(.text*._RNvNtCs*_8clj_eval14stdlib_natives12native_split*)
    *(.text*._RNvXs*_NtCs*_5alloc6stringNtB*_6StringNtNtCs*_4core3fmt5Write9write_str*)
    *(.text*.rt_n_vec_lit)
    *(.text*._RNCINvMs*_NtNtCs*_3std4sync4onceNtB*_4Once15call_once_forceNCINvMNtB*_9once_lockINtB*_8OnceLockINtNtCs*_5alloc4sync3ArceEE10initializeNCINvB*_11get_or_initNCNvNtCs*_9clj_value3seq11piece_value0E0zE0E0B*_*)
    *(.text*._RNvMs*_NtCs*_9clj_value5valueNtB*_6Vector3get*)
    *(.text*._RINvNtCs*_4core3ptr9drop_glueNtNtCs*_9clj_value3seq11RealizedSeqECs*_8clj_eval*)
    *(.text*._RINvNtCs*_4core3ptr9drop_glueNtNtCs*_9clj_value3seq3SeqECs*_8clj_eval*)
    *(.text*._RNvNtCs*_8clj_eval2vm11call_native*)
    *(.text*._RNvMs*_NtCs*_8clj_eval2vmNtB*_8Prepared5call1*)
    *(.text*._RNvMs*_NtCs*_9clj_value4trieINtB*_6PackedxE8from_vecB*_*)
    *(.text*.rt_n_op1)
    *(.text*._RNvNtCs*_8clj_eval4seqs12native_range*)
    *(.text*._RNvNtCs*_8clj_eval4core9check_ifn*)
    *(.text*.rt_n_const)
    *(.text*._RNvNtCs*_8clj_eval4lazy12as_subvector*)
    *(.text*._RNvNtCs*_9clj_value5print12print_string*)
    *(.text*._RNvNtCs*_8clj_eval4lazy10is_seqable*)
    *(.text*._RNvXs*_NtCs*_9clj_value5valueNtB*_5ValueNtNtCs*_4core3cmp9PartialEq2eq*)
    *(.text*._RNvXs*_NtCs*_9clj_value5valueNtB*_10VectorIterNtNtNtNtCs*_4core4iter6traits8iterator8Iterator4next*)
    *(.text*._RNvMs*_NtCs*_9clj_value5valueNtB*_6Vector4iter*)
    *(.text*._RNvMs*_NtCs*_5alloc4syncINtB*_3ArcSNtNtCs*_9clj_value5value5ValueE9drop_slowB*_*)
    *(.text*._RNvMs*_NtCs*_9clj_value5valueNtB*_6Vector14from_flat_ints*)
    *(.text*._RNvNtCs*_8clj_eval4lazy9seq_value*)
    *(.text*._RNvNtCs*_8clj_eval4core14parse_long_str*)
    *(.text*._RINvXs*_NtCs*_9clj_value5valueNtB*_5ValueNtNtCs*_4core4hash4Hash4hashNtCs*_10rustc_hash8FxHasherEB*_*)
    *(.text*._RNvMs*_NtCs*_9clj_value9transientNtB*_15TransientVector10persistent*)
    *(.text*._RNvXs*_NtCs*_9clj_value5valueNtB*_10VectorDataNtNtCs*_4core5clone5Clone5clone*)
    *(.text*._RNvNtCs*_8clj_eval4lazy9step_unit*)
    *(.text*._RNvNtCs*_8clj_eval4coll16native_vec_owned*)
    *(.text*._RNvMs*_NtCs*_5alloc3vecINtB*_3VecNtNtCs*_9clj_value5value5ValueE16into_boxed_sliceB*_*)
    *(.text*._RINvMs*_NtNtNtNtCs*_3std3sys12thread_local6native4lazyINtB*_7StorageINtNtCs*_4core4cell7RefCellNtNtCs*_9clj_value5value13ShapeRegistryEuE16get_or_init_slowNvNvB*_14SHAPE_REGISTRY27___rust_std_internal_init_fnEB*_*)
    *(.text*._RNvNtCs*_9clj_value5value12intern_shape*)
    *(.text*._RINvMs*_NtCs*_9hashbrown3rawINtB*_8RawTableTINtNtCs*_5alloc3vec3VecNtNtCs*_9clj_value5value5ValueEINtNtB*_4sync4WeakNtB*_8MapShapeEEE14reserve_rehashNCINvNtB*_3map11make_hasherB*_B*_INtNtCs*_4core4hash18BuildHasherDefaultNtCs*_10rustc_hash8FxHasherEE0EB*_*)
    *(.text*._RINvNtNtNtNtCs*_3std3sys12thread_local6native4lazy7destroyINtNtCs*_4core4cell7RefCellNtNtCs*_9clj_value5value13ShapeRegistryEEB*_*)
    *(.text*._RNvNtCs*_8clj_eval4core8str_push*)
    *(.text*._RNvMs*_NtCs*_5alloc4syncINtB*_3ArcDG0_INtNtNtCs*_4core3ops8function2FnTQL1_NtNtCs*_8clj_eval4eval9EvaluatorRL0_SNtNtCs*_9clj_value5value5ValueEEp6OutputINtNtB*_6result6ResultB*_NtNtB*_5error11NativeErrorENtNtB*_6marker4SendNtB*_4SyncEL_E9drop_slowB*_*)
    *(.text*._RNvXs*_NtCs*_9clj_value3seqNtB*_11RealizedSeqNtNtB*_9extension14ExtensionValue6as_any*)
    *(.text*._RNvXNtCs*_4core3anyNtNtCs*_9clj_value3seq11RealizedSeqNtB*_3Any7type_idB*_*)
    *(.text*._RINvNtCs*_4core3ptr9drop_glueINtCs*_8smallvec8SmallVecANtNtCs*_9clj_value5value5Valuej4_EECs*_5cljrt*)
    *(.text*._RNCNCNvNtCs*_5cljrt6native7make_fn00B*_*)
    *(.text*._RNvMs*_NtCs*_9clj_value5valueNtB*_6Vector8is_empty*)
    *(.text*._RINvNtCs*_4core3ptr9drop_glueINtNtNtCs*_5alloc3vec9into_iter8IntoIterNtNtCs*_9clj_value5value5ValueEECs*_8clj_eval*)
    *(.text*.rt_n_iter_plan)
    *(.text*._RNvNtCs*_8clj_eval4lazy14collect_packed*)
    *(.text*._RNvMs*_NtCs*_8clj_eval4evalNtB*_9Evaluator6invoke*)
    *(.text*._RNvMs*_NtCs*_8clj_eval4evalNtB*_9Evaluator4call*)
    *(.text*._RNvMs*_NtCs*_9clj_value9transientNtB*_14TransientItems3put*)
    *(.text*._RINvNtCs*_4core3ptr9drop_glueNtNtCs*_8clj_eval3ext8NativeFnEB*_*)
    *(.text*._RINvNtCs*_4core3ptr9drop_glueNCNCNvNtCs*_5cljrt6native7make_fn00EB*_*)
    *(.text*._RINvNtCs*_4core3ptr9drop_glueNCNvNtCs*_5cljrt6native7make_fns*_0EB*_*)
    *(.text*._RNvNtCs*_8clj_eval4lazy8step_seq*)
    *(.text*._RINvNtCs*_4core3ptr9drop_glueNtNtCs*_5cljrt6native6FnDescEB*_*)
    *(.text*._RNvMs*_NtCs*_9clj_value3seqNtB*_3Seq10chunk_next*)
    *(.text*._RNvNtCs*_8clj_eval4core16native_str_owned*)
    *(.text*._RNvMs*_NtCs*_8clj_eval4lazyNtB*_10PendingSeq12pending_kind*)
    *(.text*._RINvNtCs*_4core3ptr9drop_glueNtNtCs*_8clj_eval4lazy10PendingSeqEB*_*)
    *(.text*._RNvXs*_NtCs*_8clj_eval4lazyNtB*_10PendingSeqNtNtCs*_9clj_value9extension14ExtensionValue6as_any*)
    *(.text*._RNvXNtCs*_4core3anyNtNtCs*_8clj_eval4lazy10PendingSeqNtB*_3Any7type_idB*_*)
    *(.text*._RINvNtCs*_4core3ptr9drop_glueNtNtCs*_8clj_eval4lazy8SeqStateEB*_*)
    *(.text*._RNvMs*_NtCs*_9clj_value5valueNtB*_3Map10from_parts*)
    *(.text*._RINvNtCs*_4core3ptr9drop_glueINtNtNtCs*_5alloc3vec9into_iter8IntoIterTNtNtCs*_9clj_value5value5ValueB*_EEEB*_*)
    *(.text*._RNvMs*_NtCs*_9clj_value5valueNtB*_3Map18from_kvs_last_wins*)
    *(.text*._RNvXs*_NtCs*_8clj_eval3extNtB*_8NativeFnNtNtCs*_9clj_value9extension14ExtensionValue6as_any.767*)
    *(.text*._RINvNtCs*_4core3ptr9drop_glueNtNtCs*_9clj_value3seq8RangeNumEB*_*)
    *(.text*._RNvXs*_NtCs*_9clj_value3seqNtB*_10RangeValueNtNtB*_9extension14ExtensionValue6as_any*)
    *(.text*._RINvNtCs*_4core3ptr9drop_glueNtNtCs*_9clj_value3seq10RangeValueECs*_8clj_eval*)
    *(.text*._RNvXNtCs*_4core3anyNtNtCs*_9clj_value3seq10RangeValueNtB*_3Any7type_idB*_*)
    *(.text*._RNvXs*_NtCs*_9clj_value3seqNtB*_8RangeNumNtNtCs*_4core5clone5Clone5clone*)
    *(.text*._RNvNtCs*_8clj_eval4lazy10long_range*)
    *(.text*._RINvNtCs*_4core3ptr9drop_glueINtNtCs*_5alloc5boxed3BoxNtNtCs*_8clj_eval4lazy5ThunkEEB*_*)
    *(.text*._RNvMs*_NtCs*_5alloc7raw_vecINtB*_6RawVecTNtNtCs*_9clj_value5value5ValueB*_EE8grow_oneB*_*)
    *(.text*._RNvXs*_NtCs*_8clj_eval6vm_opsNtB*_5SeqOpNtB*_3Op15apply*)
    *(.text*._RNvMs*_NtCs*_8triomphe3arcINtB*_3ArcINtNtNtCs*_4rpds3map13hash_trie_map4NodeNtNtCs*_9clj_value5value5ValueB*_NtNtNtNtCs*_7archery14shared_pointer4kind4arct5ArcTKEE6as_ptrB*_*)
    *(.text*._RNvNtCs*_8clj_eval4lazy13walk_sole_map*)
    *(.text*._RNvNtCs*_8clj_eval4lazy13force_pending*)
    *(.text*._RINvNtCs*_4core3ptr9drop_glueNtNtCs*_8clj_eval4lazy5ThunkEB*_*)
    *(.text*._RNvNtCs*_8clj_eval4seqs10native_map*)
    *(.text*._RNvNtCs*_8clj_eval4lazy8map_unit*)
    *(.text*._RNvXs*_NtCs*_8clj_eval4lazyNtB*_10PendingSeqNtNtCs*_9clj_value9extension14ExtensionValue10as_any_mut*)
    *(.text*._RNvNtCs*_8clj_eval4seqs10long_range*)
    *(.text*._RNvNtCs*_8clj_eval4lazy8step_map*)
    *(.text*._RINvNtCs*_4core3ptr9drop_glueNtNtCs*_8clj_eval10native_abi10VecBuilderEB*_*)
    *(.text*.rt_n_vec_new)
    *(.text*._RNvXs*_NtCs*_8clj_eval10native_abiNtB*_10VecBuilderNtNtCs*_9clj_value9extension14ExtensionValue10as_any_mut*)
    *(.text*._RNvXNtCs*_4core3anyNtNtCs*_8clj_eval10native_abi10VecBuilderNtB*_3Any7type_idB*_*)
    *(.text*.rt_n_vec_done)
    *(.text*.rt_n_vec_push)
    *(.text*._RNvNtCs*_8clj_eval4lazy8seq_fast*)
    *(.text*._RNvNtCs*_8clj_eval4coll13native_zipmap*)
    *(.text*._RNvMs*_NtCs*_8clj_eval4collNtB*_11ZipmapBuild4push*)
    *(.text*._RNvNtCs*_8clj_eval4lazy7seq_str*)
    *(.text*._RNvMs*_NtCs*_5alloc7raw_vecINtB*_6RawVecINtNtCs*_4core6option6OptionNtNtCs*_9clj_value5value5ValueEE8grow_oneB*_*)
    *(.text*._RNvNtCs*_8clj_eval4seqs20native_filterv_owned*)
    *(.text*._RNvNtCs*_8clj_eval4seqs14filterv_vector*)
    *(.text*._RNvNtCs*_8clj_eval4lazy10native_seq*)
    *(.text*._RNvMs*_NtCs*_5alloc4syncINtB*_3ArcINtNtB*_3vec3VecxEE8make_mutCs*_9clj_value*)
    *(.text*._RNvNtCs*_8clj_eval4lazy10seq_vector*)
    *(.text*._RNvNtCs*_9clj_value5value7new_set*)
    *(.text*._RNvMs*_NtCs*_5alloc4syncINtB*_3ArcNtNtCs*_9clj_value5value7SetDataE8make_mutB*_*)
    *(.text*._RNvMs*_NtCs*_5alloc4syncINtB*_3ArcINtNtB*_3vec3VecINtNtCs*_4core6option6OptionNtNtCs*_9clj_value5value5ValueEEE8make_mutB*_*)
    *(.text*._RNvMs*_NtCs*_9clj_value4trieINtB*_4PVecINtNtCs*_4core6option6OptionNtNtB*_5value5ValueEE13push_back_mutB*_*)
    *(.text*._RNvMNtNtCs*_4rpds3map13hash_trie_mapINtB*_4NodeNtNtCs*_9clj_value5value5ValuejNtNtNtNtCs*_7archery14shared_pointer4kind4arct5ArcTKE6insertB*_*)
    *(.text*._RNvMs*_NtNtCs*_4rpds3map13hash_trie_mapINtB*_11HashTrieMapNtNtCs*_9clj_value5value5ValuejNtNtNtNtCs*_7archery14shared_pointer4kind4arct5ArcTKINtNtCs*_4core4hash18BuildHasherDefaultNtCs*_10rustc_hash8FxHasherEE10insert_mutB*_*)
    *(.text*._RNvMs*_NtCs*_5alloc4syncINtB*_3ArcINtNtCs*_9clj_value4trie4PVecINtNtCs*_4core6option6OptionNtNtB*_5value5ValueEEE8make_mutB*_*)
    *(.text*._RINvNtCs*_4core3ptr9drop_glueINtCs*_8smallvec5DrainANtNtCs*_9clj_value5value5Valuej4_EECs*_8clj_eval*)
    *(.text*._RNvMs*_NtCs*_9clj_value5valueNtB*_6Vector9push_back*)
    *(.text*._RNvXs*_NtCs*_9clj_value3seqNtB*_12IterateValueNtNtB*_9extension14ExtensionValue6as_any*)
    *(.text*._RNvXNtCs*_4core3anyNtNtCs*_9clj_value3seq12IterateValueNtB*_3Any7type_idB*_*)
    *(.text*._RNvMs*_NtCs*_9clj_value3seqNtB*_12IterateValue8seed_opt*)
    *(.text*._RINvNtCs*_4core3ptr9drop_glueNtNtCs*_9clj_value3seq12IterateValueECs*_8clj_eval*)
    *(.text*._RNvMs*_NtCs*_9clj_value5valueNtB*_3Set6insert*)
    *(.text*._RNvXs*_NtCs*_8clj_eval6vm_opsNtB*_4ConjNtB*_3Upd5apply*)
    *(.text*._RNvMs*_NtCs*_5alloc4syncINtB*_3ArcINtNtB*_3vec3VecTmmEEE9drop_slowCs*_9clj_value*)
    *(.text*.rt_n_set_lit)
    *(.text*._RNvMs*_NtCs*_9clj_value5valueNtB*_3Set9with_meta*)
    *(.text*._RNvMs*_NtCs*_5alloc4syncINtB*_3ArcINtNtB*_3vec3VecNtNtCs*_9clj_value5value5ValueEE8make_mutB*_*)
    *(.text*.rt_n_cap_host)
    *(.text*._RNvMs*_NtCs*_5alloc7raw_vecINtB*_6RawVecNtNtCs*_9clj_value4host10HostMethodE8grow_oneCs*_8clj_eval*)
    *(.text*._RNvNtCs*_8clj_eval4seqs13native_repeat*)
    *(.text*._RNvXNtCs*_4core3anyNtNtCs*_9clj_value3seq11RepeatValueNtB*_3Any7type_idB*_*)
    *(.text*._RINvNtCs*_4core3ptr9drop_glueNtNtCs*_9clj_value3seq11RepeatValueECs*_8clj_eval*)
    *(.text*._RNvXs*_NtCs*_9clj_value3seqNtB*_11RepeatValueNtNtB*_9extension14ExtensionValue6as_any*)
    *(.text*._RINvNtCs*_4core3ptr9drop_glueINtNtNtCs*_4rpds3map13hash_trie_map6BucketNtNtCs*_9clj_value5value5ValuejNtNtNtNtCs*_7archery14shared_pointer4kind4arct5ArcTKEEB*_*)
    *(.text*.rt_n_cap_re)
    *(.text*._RINvNtCs*_4core3ptr9drop_glueINtNtCs*_5alloc5boxed3BoxSNtNtCs*_9clj_value5value5ValueEEB*_*)
    *(.text*._RNvMs*_NtCs*_5alloc4syncINtB*_3ArcNtNtCs*_9clj_value5value8SmallMapE9drop_slowB*_*)
    *(.text*._RNvMs*_NtCs*_5alloc7raw_vecINtB*_6RawVecINtNtB*_4sync3ArcINtNtCs*_9clj_value4trie4NodeINtNtCs*_4core6option6OptionNtNtB*_5value5ValueEEEE8grow_oneB*_*)
    *(.text*.rt_n_invoke)
    *(.text*._RNvYNCNvMs*_NtCs*_4rpds4listINtB*_4ListNtNtCs*_9clj_value5value5ValueNtNtNtNtCs*_7archery14shared_pointer4kind4arct5ArcTKE4iter0INtNtNtCs*_4core3ops8function6FnOnceTRINtB*_13SharedPointerB*_B*_EEE9call_onceB*_*)
    *(.text*._RINvNtCs*_4core3ptr9drop_glueNtNtCs*_8clj_eval4core7ReducedEB*_*)
    *(.text*._RNvNtCs*_8clj_eval4lazy11collect_all*)
    *(.text*._RNvMs*_NtCs*_9clj_value3seqNtB*_3Seq5eager*)
    *(.text*._RNvMs*_NtCs*_9clj_value3seqNtB*_3Seq4next*)
    *(.text*._RNvNtCs*_8clj_eval4lazy13step_realized*)
    *(.text*._RNvNtCs*_8clj_eval4lazy14realized_value*)
    *(.text*._RINvMs*_NtCs*_5alloc4syncINtB*_3ArcSNtNtCs*_9clj_value5value5ValueE15from_iter_exactINtNtNtNtCs*_4core4iter8adapters6cloned6ClonedINtNtNtB*_5slice4iter4IterB*_EEECs*_8clj_eval*)
    *(.text*._RNvXs*_NtCs*_9clj_value5valueNtB*_10VectorIterNtNtNtNtCs*_4core4iter6traits8iterator8Iterator9size_hint*)
    *(.text*._RNCNvNtCs*_5cljrt6native7make_fns*_0B*_*)
    *(.text*._RNvNtCs*_5cljrt6native9call_code*)
    *(.text*._RINvNtCs*_4core3ptr9drop_glueTNtNtCs*_9clj_value3seq8RangeNumB*_INtNtB*_6option6OptionxEEECs*_8clj_eval*)
    *(.text*._RNvNtCs*_8clj_eval4core6as_num*)
    *(.text*._RNvNtCs*_8clj_eval4seqs19native_reduce_owned*)
    *(.text*._RNvMNtCs*_8clj_eval5xformNtB*_8Eduction5parts*)
    *(.text*._RNCNvNtCs*_8clj_eval4seqs19native_reduce_owned0B*_*)
    *(.text*._RNvMs*_NtCs*_9clj_value5valueNtB*_6Vector13set_nth_owned*)
    *(.text*._RNvXs*_NtCs*_8clj_eval6vm_opsNtB*_5AssocNtB*_3Upd5apply*)
    *(.text*._RNvNtCs*_8clj_eval14stdlib_natives12native_blank*)
    *(.text*._RINvYNtNtNtCs*_4core3str4iter5CharsNtNtNtNtB*_4iter6traits8iterator8Iterator8try_folduNCINvNvB*_3all5checkcNvNtCs*_8clj_eval8classemu18java_is_whitespaceE0INtNtNtB*_3ops12control_flow11ControlFlowuEEB*_*)
    *(.text*._RNvNtCs*_8clj_eval4seqs17native_mapv_owned*)
    *(.text*._RNvXNtNtCs*_5alloc3vec21spec_from_iter_nestedINtB*_3VecNtNtCs*_9clj_value5value5ValueEINtB*_18SpecFromIterNestedB*_INtCs*_8smallvec5DrainAB*_j4_EE9from_iterCs*_8clj_eval*)
    *(.text*._RINvMNtNtCs*_4rpds3map13hash_trie_mapINtB*_4NodeNtNtCs*_9clj_value5value5ValueB*_NtNtNtNtCs*_7archery14shared_pointer4kind4arct5ArcTKE3getB*_EB*_*)
    *(.text*._RNvXs*_NtCs*_8clj_eval6vm_opsNtB*_9ParseLongNtB*_3Op15apply*)
    *(.text*._RNCINvXs*_NtNtNtCs*_7archery14shared_pointer4kind4arctNtB*_5ArcTKNtB*_17SharedPointerKind8make_mutINtNtNtCs*_4rpds3map13hash_trie_map4NodeNtNtCs*_9clj_value5value5ValuejB*_EE0B*_*)
    *(.text*._RNvNtCs*_8clj_eval4core9nth_index*)
    *(.text*._RNCNvNtCs*_8clj_eval4seqs17native_mapv_owneds*_0B*_*)
    *(.text*._RNvNtCs*_8clj_eval2re10match_text*)
    *(.text*._RNvNtCs*_8clj_eval2re15fast_re_matches*)
    *(.text*.rt_n_op2_re)
    *(.text*._RNvNtCs*_8clj_eval2re12re_matches_2*)
    *(.text*._RNvMs*_NtCs*_5alloc4syncINtB*_3ArcNtNtCs*_9clj_value5value8ListDataE9drop_slowB*_*)
    *(.text*._RINvNtCs*_4core3ptr9drop_glueINtNtCs*_4rpds4list4ListNtNtCs*_9clj_value5value5ValueNtNtNtNtCs*_7archery14shared_pointer4kind4arct5ArcTKEEB*_*)
    *(.text*._RNvMs*_NtCs*_9clj_value5valueNtB*_4List8new_sync*)
    *(.text*._RINvNtCs*_4core3ptr9drop_glueNtNtCs*_8clj_eval4lazy6ForcedEB*_*)
    *(.text*.rt_n_vec_item)
    *(.text*._RNvNtCs*_9clj_value5value7new_map*)
    *(.text*._RNvNtCs*_9clj_value5value17fresh_empty_small*)
    *(.text*._RNvYNCNvNtCs*_9clj_value5value15EMPTY_MAP_SHAPE0INtNtNtCs*_4core3ops8function6FnOnceuE9call_onceB*_*)
    *(.text*._RNvMs*_NtCs*_9clj_value5valueNtB*_3Map3get*)
    *(.text*._RINvXs*_Cs*_8smallvecINtB*_8SmallVecANtNtCs*_9clj_value5value5Valuej4_EINtNtNtNtCs*_4core4iter6traits7collect6ExtendB*_E6extendINtNtNtB*_8adapters6cloned6ClonedINtNtNtB*_5slice4iter4IterB*_EEECs*_8clj_eval*)
    *(.text*._RNvNtCs*_8clj_eval14stdlib_natives11native_trim*)
    *(.text*.rt_n_op2)
    *(.text*._RNvMs*_NtCs*_9clj_value5valueNtB*_6Vector3get.2244*)
    *(.text*._RNvMs*_NtCs*_5alloc4syncINtB*_3ArcNtNtCs*_9clj_value5value7MapDataE8make_mutB*_*)
    *(.text*.rt_n_require_string_lite)
    *(.text*._RNvNtCs*_8clj_eval14stdlib_natives17native_join_owned*)
    *(.text*._RNvNtCs*_8clj_eval14stdlib_natives13fast_join_sep*)
    *(.text*._RINvNtCs*_4core3ptr9drop_glueNtNtCs*_9clj_value5value7MapDataEB*_*)
    *(.text*._RNvMs*_NtCs*_5alloc4syncINtB*_3ArcNtNtCs*_9clj_value5value7MapDataE9drop_slowB*_*)
    *(.text*._RNvNtCs*_8clj_eval4coll6assoc3*)
    *(.text*._RNvMs*_NtCs*_9clj_value4trieINtB*_6PackedNtNtB*_5value5ValueE4pushB*_*)
    *(.text*._RNvNtCs*_8clj_eval4lazy12is_seq_value*)
    *(.text*._RINvNtCs*_4core3ptr9drop_glueNtNtCs*_9clj_value3seq14SubVectorValueECs*_8clj_eval*)
    *(.text*._RNvMs*_NtCs*_9clj_value4trieINtB*_6PackedNtNtB*_5value5ValueE3setB*_*)
    *(.text*._RNvXs*_NtCs*_9clj_value5valueNtB*_10VectorIterNtNtNtNtCs*_4core4iter6traits8iterator8Iterator3nth*)
    *(.text*.rt_n_parse_long)
    *(.text*._RNvMs*_NtCs*_9clj_value5valueNtB*_3Map10insert_mut*)
    *(.text*._RNvXs*_NtCs*_8clj_eval6vm_opsNtB*_5FirstNtB*_3Op15apply*)
    *(.text*._RNvNtCs*_8clj_eval4lazy10first_fast*)
    *(.text*._RNvNtCs*_8clj_eval4lazy16step_range_value*)
    *(.text*._RNvMs*_NtCs*_9clj_value5valueNtB*_3Map6insert*)
    *(.text*._RNvXNtCs*_4core3anyNtNtCs*_9clj_value3seq14SubVectorValueNtB*_3Any7type_idB*_*)
    *(.text*._RNvXs*_NtCs*_9clj_value3seqNtB*_14SubVectorValueNtNtB*_9extension14ExtensionValue6as_any*)
    *(.text*._RNvXs*_NtCs*_4core3fmtReNtB*_7Display3fmtCs*_5cljrt*)
    *(.text*._RNvXs*_NtCs*_8clj_eval6vm_opsNtB*_4RestNtB*_3Upd5apply*)
    *(.text*._RNCINvMs*_NtNtCs*_3std4sync4onceNtB*_4Once15call_once_forceNCNvMNtB*_9lazy_lockINtB*_8LazyLockINtNtCs*_5alloc4sync3ArcINtNtNtNtB*_11collections4hash3map7HashMapNtNtB*_6string6StringB*_EEE5force0E0Cs*_8clj_eval*)
    *(.text*._RNvXs*_NtCs*_5alloc6stringNtB*_6StringNtNtCs*_4core3fmt7Display3fmt*)
    *(.text*._RNvYNCNvNtCs*_8clj_eval4core10native_gtes*_0INtNtNtCs*_4core3ops8function6FnOnceTxxEE9call_onceB*_*)
    *(.text*._RNvNtCs*_8clj_eval4lazy10next_owned*)
    *(.text*._RNvMs*_NtCs*_9clj_value3seqNtB*_11RealizedSeq7advance*)
    *(.text*._RNvXs*_NtCs*_9clj_value3seqNtB*_11RealizedSeqNtNtB*_9extension14ExtensionValue10as_any_mut*)
    *(.text*._RNvNtCs*_8clj_eval4core10take_count*)
    *(.text*._RNvNtCs*_8clj_eval4seqs11native_take*)
    *(.text*._RNvNtCs*_8clj_eval7emucoll13list_snapshot*)
    *(.text*._RNvNtCs*_8clj_eval4lazy11first_value*)
    *(.text*._RNvNtCs*_8clj_eval4lazy10next_value*)
    *(.text*._RNvNtCs*_8clj_eval4lazy11step_filter*)
    *(.text*._RNvNtCs*_8clj_eval4coll8count_of*)
    *(.text*._RINvNtCs*_9clj_value9transient6put_atNtNtB*_5value5ValueECs*_8clj_eval*)
    *(.text*._RINvMs*_NtCs*_5alloc3vecINtB*_3VecNtNtCs*_9clj_value5value5ValueE16extend_desugaredNtB*_10VectorIterECs*_8clj_eval*)
    *(.text*._RNvXNtNtCs*_5alloc3vec21spec_from_iter_nestedINtB*_3VecNtNtCs*_9clj_value5value5ValueEINtB*_18SpecFromIterNestedB*_NtB*_10VectorIterE9from_iterCs*_8clj_eval*)
    *(.text*._RNvMs*_NtCs*_5alloc3vecINtB*_3VecNtNtCs*_9clj_value5value5ValueE11extend_withCs*_8clj_eval*)
    *(.text*._RINvXNtNtCs*_5alloc3vec14spec_from_elemNtNtCs*_9clj_value5value5ValueNtB*_12SpecFromElem9from_elemNtNtB*_5alloc6GlobalECs*_8clj_eval*)
    *(.text*._RNvNtCs*_8clj_eval4coll7subvec3*)
    *(.text*._RNvNtCs*_8clj_eval4coll13native_subvec*)
    *(.text*._RNvNtCs*_8clj_eval4seqs10call_pred1*)
    *(.text*._RNvNtCs*_8clj_eval2ns11set_core_ns*)
    *(.text*.rt_n_ns_lite)
    *(.text*._RINvNtCs*_4core3ptr9drop_glueNtNtCs*_8clj_eval4core3NumEB*_*)
    *(.text*.rt_n_unreduce)
    *(.text*._RNvNtCs*_8clj_eval4coll8conj_one*)
    *(.text*._RNvNtCs*_8clj_eval4coll12assoc_vector*)
    *(.text*._RNvMs*_NtCs*_9clj_value5valueNtB*_3Map4iter*)
    *(.text*._RNvXs*_NtCs*_9clj_value5valueNtB*_7MapIterNtNtNtNtCs*_4core4iter6traits8iterator8Iterator4next*)
    *(.text*._RNvNtCs*_8clj_eval4coll11take_lookup*)
    *(.text*.rt_n_kw)
    *(.text*._RNvNtCs*_8clj_eval2io12native_print*)
    *(.text*._RNvMs*_NtCs*_5alloc4syncINtB*_3ArcNtNtCs*_9clj_value5value8MapShapeE9drop_slowB*_*)
    *(.text*.rt_n_map_lit)
    *(.text*._RNvNtCs*_8clj_eval10native_abi9map_pairs*)
    *(.text*._RNvMs*_NtCs*_9clj_value5valueNtB*_3Map9with_meta*)
    *(.text*._RNvNtCs*_8clj_eval4seqs17native_some_owned*)
    *(.text*._RINvMs*_NtCs*_9hashbrown3rawINtB*_8RawTableTNtNtCs*_5alloc6string6StringTB*_yEEE14reserve_rehashNCINvNtB*_3map11make_hasherB*_B*_INtNtCs*_4core4hash18BuildHasherDefaultNtCs*_10rustc_hash8FxHasherEE0ECs*_8clj_eval*)
    *(.text*._RNvMs*_NtCs*_8clj_eval3envNtB*_9Namespace9add_alias*)
    *(.text*._RINvMs*_NtCs*_9hashbrown3mapINtB*_7HashMapNtNtCs*_5alloc6string6StringTB*_yEINtNtCs*_4core4hash18BuildHasherDefaultNtCs*_10rustc_hash8FxHasherEE3geteECs*_8clj_eval*)
    *(.text*._RNvNtCs*_8clj_eval6macros12native_apply*)
    *(.text*._RNvNtCs*_8clj_eval14stdlib_natives11native_join*)
    *(.text*._RNvNtCs*_8clj_eval14stdlib_natives8join_seq*)
    *(.text*._RNvNtCs*_8clj_eval8classemu13native_static*)
    *(.text*._RNvMs*_NtCs*_9clj_value3seqNtB*_14SubVectorValue5items*)
    *(.text*._RNvXs*_NtCs*_8clj_eval6vm_opsNtB*_5CountNtB*_3Op15apply*)
    *(.text*._RNvNtCs*_8clj_eval13vm_intrinsics8count_of*)
    *(.text*._RNvNtCs*_8clj_eval4lazy15step_entry_unit*)
    *(.text*._RNvXs*_NtCs*_8clj_eval6vm_opsNtB*_3NthNtB*_3Op25apply*)
    *(.text*._RNvMs*_NtCs*_4core3fmtNtB*_9Formatter3pad*)
    *(.text*._RNCINvNtCs*_8clj_eval4seqs11walk_directNCNvB*_17native_some_owneds*_0E0B*_*)
    *(.text*._RINvNtCs*_4core3ptr9drop_glueNtNtCs*_9clj_value9extension9ThrowableECs*_8clj_eval*)
    *(.text*._RNvMs*_NtCs*_8clj_eval4evalNtB*_9Evaluator9throwable*)
    *(.text*._RNvNtCs*_8clj_eval2ns19throwable_to_native*)
    *(.text*._RNvNtCs*_5cljrt6native4fail*)
    *(.text*._RNvNtCs*_5cljrt6native12take_pending*)
    *(.text*._RNvMs*_Cs*_8smallvecINtB*_8SmallVecANtNtCs*_9clj_value5value5Valuej4_E8try_growCs*_5cljrt*)
    *(.text*._RINvNtCs*_4core3ptr9drop_glueINtNtNtCs*_5alloc3vec9into_iter8IntoIterNtNtCs*_9clj_value5value5ValueEEB*_*)
    *(.text*._RNvNtCs*_8clj_eval4coll18native_assoc_owned*)
    *(.text*._RNvNvNtCs*_5alloc3fmt6format12format_inner*)
    *(.text*._RNvXs*_NtCs*_5alloc6stringNtB*_6StringNtNtCs*_4core3fmt5Write9write_str.686*)
    *(.text*._RNvNtCs*_8clj_eval4eval8uncaught*)
    *(.text*._RNvXs*_NtCs*_9clj_value3seqNtB*_13SplitVecValueNtNtB*_9extension14ExtensionValue6as_any*)
    *(.text*._RNvXNtCs*_4core3anyNtNtCs*_9clj_value3seq13SplitVecValueNtB*_3Any7type_idB*_*)
    *(.text*._RNvXs*_NtCs*_4core3fmtReNtB*_7Display3fmtB*_*)
    *(.text*._RNvXs*_NtCs*_8clj_eval8classemuNtB*_13StringBuilderNtNtCs*_9clj_value9extension14ExtensionValue6as_any*)
    *(.text*._RNvNtCs*_8clj_eval4seqs17native_sort_owned*)
    *(.text*._RNvNtCs*_8clj_eval4seqs8cmp_ints*)
    *(.text*._RNvXs*_NtCs*_9clj_value4trieINtB*_4IterINtNtCs*_4core6option6OptionNtNtB*_5value5ValueEENtNtNtNtB*_4iter6traits8iterator8Iterator4nextB*_*)
    *(.text*._RINvNtCs*_4core3ptr9drop_glueNtNtCs*_9clj_value5value7SetDataEB*_*)
    *(.text*._RNvMs*_NtCs*_5alloc4syncINtB*_3ArcINtNtCs*_9clj_value4trie4PVecINtNtCs*_4core6option6OptionNtNtB*_5value5ValueEEE9drop_slowB*_*)
    *(.text*._RNvMs*_NtCs*_5alloc4syncINtB*_3ArcINtNtB*_3vec3VecINtNtCs*_4core6option6OptionNtNtCs*_9clj_value5value5ValueEEE9drop_slowB*_*)
    *(.text*._RNvMs*_NtCs*_8triomphe3arcINtB*_3ArcINtNtNtCs*_4rpds3map13hash_trie_map4NodeNtNtCs*_9clj_value5value5ValuejNtNtNtNtCs*_7archery14shared_pointer4kind4arct5ArcTKEE9drop_slowB*_*)
    *(.text*._RINvNtCs*_4core3ptr9drop_glueINtNtCs*_9clj_value4trie4PVecINtNtB*_6option6OptionNtNtB*_5value5ValueEEEB*_*)
    *(.text*._RINvNtCs*_4core3ptr9drop_glueINtNtCs*_5alloc3vec3VecINtNtCs*_7archery14shared_pointer13SharedPointerINtNtNtCs*_4rpds3map13hash_trie_map4NodeNtNtCs*_9clj_value5value5ValuejNtNtNtB*_4kind4arct5ArcTKEB*_EEEB*_*)
    *(.text*._RNvMs*_NtCs*_8triomphe3arcINtB*_3ArcINtNtNtCs*_4rpds3map5entry5EntryNtNtCs*_9clj_value5value5ValuejEE9drop_slowB*_*)
    *(.text*._RNvMs*_NtCs*_5alloc4syncINtB*_3ArcNtNtCs*_9clj_value5value7SetDataE9drop_slowB*_*)
    *(.text*._RINvNtCs*_4core3ptr9drop_glueINtNtCs*_5alloc3vec3VecINtNtB*_6option6OptionNtNtCs*_9clj_value5value5ValueEEEB*_*)
    *(.text*._RNvMs*_NtCs*_9clj_value5valueNtB*_3Set8contains*)
    *(.text*._RNvXs*_NtCs*_5alloc3vecINtB*_3VecINtNtCs*_4core6option6OptionNtNtCs*_9clj_value5value5ValueEENtNtB*_5clone5Clone5cloneB*_*)
    *(.text*._RNvNtCs*_8clj_eval13vm_intrinsics13contains_test*)
    *(.text*._RNvXs*_NtCs*_8clj_eval6vm_opsNtB*_8ContainsNtB*_3Op25apply*)
    *(.text*._RNvNtCs*_8clj_eval4coll17native_conj_owned*)
    *(.text*._RNvMs*_NtCs*_8clj_eval4evalNtB*_9Evaluator11invoke_args*)
    *(.text*._RNvNtCs*_8clj_eval4coll19native_update_owned*)
    *(.text*._RNvNtCs*_8clj_eval4seqs12call_checked*)
    *(.text*._RNvNtCs*_8clj_eval4core11jvm_compare*)
    *(.text*._RINvNtCs*_4core3ptr9drop_glueINtCs*_12num_rational5RatioNtNtCs*_10num_bigint6bigint6BigIntEECs*_9clj_value*)
    *(.text*._RINvNtCs*_4core3ptr9drop_glueINtCs*_12num_rational5RatioNtNtCs*_10num_bigint6bigint6BigIntEECs*_10clj_reader*)
    *(.text*._RNvNtCs*_8clj_eval4core12num_rational*)
    *(.text*._RNvNtCs*_8clj_eval4core13compare_exact*)
    *(.text*._RNvXs*_Cs*_12num_rationalINtB*_5RatioNtNtCs*_10num_bigint6bigint6BigIntENtNtCs*_4core3cmp3Ord3cmpCs*_9clj_value*)
    *(.text*._RNvNtCs*_8clj_eval4lazy14step_thunk_mid*)
    *(.text*._RNvNtCs*_8clj_eval4lazy10step_items*)
    *(.text*._RNvNtCs*_8clj_eval4coll16native_nth_owned*)
    *(.text*._RNvNtCs*_8clj_eval4lazy10rest_value*)
    *(.text*._RNvNtCs*_8clj_eval4lazy9step_head*)
    *(.text*._RNvNtCs*_8clj_eval4coll18native_count_owned*)
    *(.text*._RNvNtCs*_8clj_eval4seqs13native_filter*)
    *(.text*._RNvNtNtCs*_3std2io5stdio7__eprint*)
    *(.text*._RINvNtCs*_4core3ptr9drop_glueNtNtCs*_9clj_value9extension9ThrowableECs*_5cljrt*)
    *(.text*._RNvYNtNtNtNtCs*_3std3sys5stdio4unix6StderrNtNtNtCs*_4core2io5write5Write9write_allB*_*)
    *(.text*._RNvNtCs*_8clj_eval2ns16source_to_native*)
    *(.text*._RNvMs*_NtCs*_5alloc7raw_vecNtB*_11RawVecInner11finish_growB*_*)
    *(.text*._RNvXNvNtNtCs*_4core2io5write17default_write_fmtINtB*_7AdapterNtNtNtCs*_3std2io5stdio10StderrLockENtNtB*_3fmt5Write9write_strB*_*)
    *(.text*._RNvNtCs*_8clj_eval6script14run_diagnostic*)
    *(.text*._RNvNtCs*_8clj_eval6script9load_site*)
    *(.text*._RINvNvMs*_NtCs*_5alloc7raw_vecINtB*_11RawVecInnerpE7reserve21do_reserve_and_handleNtNtB*_5alloc6GlobalEB*_*)
    *(.text*._RINvNtCs*_4core3ptr9drop_glueNtNtCs*_8clj_eval4eval11SourceErrorECs*_5cljrt*)
    *(.text*._RNvNtCs*_8clj_eval4lazy19step_subvector_unit*)
    *(.text*._RNvNtCs*_8clj_eval4lazy17rest_realized_seq*)
    *(.text*._RNvNtCs*_8clj_eval4lazy12native_first*)
    *(.text*._RNvNtCs*_8clj_eval4lazy8is_idrop*)
    *(.text*._RNvNtCs*_8clj_eval8classemu10static_row*)
    *(.text*._RINvMs*_NtCs*_9hashbrown3rawINtB*_8RawTableTReRNtNtCs*_8clj_eval8classemu9StaticRowEE14reserve_rehashNCINvNtB*_3map11make_hasherB*_B*_INtNtCs*_4core4hash18BuildHasherDefaultNtCs*_10rustc_hash8FxHasherEE0EB*_*)
    *(.text*._RNCINvMs*_NtNtCs*_3std4sync4onceNtB*_4Once15call_once_forceNCINvMNtB*_9once_lockINtB*_8OnceLockINtNtNtNtB*_11collections4hash3map7HashMapReRNtNtCs*_8clj_eval8classemu9StaticRowINtNtCs*_4core4hash18BuildHasherDefaultNtCs*_10rustc_hash8FxHasherEEE10initializeNCINvB*_11get_or_initNCNvB*_10static_row0E0zE0E0B*_*)
    *(.text*._RNvNtCs*_8clj_eval8classemu12static_class*)
    *(.text*._RINvMs*_NtCs*_9hashbrown3rawINtB*_8RawTableTReINtNtCs*_5alloc4sync3ArcNtNtCs*_9clj_value5class8ClassValEEE14reserve_rehashNCINvNtB*_3map11make_hasherB*_B*_NtNtNtCs*_3std4hash6random11RandomStateE0ECs*_8clj_eval*)
    *(.text*._RNvNtCs*_8clj_eval4lazy17step_value_forced*)
    *(.text*._RNvNtCs*_8clj_eval4lazy10chain_tail*)
    *(.text*._RNvNtCs*_8clj_eval4core14native_compare*)
    *(.text*._RINvNtCs*_4core3ptr9drop_glueNtNtCs*_8clj_eval8classemu13StringBuilderEB*_*)
    *(.text*._RNvXNtCs*_4core3anyNtNtCs*_8clj_eval8classemu13StringBuilderNtB*_3Any7type_idB*_*)
    *(.text*._RNvXs*_NtCs*_8clj_eval6vm_opsNtB*_6EmptyPNtB*_3Op15apply*)
    *(.text*._RNvXNtCs*_4core3anyNtNtCs*_8clj_eval8classemu12LocaleHandleNtB*_3Any7type_idB*_*)
    *(.text*._RNvNtCs*_8clj_eval14stdlib_natives15join_vector_buf*)
    *(.text*._RINvNtCs*_4core3ptr9drop_glueNtNtCs*_9clj_value9transient9TransientECs*_8clj_eval*)
    *(.text*._RNvNtCs*_8clj_eval4coll23native_persistent_owned*)
    *(.text*._RNvNtCs*_8clj_eval4coll22native_transient_owned*)
    *(.text*._RNvMs*_NtCs*_9clj_value9transientNtB*_9Transient9with_meta*)
    *(.text*._RNvMs*_NtCs*_5alloc4syncINtB*_3ArcNtNtCs*_9clj_value9transient13TransientLockE9drop_slowB*_*)
    *(.text*._RNvMs*_NtCs*_9clj_value4trieINtB*_6PackedxE8into_vecB*_*)
    *(.text*._RINvNtCs*_4core3ptr9drop_glueINtNtNtCs*_3std4sync9once_lock8OnceLockNtNtCs*_9clj_value3seq14SubVectorValueEEB*_*)
    *(.text*._RINvNtCs*_4core3ptr9drop_glueNtNtCs*_9clj_value3seq13SplitVecValueECs*_8clj_eval*)
    *(.text*._RNvXs*_NtNtCs*_5alloc3vec21spec_from_iter_nestedINtB*_3VecNtNtCs*_9clj_value5value5ValueEINtB*_18SpecFromIterNestedB*_INtNtNtNtCs*_4core4iter8adapters3map3MapINtNtNtB*_5slice4iter4IterTmmEENCNvMs*_NtB*_3seqNtB*_13SplitVecValue4iter0EE9from_iterB*_*)
    *(.text*._RNvMs*_NtCs*_9clj_value3seqNtB*_13SplitVecValue5items*)
    *(.text*.rt_n_op3)
    *(.text*.rt_n_def_begin)
    *(.text*.rt_n_meta_sym)
    *(.text*.rt_n_def_finish)
    *(.text*._RNvMs*_NtCs*_8clj_eval3envNtB*_14SharedRegistry17intern_def_target*)
    *(.text*._RNvMs*_NtCs*_9clj_value6symbolNtB*_6Symbol9with_meta*)
    *(.text*._RNvMs*_NtCs*_8clj_eval3envNtB*_17NamespaceRegistry9intern_in*)
    *(.text*.rt_n_coll)
    *(.text*._RNvXNtNtCs*_5alloc3vec21spec_from_iter_nestedINtB*_3VecNtNtCs*_9clj_value5value5ValueEINtB*_18SpecFromIterNestedB*_NtB*_10VectorIterE9from_iterCs*_5cljrt*)
    *(.text*.rt_n_sym)
    *(.text*._RNvNtCs*_9clj_value6hasheq20seq_hash_unsupported*)
    *(.text*._RNvNtCs*_8clj_eval4core10str_of_one*)
    *(.text*._RNvNtCs*_8clj_eval5types11native_meth*)
    *(.text*._RNvXs*_NtCs*_8clj_eval8classemuNtB*_13StringBuilderNtNtCs*_9clj_value9extension14ExtensionValue8java_str*)
    *(.text*._RNvNtCs*_8clj_eval5types10native_new*)
    *(.text*._RNvMs*_NtCs*_8clj_eval3envNtB*_14SharedRegistry10resolve_in*)
    *(.text*._RNvNtCs*_8clj_eval5types13new_via_class*)
    *(.text*._RNvNtCs*_9clj_value6hasheq14realized_items*)
    *(.text*._RNvNtCs*_8clj_eval5types11lookup_root*)
    *(.text*._RNvNtCs*_8clj_eval4core15is_lazy_seq_str*)
    *(.text*._RNvMs*_NtCs*_8clj_eval3envNtB*_17NamespaceRegistry10resolve_in*)
    *(.text*._RNvNtCs*_8clj_eval5types18new_via_class_core*)
    *(.text*._RNvNtCs*_8clj_eval8classemu17is_class_position*)
    *(.text*._RNvNtCs*_8clj_eval8classemu9parse_nfe*)
    *(.text*._RNCNvNtCs*_8clj_eval4lazy14collect_packed0B*_*)
    *(.text*._RNvMs*_NtCs*_9clj_value5valueNtB*_3Map10with_hashy*)
    *(.text*._RNvXs*_NtCs*_5alloc5boxedINtB*_3BoxSNtNtCs*_9clj_value5value5ValueENtNtCs*_4core5clone5Clone5cloneB*_*)
    *(.text*._RNvNtCs*_8clj_eval4lazy10empty_fast*)
    *(.text*._RNvMs*_NtCs*_9clj_value5valueNtB*_6Vector15from_flat_chars*)
    *(.text*._RNvXs*_NtCs*_8clj_eval8classemuNtB*_12LocaleHandleNtNtCs*_9clj_value9extension14ExtensionValue6as_any*)
    *(.text*._RNvNtCs*_5cljrt6native13call_compiled*)
    *(.text*._RNvNtCs*_8clj_eval4eval9rest_list*)
    *(.text*._RNvNtCs*_8clj_eval6arrays15native_to_array*)
    *(.text*._RNvNtCs*_8clj_eval6arrays14to_array_value*)
    *(.text*._RNvNtCs*_8clj_eval8classemu18static_field_value*)
    *(.text*._RNvXs*_NtNtCs*_5alloc3vec11spec_extendINtB*_3VecNtNtCs*_9clj_value5value5ValueEINtB*_10SpecExtendB*_INtNtB*_9into_iter8IntoIterB*_EE11spec_extendCs*_8clj_eval*)
    *(.text*.rt_n_static_field)
    *(.text*._RNvNtCs*_8clj_eval8classemu17native_static_mid*)
    *(.text*._RNvMs*_NtCs*_9clj_value5arrayNtB*_5Array8snapshot*)
    *(.text*._RNvMs*_NtCs*_5alloc4syncINtB*_3ArcNtNtCs*_9clj_value5array9ArrayDataE9drop_slowB*_*)
    *(.text*._RNvMs*_NtCs*_5alloc4syncINtB*_3ArcINtNtNtNtCs*_3std4sync6poison5mutex5MutexNtNtCs*_9clj_value5array10ArrayStoreEE9drop_slowB*_*)
    *(.text*._RNvMs*_NtCs*_9clj_value5arrayNtB*_5Array3new*)
    *(.text*._RNvMs*_NtCs*_9clj_value5arrayNtB*_5Array3len*)
    *(.text*._RINvNtCs*_4core3ptr9drop_glueNtNtCs*_9clj_value5array10ArrayStoreECs*_8clj_eval*)
    *(.text*._RNvNtCs*_8clj_eval3fmt13round_half_up*)
    *(.text*._RNvNtCs*_8clj_eval3fmt19pad_zero_sign_aware*)
    *(.text*._RNvNtCs*_8clj_eval3fmt8render_f*)
    *(.text*._RNvNtCs*_8clj_eval3fmt16apply_float_sign*)
    *(.text*._RNvNtCs*_8clj_eval3fmt15check_sign_pair*)
    *(.text*._RNvNtCs*_8clj_eval3fmt20check_width_required*)
    *(.text*._RNvNtCs*_8clj_eval3fmt10apply_spec*)
    *(.text*._RNvNtCs*_8clj_eval3fmt14check_mismatch*)
    *(.text*._RNvNtCs*_8clj_eval3fmt13native_format*)
    *(.text*._RNvNtCs*_8clj_eval3fmt10check_spec*)
    *(.text*._RNvNtCs*_8clj_eval3fmt3pad*)
    *(.text*.rt_n_parse_double)
    *(.text*._RNvNtCs*_8clj_eval4core6to_f64*)
    *(.text*._RNvNtCs*_8clj_eval4core10native_add*)
    *(.text*._RNvMs*_NtCs*_8triomphe3arcINtB*_3ArcNtNtCs*_9clj_value5value5ValueE9drop_slowB*_*)
    *(.text*._RNCINvNtCs*_8clj_eval4seqs13walk_sole_mapNCNvB*_19native_reduce_owned0E0B*_*)
    *(.text*._RNvMs*_NtCs*_8clj_eval4evalNtB*_9Evaluator9fast_int2*)
    *(.text*._RNvNtCs*_8clj_eval4core9num_value*)
    *(.text*._RNvNtCs*_8clj_eval4core4fold*)
    *(.text*._RNvNtCs*_8clj_eval4core3add*)
    *(.text*._RNvNtCs*_8clj_eval4core16parse_double_str*)
    *(.text*._RNvMs*_NtCs*_9clj_value5valueNtB*_4List9with_meta*)
    *(.text*._RNvMs*_NtCs*_9clj_value5valueNtB*_4List10drop_first*)
    *(.text*._RNvMs*_NtCs*_9clj_value5valueNtB*_4List10push_front*)
    *(.text*._RNvMs*_NtCs*_9clj_value5valueNtB*_4List8from_vec*)
    *(.text*._RNvNtCs*_8clj_eval4seqs20native_reverse_owned*)
    *(.text*._RNvNtCs*_8clj_eval4core10native_str*)
    *(.text*._RNvMs*_Cs*_8smallvecINtB*_8SmallVecANtNtCs*_9clj_value5value5Valuej4_E8try_growCs*_8clj_eval*)
    *(.text*._RNvNtCs*_8clj_eval4seqs16native_interpose*)
    *(.text*._RNvNtCs*_8clj_eval4seqs13native_concat*)
    *(.text*._RNvNtCs*_8clj_eval4seqs13native_mapcat*)
    *(.text*._RINvNtCs*_4core3ptr9drop_glueINtNtNtNtB*_4iter8adapters3rev3RevINtNtNtCs*_5alloc3vec9into_iter8IntoIterTINtNtB*_4sync3ArcINtB*_3VecNtNtCs*_9clj_value5value5ValueEEjEEEECs*_8clj_eval*)
    *(.text*._RNvMNtCs*_8clj_eval4collNtB*_7KeyStep8from_val*)
    *(.text*._RNvMNtCs*_8clj_eval4collNtB*_7KeyStep4next*)
    *(.text*._RINvNtCs*_4core3ptr9drop_glueNtNtCs*_8clj_eval4coll7KeyStepEB*_*)
    *(.text*._RNvNtCs*_8clj_eval4coll11assoc_in_up*)
    *(.text*._RNvNtCs*_8clj_eval4coll21native_assoc_in_owned*)
    *(.text*._RNvNtCs*_8clj_eval11concurrency12native_deref*)
    *(.text*._RNvNtCs*_8clj_eval11concurrency11native_swap*)
    *(.text*._RNvNtCs*_8clj_eval11concurrency12fire_watches*)
    *(.text*._RNvMNtCs*_9clj_value4atomNtB*_4Atom4lock*)
    *(.text*._RNvNtCs*_8clj_eval11concurrency11native_atom*)
    *(.text*._RNvNtCs*_8clj_eval11concurrency9swap_loop*)
    *(.text*._RNvNtCs*_8clj_eval11concurrency12atom_options*)
    *(.text*._RNvMNtCs*_9clj_value4atomNtB*_4Atom3new*)
    *(.text*._RNvNtCs*_8clj_eval11concurrency13check_swap_fn*)
    *(.text*._RNvMs*_NtCs*_5alloc4syncINtB*_3ArcINtNtNtNtCs*_3std4sync6poison5mutex5MutexNtNtCs*_9clj_value4atom9AtomStateEE9drop_slowB*_*)
    *(.text*._RNvXNtNtCs*_5alloc3vec21spec_from_iter_nestedINtB*_3VecNtNtCs*_9clj_value5value5ValueEINtB*_18SpecFromIterNestedB*_INtNtNtNtCs*_4core4iter8adapters4skip4SkipNtB*_10VectorIterEE9from_iterCs*_8clj_eval*)
    *(.text*._RNvNtCs*_8clj_eval4seqs11native_drop*)
    *(.text*._RNvNtCs*_8clj_eval4lazy10drop_value*)
    *(.text*._RNvNtCs*_8clj_eval4core12idrop_coerce*)
    *(.text*._RNvNtCs*_8clj_eval4lazy11idrop_shift*)
    *(.text*._RNvMs*_NtCs*_5alloc4syncINtB*_3ArcSIB*_SNtNtCs*_9clj_value5value5ValueEE9drop_slowB*_*)
    *(.text*._RNvNtCs*_8clj_eval4coll17native_into_owned*)
    *(.text*._RNvNtCs*_8clj_eval4coll10into_inner*)
    *(.text*._RNvXs*_NtCs*_8clj_eval6vm_opsNtB*_3PopNtB*_3Upd5apply*)
    *(.text*._RNvMs*_NtCs*_9clj_value5valueNtB*_6Vector15drop_last_owned*)
    *(.text*._RNvNtCs*_8clj_eval4core6minmax*)
    *(.text*._RNvNtCs*_8clj_eval4coll12native_assoc*)
    *(.text*._RNvNtCs*_8clj_eval4lazy22realize_deep_extension*)
    *(.text*._RNvNtCs*_8clj_eval8classemu16static_call_long*)
    *(.text*._RNvXs*_NtCs*_5alloc6stringNtB*_6StringNtNtCs*_4core3fmt5Write10write_char*)
    *(.text*._RNvNtCs*_6clj_bc3ops10coll_count*)
    *(.text*._RNvNtCs*_8clj_eval4coll13native_second*)
    *(.text*._RNvNtCs*_8clj_eval4core10native_nil*)
    *(.text*._RNvXs*_NtNtNtCs*_4core4iter8adapters6clonedINtB*_6ClonedINtNtB*_7flatten7FlattenINtNtCs*_9clj_value4trie4IterINtNtB*_6option6OptionNtNtB*_5value5ValueEEEENtNtNtB*_6traits8iterator8Iterator4nextCs*_10clj_reader*)
    *(.text*._RNvNtCs*_8clj_eval4lazy15native_for_keep*)
    *(.text*._RINvNtCs*_4core3ptr9drop_glueNCNCNvNtCs*_8clj_eval4seqs20native_sort_by_owned00EB*_*)
    *(.text*._RNvNtCs*_8clj_eval4seqs20native_sort_by_owned*)
    *(.text*._RNCINvMNtCs*_5alloc5sliceSNtNtCs*_9clj_value5value5Value7sort_byNCINvNtCs*_8clj_eval4seqs15sort_by_checkedNCNvB*_20native_sort_by_owned0E0E0B*_*)
    *(.text*._RNvNtCs*_8clj_eval4core15compare_vectors*)
    *(.text*._RNvNtCs*_8clj_eval4eval10nth_or_nil*)
    *(.text*.rt_n_nth_nil)
    *(.text*._RNvNtCs*_8clj_eval4lazy13rest_memoized*)
    *(.text*._RNvNtCs*_8clj_eval13vm_intrinsics6get_of*)
    *(.text*._RNvMs*_NtCs*_9hashbrown3rawINtB*_8RawTableTINtNtCs*_5alloc3vec3VecNtNtCs*_9clj_value5value5ValueEINtNtB*_4sync4WeakNtB*_8MapShapeEEE5eraseB*_*)
    *(.text*._RNvNtCs*_8clj_eval4lazy13is_always_seq*)
    *(.text*._RNvMs*_NtCs*_9clj_value5valueNtB*_3Map8is_empty*)
    *(.text*._RNvXNtNtCs*_5alloc3vec21spec_from_iter_nestedINtB*_3VeccEINtB*_18SpecFromIterNestedcNtNtNtCs*_4core3str4iter5CharsE9from_iterCs*_8clj_eval*)
    *(.text*._RNvNtCs*_8clj_eval4eval6lookup*)
    *(.text*._RNvMs*_NtNtCs*_4core3str4iterINtB*_13SplitInternalcE9next_backCs*_8clj_eval*)
    *(.text*._RNvXNtCs*_4core3anyNtNtCs*_9clj_value3seq9ConsValueNtB*_3Any7type_idB*_*)
    *(.text*._RNvNtCs*_8clj_eval8classemu13surface_gated*)
    *(.text*._RNvNtCs*_8clj_eval4core10native_int*)
    *(.text*._RNvNtCs*_8clj_eval4core14int_cast_value*)
    *(.text*._RINvYNtNtNtCs*_3std4hash6random11RandomStateNtNtCs*_4core4hash11BuildHasher8hash_oneRNtNtCs*_5alloc6string6StringECs*_8clj_eval*)
    *(.text*._RINvMNtNtCs*_3std4sync9once_lockINtB*_8OnceLockINtNtNtNtB*_11collections4hash3map7HashMapReRNtNtCs*_8clj_eval8classemu9StaticRowINtNtCs*_4core4hash18BuildHasherDefaultNtCs*_10rustc_hash8FxHasherEEE10initializeNCINvB*_11get_or_initNCNvB*_10static_row0E0zEB*_*)
    *(.text*._RNCINvMs*_NtNtCs*_3std4sync4onceNtB*_4Once15call_once_forceNCINvMNtB*_9once_lockINtB*_8OnceLockINtNtNtB*_6poison5mutex5MutexINtNtNtNtB*_11collections4hash3map7HashMapReINtNtCs*_5alloc4sync3ArcINtNtB*_3set7HashSetB*_EEEEE10initializeNCINvB*_11get_or_initNvYB*_NtNtCs*_4core7default7Default7defaultE0zE0E0Cs*_8clj_eval*)
    *(.text*._RNvNtCs*_8clj_eval8classemu14class_for_name*)
    *(.text*._RNCINvMNtNtCs*_3std4sync9once_lockINtB*_8OnceLockINtNtNtNtB*_11collections4hash3map7HashMapReRNtNtCs*_8clj_eval8classemu9StaticRowINtNtCs*_4core4hash18BuildHasherDefaultNtCs*_10rustc_hash8FxHasherEEE10initializeNCINvB*_11get_or_initNCNvB*_10static_row0E0zE0B*_*)
    *(.text*._RINvMNtNtCs*_3std4sync9once_lockINtB*_8OnceLockINtNtNtB*_6poison5mutex5MutexINtNtNtNtB*_11collections4hash3map7HashMapReINtNtCs*_5alloc4sync3ArcNtNtCs*_9clj_value5class8ClassValEEEE10initializeNCINvB*_11get_or_initNvYB*_NtNtCs*_4core7default7Default7defaultE0zECs*_8clj_eval*)
    *(.text*.rt_n_class)
    *(.text*._RNvNtCs*_8clj_eval6arrays19primitive_base_type*)
    *(.text*.rt_n_declare)
    *(.text*._RINvNtCs*_4core3ptr9drop_glueINtNtCs*_5alloc3vec3VecNtNtCs*_9clj_value6symbol6SymbolEECs*_5cljrt*)
    *(.text*._RNvNtCs*_8clj_eval8classemu11str_int_arg*)
    *(.text*._RINvNtCs*_6clj_bc3ops13write_val_refINtNtNtCs*_4core3mem12maybe_uninit11MaybeUninitNtNtCs*_9clj_value5value5ValueEEB*_*)
    *(.text*._RINvNtNtCs*_4core4iter8adapters11try_processINtNtB*_3map3MapINtNtNtB*_3ops5range5RangexENCNvNtCs*_8clj_eval4lazy14collect_directs*_0ExINtNtB*_6option6OptionzENCINvXs*_B*_IB*_INtNtCs*_5alloc3vec3VecxEEINtNtNtB*_6traits7collect12FromIteratorIB*_xEE9from_iterB*_E0B*_EB*_*)
    *(.text*._RINvNtCs*_4core3ptr9drop_glueINtNtCs*_5alloc3vec3VecNtNtCs*_9clj_value5value6VectorEECs*_8clj_eval*)
    *(.text*._RNvNtCs*_8clj_eval4core10native_mul*)
    *(.text*._RNvNtCs*_8clj_eval4core10native_max*)
    *(.text*._RNvXNtCs*_4core3anyNtNtCs*_9clj_value3seq11KeySeqValueNtB*_3Any7type_idB*_*)
    *(.text*._RNvNtCs*_8clj_eval4seqs20native_every_p_owned*)
    *(.text*._RNCINvNtCs*_8clj_eval4seqs11walk_directNCNvB*_20native_every_p_owned0E0B*_*)
    *(.text*._RNvMs*_NtCs*_8clj_eval4evalNtB*_9Evaluator10invoke_map*)
    *(.text*._RNvNtCs*_8clj_eval4seqs17native_drop_while*)
    *(.text*._RNvNtCs*_8clj_eval4seqs16native_partition*)
    *(.text*._RNvNtCs*_8clj_eval4lazy11lazy_window*)
    *(.text*._RNvNtCs*_8clj_eval4lazy11window_full*)
    *(.text*._RNvNtCs*_8clj_eval4lazy14partition_next*)
    *(.text*._RNvNtCs*_8clj_eval4coll10native_nth*)
    *(.text*._RNvNtCs*_8clj_eval4seqs13native_remove*)
    *(.text*._RNvNtCs*_8clj_eval4lazy16step_map_indexed*)
    *(.text*._RNvNtCs*_8clj_eval4seqs18native_map_indexed*)
    *(.text*._RNvNtCs*_9clj_value5value9seq_items*)
    *(.text*._RNvNtCs*_9clj_value5value12port_pair_eq*)
    *(.text*._RNvNtCs*_8clj_eval4coll14lookup_present*)
    *(.text*._RNvNtCs*_8clj_eval4lazy10equiv_vals*)
    *(.text*._RNvNtCs*_8clj_eval4lazy13is_sequential*)
    *(.text*._RNvNtCs*_8clj_eval4core9native_eq*)
    *(.text*._RNvXs*_NtCs*_8clj_eval6vm_opsNtB*_2EqNtB*_3Op25apply*)
    *(.text*._RNvNtCs*_8clj_eval4coll11native_conj*)
    *(.text*._RNvNtCs*_8clj_eval4seqs11native_fnil*)
    *(.text*._RNCNvNtCs*_8clj_eval4seqs11native_fnil0B*_*)
    *(.text*._RINvNtCs*_4core3ptr9drop_glueNCNvNtCs*_8clj_eval4seqs11native_fnil0EB*_*)
    *(.text*._RINvNtCs*_4core3ptr9drop_glueINtNtCs*_5alloc5boxed3BoxNtNtCs*_9clj_value5value5ValueEEB*_*)
    *(.text*._RNvNtCs*_9clj_value5value9map_entry*)
    *(.text*._RINvNtCs*_4core3ptr9drop_glueINtNtCs*_5alloc5boxed3BoxNtNtCs*_9clj_value5value5ValueEECs*_8clj_eval*)
    *(.text*._RNvNtCs*_8clj_eval4lazy7seq_map*)
    *(.text*._RNvXNtNtCs*_5alloc3vec21spec_from_iter_nestedINtB*_3VecNtNtCs*_9clj_value5value5ValueEINtB*_18SpecFromIterNestedB*_INtNtNtNtCs*_4core4iter8adapters6cloned6ClonedINtNtB*_7flatten7FlattenINtNtB*_4trie4IterINtNtB*_6option6OptionB*_EEEEE9from_iterCs*_8clj_eval*)
    *(.text*._RNvNtCs*_8clj_eval4coll16native_set_owned*)
    *(.text*._RNvNtCs*_8clj_eval4coll13native_get_in*)
    *(.text*._RNvNtCs*_8clj_eval4lazy10keys_thunk*)
    *(.text*._RNvNtCs*_8clj_eval4lazy10keys_empty*)
    *(.text*._RINvNtCs*_4core3ptr9drop_glueINtNtCs*_5alloc5boxed3BoxNtNtCs*_9clj_value5value5ValueEECs*_5cljrt*)
    *(.text*._RNvXs*_NtCs*_8clj_eval6vm_opsNtB*_4NextNtB*_3Upd5apply*)
    *(.text*._RNvNtCs*_8clj_eval4seqs18native_dorun_owned*)
    *(.text*._RNvNtCs*_8clj_eval4lazy14step_keys_unit*)
    *(.text*._RNvNtCs*_8clj_eval4coll10native_get*)
    *(.text*._RNvNtCs*_8clj_eval4core7inc_one*)
    *(.text*._RNvNtCs*_8clj_eval4core10native_inc*)
    *(.text*._RNvMNtNtNtCs*_4rpds3map13hash_trie_map18sparse_array_usizeINtB*_16SparseArrayUsizeINtNtCs*_7archery14shared_pointer13SharedPointerINtB*_4NodeNtNtCs*_9clj_value5value5ValuejNtNtNtB*_4kind4arct5ArcTKEB*_EE6removeB*_*)
    *(.text*._RNvMs*_NtCs*_9clj_value4trieINtB*_4PVecINtNtCs*_4core6option6OptionNtNtB*_5value5ValueEE7set_mutB*_*)
    *(.text*._RINvMs*_NtNtCs*_4rpds3map13hash_trie_mapINtB*_11HashTrieMapNtNtCs*_9clj_value5value5ValuejNtNtNtNtCs*_7archery14shared_pointer4kind4arct5ArcTKINtNtCs*_4core4hash18BuildHasherDefaultNtCs*_10rustc_hash8FxHasherEE10remove_mutB*_EB*_*)
    *(.text*._RNvMNtNtCs*_4rpds3map13hash_trie_mapINtB*_4NodeNtNtCs*_9clj_value5value5ValuejNtNtNtNtCs*_7archery14shared_pointer4kind4arct5ArcTKE8compressB*_*)
    *(.text*._RNvNtCs*_8clj_eval4coll11native_disj*)
    *(.text*._RINvMNtNtCs*_4rpds3map13hash_trie_mapINtB*_4NodeNtNtCs*_9clj_value5value5ValuejNtNtNtNtCs*_7archery14shared_pointer4kind4arct5ArcTKE6removeB*_EB*_*)
    *(.text*._RNvMs*_NtCs*_9clj_value5valueNtB*_7SetData7compact*)
    *(.text*._RNvXNtNtCs*_5alloc3vec21spec_from_iter_nestedINtB*_3VecNtNtCs*_9clj_value5value5ValueEINtB*_18SpecFromIterNestedB*_INtNtNtNtCs*_4core4iter8adapters6cloned6ClonedINtNtB*_7flatten7FlattenINtNtB*_4trie4IterINtNtB*_6option6OptionB*_EEEEE9from_iterB*_*)
    *(.text*._RNvNtCs*_8clj_eval4coll17compare_sort_keys*)
    *(.text*._RINvNtCs*_4core3ptr9drop_glueINtNtCs*_5alloc5boxed3BoxNtNtCs*_9clj_value5value8SortSpecEEB*_*)
    *(.text*._RNvNtCs*_8clj_eval4coll12set_position*)
    *(.text*._RNvNtCs*_8clj_eval4coll15sorted_set_from*)
    *(.text*._RNvNtCs*_8clj_eval4coll15sorted_conj_set*)
    *(.text*._RNvMs*_NtCs*_9clj_value5valueNtB*_3Set9with_sort*)
    *(.text*._RNvMs*_NtCs*_9clj_value5valueNtB*_3Set13sorted_member*)
    *(.text*._RNvNtCs*_8clj_eval4core10native_min*)
    *(.text*._RINvNtCs*_6clj_bc3ops8nth_fastINtNtNtCs*_4core3mem12maybe_uninit11MaybeUninitNtNtCs*_9clj_value5value5ValueEEB*_*)
    *(.text*._RNvNtCs*_8clj_eval4coll17native_sorted_set*)
    *(.text*._RNvNtCs*_8clj_eval6macros13native_vector*)
    *(.text*._RNvXs*_NtNtCs*_5alloc3vec21spec_from_iter_nestedINtB*_3VecjEINtB*_18SpecFromIterNestedjINtNtNtCs*_4core3ops5range5RangejEE9from_iterCs*_8clj_eval*)
    *(.text*._RNvNtCs*_8clj_eval4seqs7permute*)
    *(.text*._RNvNtCs*_8clj_eval4lazy11filter_pred*)
    *(.text*._RNvNtCs*_8clj_eval4core11native_subs*)
    *(.text*._RNvMs*_NtCs*_9clj_value3seqNtB*_14SubVectorValue9with_meta*)
    *(.text*._RNCINvMs*_NtNtCs*_3std4sync4onceNtB*_4Once15call_once_forceNCINvMNtB*_9once_lockINtB*_8OnceLockNtNtCs*_9clj_value3seq14SubVectorValueE10initializeNCINvB*_11get_or_initNCNvMs*_B*_NtB*_13SplitVecValue4view0E0zE0E0B*_*)
    *(.text*.rt_n_try)
    *(.text*._RINvNtCs*_4core3ptr9drop_glueINtNtCs*_5alloc3vec3VecTNtNtB*_6string6StringNtNtCs*_9clj_value5value5ValueEEECs*_5cljrt*)
    *(.text*.rt_n_parse_int)
    *(.text*._RNvXs*_NtCs*_8clj_eval6vm_opsNtB*_8ConjBangNtB*_3Op25apply*)
    *(.text*._RNvMs*_NtCs*_9clj_value3seqNtB*_13SplitVecValue9piece_str*)
    *(.text*._RNvNtCs*_8clj_eval4coll15native_contains*)
    *(.text*._RNvNtCs*_8clj_eval6vm_ops18assoc_conj_in_cell*)
    *(.text*._RNvXs*_NtCs*_8clj_eval6vm_opsNtB*_3GetNtB*_3Op25apply*)
    *(.text*.rt_n_assoc_conj)
    *(.text*._RNvXs*_NtCs*_8clj_eval6vm_opsNtB*_8LongCastNtB*_3Op15apply*)
    *(.text*._RNvNtCs*_8clj_eval4core11native_long*)
    *(.text*._RNvMs*_NtCs*_9clj_value5valueNtB*_3Set17without_sorted_at*)
    *(.text*._RINvNtCs*_4core3ptr9drop_glueINtNtNtCs*_4rpds3map13hash_trie_map6BucketNtNtCs*_9clj_value5value5ValueB*_NtNtNtNtCs*_7archery14shared_pointer4kind4arct5ArcTKEEB*_*)
    *(.text*._RNvXs*_NtCs*_9clj_value3seqNtB*_11KeySeqValueNtNtB*_9extension14ExtensionValue6as_any*)
    *(.text*._RNvXs*_NtCs*_9clj_value3seqNtB*_11ValSeqValueNtNtB*_9extension14ExtensionValue6as_any*)
    *(.text*._RNvYNCNvNtCs*_8clj_eval4core9native_gts*_0INtNtNtCs*_4core3ops8function6FnOnceTxxEE9call_onceB*_*)
    *(.text*._RINvNtNtCs*_4core4iter8adapters11try_processINtNtB*_3map3MapINtNtNtB*_5slice4iter4IterNtNtCs*_9clj_value5value5ValueENCNvNtCs*_8clj_eval4lazy14sole_map_partss*_0ENtB*_6VectorINtNtB*_6option6OptionzENCINvXs*_B*_IB*_INtNtCs*_5alloc3vec3VecB*_EEINtNtNtB*_6traits7collect12FromIteratorIB*_B*_EE9from_iterB*_E0B*_EB*_*)
    *(.text*._RNvNtCs*_8clj_eval4core3mul*)
    *(.text*._RNvNtCs*_8clj_eval6arrays17native_into_array*)
    *(.text*._RNvXs*_NtCs*_8clj_eval4coreNtB*_3NumNtNtCs*_4core5clone5Clone5clone*)
    *(.text*._RNvNtCs*_8clj_eval4core10native_sub*)
    *(.text*._RNvNtCs*_8clj_eval4core3sub*)
    *(.text*._RNvXs*_NtCs*_8clj_eval6vm_opsNtB*_4Get3NtB*_3Op35apply*)
    *(.text*._RNvMNtNtCs*_4rpds3map13hash_trie_mapINtB*_4NodeNtNtCs*_9clj_value5value5ValueB*_NtNtNtNtCs*_7archery14shared_pointer4kind4arct5ArcTKE6insertB*_*)
    *(.text*._RNvMs*_NtNtCs*_4rpds3map13hash_trie_mapINtB*_11HashTrieMapNtNtCs*_9clj_value5value5ValueB*_NtNtNtNtCs*_7archery14shared_pointer4kind4arct5ArcTKINtNtCs*_4core4hash18BuildHasherDefaultNtCs*_10rustc_hash8FxHasherEE10insert_mutB*_*)
    *(.text*._RNvMs*_NtCs*_9clj_value5valueNtB*_3Map8trie_mut*)
    *(.text*._RINvNtCs*_4core3ptr9drop_glueINtNtCs*_8triomphe3arc8ArcInnerINtNtNtCs*_4rpds3map5entry5EntryNtNtCs*_9clj_value5value5ValueB*_EEEB*_*)
    *(.text*._RNvMs*_NtCs*_8triomphe3arcINtB*_3ArcINtNtNtCs*_4rpds3map5entry5EntryNtNtCs*_9clj_value5value5ValueB*_EE9drop_slowB*_*)
    *(.text*._RNvMs*_NtCs*_5alloc4syncINtB*_3ArcINtNtNtCs*_4rpds3map13hash_trie_map11HashTrieMapNtNtCs*_9clj_value5value5ValueB*_NtNtNtNtCs*_7archery14shared_pointer4kind4arct5ArcTKINtNtCs*_4core4hash18BuildHasherDefaultNtCs*_10rustc_hash8FxHasherEEE9drop_slowB*_*)
    *(.text*._RINvNtCs*_4core3ptr9drop_glueINtNtCs*_5alloc3vec3VecINtNtCs*_7archery14shared_pointer13SharedPointerINtNtNtCs*_4rpds3map13hash_trie_map4NodeNtNtCs*_9clj_value5value5ValueB*_NtNtNtB*_4kind4arct5ArcTKEB*_EEEB*_*)
    *(.text*._RNvMs*_NtCs*_8triomphe3arcINtB*_3ArcINtNtNtCs*_4rpds3map13hash_trie_map4NodeNtNtCs*_9clj_value5value5ValueB*_NtNtNtNtCs*_7archery14shared_pointer4kind4arct5ArcTKEE9drop_slowB*_*)
    *(.text*._RINvNtCs*_4core3ptr9drop_glueNtNtCs*_9clj_value4trie4PVecEB*_*)
    *(.text*._RNvMs*_NtNtCs*_4rpds3map13hash_trie_mapINtB*_6BucketNtNtCs*_9clj_value5value5ValueB*_NtNtNtNtCs*_7archery14shared_pointer4kind4arct5ArcTKE6insertB*_*)
    *(.text*._RINvNtCs*_4core3ptr9drop_glueINtNtNtNtB*_4iter8adapters3zip3ZipINtNtNtCs*_5alloc3vec9into_iter8IntoIterNtNtCs*_9clj_value5value5ValueEB*_EEB*_*)
    *(.text*._RNvNtCs*_8clj_eval13vm_intrinsics6nth_of*)
    *(.text*._RINvNtCs*_4core3ptr9drop_glueNtNtCs*_8clj_eval4eval7SubMapsEB*_*)
    *(.text*._RINvNtCs*_4core3ptr9drop_glueNtNtCs*_8clj_eval4expr7PatternEB*_*)
    *(.text*._RNvNtCs*_8clj_eval10native_abi9dec_items*)
    *(.text*.rt_n_destructure)
    *(.text*._RINvNtCs*_4core3ptr9drop_glueNtNtCs*_8clj_eval4eval10OutletValsEB*_*)
    *(.text*._RNvNtCs*_8clj_eval10native_abi7dec_str*)
    *(.text*._RNvMs*_NtCs*_8clj_eval4evalNtB*_9Evaluator10seq_to_map*)
    *(.text*._RNvMs*_NtCs*_8clj_eval4evalNtB*_9Evaluator11map_binding*)
    *(.text*._RINvMs*_NtCs*_9hashbrown3rawINtB*_8RawTableTReRNtNtCs*_9clj_value5value5ValueEE14reserve_rehashNCINvNtB*_3map11make_hasherB*_B*_NtNtNtCs*_3std4hash6random11RandomStateE0ECs*_8clj_eval*)
    *(.text*._RINvNtCs*_4core3ptr9drop_glueINtNtNtCs*_5alloc3vec9into_iter8IntoIterNtNtCs*_9clj_value5value5ValueEECs*_5cljrt*)
    *(.text*._RNvMs*_NtCs*_9hashbrown3mapINtB*_7HashMapReRNtNtCs*_9clj_value5value5ValueNtNtNtCs*_3std4hash6random11RandomStateE6insertCs*_8clj_eval*)
    *(.text*._RNvNtCs*_8clj_eval10native_abi11dec_pattern*)
    *(.text*._RNvYNCNvNtCs*_8clj_eval3env11EMPTY_FRAME0INtNtNtCs*_4core3ops8function6FnOnceuE9call_onceB*_*)
    *(.text*._RINvNtCs*_4core3ptr9drop_glueINtNtCs*_5alloc3vec3VecTNtNtCs*_9clj_value5value5ValueNtNtCs*_8clj_eval4expr4ExprEEEB*_*)
    *(.text*._RNvMs*_NtCs*_8clj_eval4evalNtB*_9Evaluator11destructure*)
    *(.text*._RINvNtCs*_4core3ptr9drop_glueINtNtCs*_5alloc3vec3VecNtNtCs*_8clj_eval4expr10KeyBindingEEB*_*)
    *(.text*._RINvNtCs*_4core3ptr9drop_glueINtNtCs*_5alloc3vec3VecTNtNtCs*_8clj_eval4expr7PatternNtNtCs*_9clj_value5value5ValueB*_bEEEB*_*)
    *(.text*._RNvMs*_NtCs*_8clj_eval4evalNtB*_9Evaluator8bind_map*)
    *(.text*._RNvMs*_NtCs*_9clj_value5valueNtB*_3Set7without*)
    *(.text*._RNvNtCs*_9clj_value5value8slots_of*)
    *(.text*._RNvMs*_NtCs*_5alloc7raw_vecINtB*_6RawVeccE8grow_oneCs*_12regex_syntax*)
    *(.text*._RNvNtCs*_8clj_eval4core14native_numberp*)
    *(.text*._RNCNvNtCs*_8clj_eval4seqs21native_run_bang_owned0B*_*)
    *(.text*._RNvNtCs*_8clj_eval4seqs15native_run_bang*)
    *(.text*._RNvNtCs*_8clj_eval4seqs21native_run_bang_owned*)
    *(.text*._RNCNvNtCs*_8clj_eval5xform17into_transient_rf0B*_*)
    *(.text*._RNvNtCs*_8clj_eval4coll16native_transient*)
    *(.text*._RNvNtCs*_8clj_eval4coll17native_persistent*)
    *(.text*._RNvNtCs*_8clj_eval5xform14transduce_into*)
    *(.text*._RNvNtCs*_8clj_eval5xform14map_step_value*)
    *(.text*._RNCNvNtCs*_8clj_eval5xform14map_step_value0B*_*)
    *(.text*._RNvNtCs*_8clj_eval10native_abi4nary*)
    *(.text*._RNvXs*_NtCs*_8clj_eval6vm_opsNtB*_3AddNtB*_3Op25apply*)
    *(.text*._RNCINvNtCs*_8clj_eval4seqs13walk_sole_mapNCNvNtB*_4coll10into_inner0E0B*_*)
    *(.text*._RNvNtCs*_8clj_eval4coll13conj_map_into*)
    *(.text*._RNvNtCs*_8clj_eval4coll13map_conj_plan*)
    *(.text*._RNvNtCs*_8clj_eval4lazy13step_map_unit*)
    *(.text*._RINvNtCs*_4core3ptr9drop_glueNtNtCs*_9clj_value3seq11KeySeqValueECs*_8clj_eval*)
    *(.text*._RNvNtCs*_8clj_eval4seqs11native_keys*)
    *(.text*._RNvNtCs*_8clj_eval4core14native_boolean*)
    *(.text*.rt_bc_1_first)
    *(.text*._RNvXNtCs*_4core3anyNtNtCs*_9clj_value3seq11ValSeqValueNtB*_3Any7type_idB*_*)
    *(.text*._RNvNtCs*_8clj_eval4coll15native_assoc_in*)
    *(.text*._RNvNtCs*_8clj_eval11concurrency12native_reset*)
    *(.text*._RNvMs*_NtCs*_5alloc4syncINtB*_3ArcINtNtNtNtCs*_3std11collections4hash3map7HashMapNtNtB*_6string6StringB*_EE9drop_slowCs*_10clj_reader*)
    *(.text*._RINvNtCs*_4core3ptr9drop_glueNtNtCs*_9clj_value5value5ValueECs*_10clj_reader*)
    *(.text*._RINvNtCs*_4core3ptr9drop_glueNtCs*_10clj_reader6ReaderEB*_*)
    *(.text*._RINvNtCs*_4core3ptr9drop_glueINtNtB*_6option6OptionINtNtNtNtCs*_3std11collections4hash3map7HashMapNtNtCs*_9clj_value6symbol6SymbolB*_EEECs*_10clj_reader*)
    *(.text*._RNvNtCs*_10clj_reader6symbol10name_valid*)
    *(.text*._RNvXs*_NtCs*_9clj_value5valueNtB*_5ValueNtNtCs*_4core5clone5Clone5clone.2075*)
    *(.text*._RINvNtCs*_4core3ptr9drop_glueINtNtNtNtCs*_3std11collections4hash3set7HashSetNtNtCs*_9clj_value6symbol6SymbolEECs*_10clj_reader*)
    *(.text*._RNvMs*_NtCs*_9clj_value5valueNtB*_3Map16from_kvs_checked*)
    *(.text*._RINvNtCs*_4core3ptr9drop_glueINtNtNtNtCs*_3std11collections4hash3map7HashMapNtNtCs*_5alloc6string6StringTB*_B*_EEECs*_10clj_reader*)
    *(.text*._RNvMNtCs*_10clj_reader8dispatchNtB*_6Reader12nsmap_reader*)
    *(.text*._RINvNtCs*_4core3ptr9drop_glueINtNtNtCs*_5alloc3vec9into_iter8IntoIterTNtNtCs*_9clj_value5value5ValueB*_EEECs*_10clj_reader*)
    *(.text*._RNvMs*_NtCs*_5alloc7raw_vecNtB*_11RawVecInner11finish_growCs*_10clj_reader*)
    *(.text*._RINvNtCs*_4core3ptr9drop_glueTINtNtCs*_5alloc4sync3ArceEB*_EECs*_9clj_value*)
    *(.text*._RNvMNtCs*_10clj_reader8metaformNtB*_6Reader11meta_reader*)
    *(.text*._RNvMs*_NtCs*_9clj_value6symbolNtB*_6Symbol6intern*)
    *(.text*._RINvYINtNtCs*_4core4hash18BuildHasherDefaultNtCs*_10rustc_hash8FxHasherENtB*_11BuildHasher8hash_oneRTINtNtCs*_5alloc4sync3ArceEB*_EECs*_9clj_value*)
    *(.text*._RINvNtCs*_4core3ptr9drop_glueINtNtNtCs*_5alloc11collections9vec_deque8VecDequeNtNtCs*_9clj_value5value5ValueEECs*_8clj_eval*)
    *(.text*._RINvNtCs*_4core3ptr9drop_glueINtNtCs*_5alloc3vec3VecNtCs*_10clj_reader8FiredTagEEB*_*)
    *(.text*._RNvMNtCs*_10clj_reader4collNtB*_6Reader14read_delimited*)
    *(.text*._RNvNtCs*_10clj_reader6symbol10read_token*)
    *(.text*._RNvMNtCs*_10clj_reader8dispatchNtB*_6Reader7skip_ws*)
    *(.text*._RINvNtCs*_4core3ptr9drop_glueINtNtNtNtCs*_3std11collections4hash3set7HashSetNtNtCs*_9clj_value7keyword7KeywordEECs*_10clj_reader*)
    *(.text*._RNvMCs*_10clj_readerNtB*_6Reader10read_inner*)
    *(.text*._RNvNtCs*_10clj_reader6symbol12match_symbol*)
    *(.text*._RNvMNtCs*_10clj_reader4collNtB*_6Reader11checked_map*)
    *(.text*._RINvNvMs*_NtCs*_5alloc7raw_vecINtB*_11RawVecInnerpE7reserve21do_reserve_and_handleNtNtB*_5alloc6GlobalECs*_10clj_reader*)
    *(.text*._RINvMs*_NtCs*_9hashbrown3rawINtB*_8RawTableTTINtNtCs*_5alloc4sync3ArceEB*_EIB*_NtNtCs*_9clj_value7keyword11KeywordDataEEE14reserve_rehashNCINvNtB*_3map11make_hasherB*_B*_INtNtCs*_4core4hash18BuildHasherDefaultNtCs*_10rustc_hash8FxHasherEE0EB*_*)
    *(.text*.rt_n_read)
    *(.text*._RNvNtCs*_10clj_reader4coll7pair_up*)
    *(.text*._RINvNtCs*_4core3ptr9drop_glueINtNtB*_6option6OptionINtNtNtNtCs*_5alloc11collections5btree3map8BTreeMaplNtNtCs*_9clj_value6symbol6SymbolEEECs*_10clj_reader*)
    *(.text*._RINvNtCs*_4core3ptr9drop_glueSNtCs*_10clj_reader8FiredTagEB*_*)
    *(.text*._RNvMs*_NtCs*_5alloc4syncINtB*_3ArcNtNtCs*_9clj_value5value3MapE9drop_slowB*_*)
    *(.text*._RINvNtCs*_4core3ptr9drop_glueNtNtCs*_10clj_reader4opts10ReaderOptsEB*_*)
    *(.text*._RINvNtCs*_4core3ptr9drop_glueINtNtNtCs*_5alloc3vec9into_iter8IntoIterNtNtCs*_9clj_value5value5ValueEECs*_10clj_reader*)
    *(.text*._RNvXs*_NtCs*_8clj_eval6vm_opsNtB*_4PeekNtB*_3Op15apply*)
    *(.text*._RNvNtCs*_8clj_eval4coll11native_peek*)
    *(.text*._RINvMs*_NtCs*_5alloc3vecINtB*_3VeccE16extend_desugaredNtNtNtCs*_4core3str4iter5CharsECs*_10clj_reader*)
    *(.text*._RNvNtCs*_8clj_eval4coll10native_pop*)
    *(.text*.rt_n_cell_get)
    *(.text*.rt_n_cell_set)
    *(.text*.rt_n_cell_new)
    *(.text*._RNvNtCs*_8clj_eval6reader16stream_read_line*)
    *(.text*._RNvNtCs*_8clj_eval6reader16native_read_line*)
    *(.text*._RINvNtCs*_8clj_eval6reader10pull_chunkINtNtNtNtCs*_5alloc2io8buffered9bufreader9BufReaderINtNtB*_5boxed3BoxDNtNtB*_4read4ReadNtNtCs*_4core6marker4SendEL_EEEB*_*)
    *(.text*._RNvXs*_NtNtCs*_3std2io5stdioNtB*_5StdinNtNtNtCs*_5alloc2io4read4Read8read_buf*)
    *(.text*._RNvXs*_NtNtNtCs*_5alloc2io8buffered9bufreaderINtB*_9BufReaderNtNtNtCs*_3std2io5stdio8StdinRawENtNtB*_4read4Read8read_bufB*_*)
    *(.text*._RNvMCs*_10clj_readerNtB*_6Reader9read_line*)
    *(.text*._RNvNtCs*_8clj_eval6macros11native_list*)
    *(.text*._RNvNtCs*_8clj_eval2ns16signal_to_native*)
    *(.text*._RINvNtCs*_8clj_eval14stdlib_natives8upstreamNCNvB*_11native_trim0EB*_*)
    *(.text*._RNvNtCs*_8clj_eval4coll17native_assoc_bang*)
    *(.text*._RNvXs*_NtCs*_9clj_value9extensionNtB*_9ThrowableNtNtCs*_4core5clone5Clone5clone.716*)
    *(.text*._RINvMs*_NtCs*_5alloc3vecINtB*_3VecNtNtCs*_9clj_value5value5ValueE16extend_desugaredINtNtNtNtCs*_4core4iter8adapters6cloned6ClonedINtNtB*_3map3MapINtNtCs*_4rpds4list7IterPtrB*_NtNtNtNtCs*_7archery14shared_pointer4kind4arct5ArcTKEFG_RL0_INtB*_13SharedPointerB*_B*_EERL0_B*_EEECs*_8clj_eval*)
    *(.text*._RNvMNtCs*_9clj_value9extensionNtB*_10ThrowClass7matches*)
    *(.text*._RNvNtCs*_8clj_eval14stdlib_natives4meth*)
    *(.text*._RNvMs*_NtCs*_5alloc4syncINtB*_3ArcNtNtCs*_9clj_value9extension9ThrowableE9drop_slowB*_*)
    *(.text*._RNvMs*_NtCs*_5alloc4syncINtB*_3ArcINtNtNtNtCs*_3std4sync6poison5mutex5MutexNtNtCs*_9clj_value5value5ValueEE9drop_slowB*_*)
    *(.text*._RNvXs*_NtCs*_5alloc6stringNtB*_6StringNtNtCs*_4core3fmt5Write9write_str.705*)
    *(.text*._RNvNtCs*_8clj_eval14stdlib_natives18native_split_lines*)
    *(.text*._RNvNtCs*_8clj_eval4core12native_somep*)
    *(.text*._RNvNtCs*_8clj_eval4seqs8cmp_strs*)
    *(.text*._RNvMNtCs*_9clj_value9extensionNtB*_10ThrowClass8jvm_name*)
    *(.text*._RNvXs*_NtCs*_9clj_value3seqNtB*_9ConsValueNtNtB*_9extension14ExtensionValue6as_any*)
    *(.text*._RNvYNCNvNtCs*_8clj_eval4core9native_lts*_0INtNtNtCs*_4core3ops8function6FnOnceTxxEE9call_onceB*_*)
    *(.text*._RNvXs*_NtCs*_8clj_eval6vm_opsNtB*_9AssocBangNtB*_3Op35apply*)
    *(.text*._RINvNtCs*_4core3ptr9drop_glueTNtNtCs*_9clj_value5value5ValueB*_EEB*_*)
    *(.text*._RNvMs*_NtCs*_9clj_value9transientNtB*_12TransientMap5assoc*)
    *(.text*._RINvNtCs*_4core3ptr9drop_glueINtNtCs*_5alloc3vec3VecTNtNtCs*_9clj_value5value5ValueB*_EEEB*_*)
    *(.text*._RNvMs*_NtCs*_9clj_value9transientNtB*_12TransientMap3get*)
    *(.text*._RNvNtCs*_8clj_eval4seqs11native_rseq*)
    *(.text*._RINvNtNtNtNtCs*_4core5slice4sort6shared9smallsort19bidirectional_mergejNCINvMNtCs*_5alloc5sliceSj7sort_byNCNvNtCs*_8clj_eval4seqs13sort_by_index0E0EB*_*)
    *(.text*._RINvNtNtNtNtCs*_4core5slice4sort6shared9smallsort12sort4_stablejNCINvMNtCs*_5alloc5sliceSj7sort_byNCNvNtCs*_8clj_eval4seqs13sort_by_index0E0EB*_*)
    *(.text*._RINvNtNtNtNtCs*_4core5slice4sort6shared5pivot11median3_recjNCINvMNtCs*_5alloc5sliceSj7sort_byNCNvNtCs*_8clj_eval4seqs13sort_by_index0E0EB*_*)
    *(.text*._RINvNtNtNtNtCs*_4core5slice4sort6stable9quicksort9quicksortjNCINvMNtCs*_5alloc5sliceSj7sort_byNCNvNtCs*_8clj_eval4seqs13sort_by_index0E0EB*_*)
    *(.text*._RINvNtNtNtCs*_4core5slice4sort6stable14driftsort_mainjNCINvMNtCs*_5alloc5sliceSj7sort_byNCNvNtCs*_8clj_eval4seqs13sort_by_index0E0INtNtB*_3vec3VecjEEB*_*)
    *(.text*._RINvNtNtNtNtCs*_4core5slice4sort6stable5drift4sortjNCINvMNtCs*_5alloc5sliceSj7sort_byNCNvNtCs*_8clj_eval4seqs13sort_by_index0E0EB*_*)
    *(.text*.rt_n_conj_bang_fx)
    *(.text*._RNvMs*_NtCs*_9clj_value3seqNtB*_14SubVectorValue4iter*)
    *(.text*._RNvNtCs*_8clj_eval4coll9str_ascii*)
    *(.text*._RINvNtCs*_4core3ptr9drop_glueINtNtB*_6option6OptionTINtNtCs*_5alloc4sync4WeakeENtNtCs*_8clj_eval4coll7StrScanEEEB*_*)
    *(.text*._RNvMs*_NtCs*_5alloc7raw_vecINtB*_6RawVecNtNtCs*_8clj_eval4coll12StrScanEntryE8grow_oneB*_*)
    *(.text*._RNvNtCs*_8clj_eval4coll12memoize_scan*)
    *(.text*._RINvNtNtNtNtCs*_3std3sys12thread_local6native5eager7destroyINtNtCs*_4core4cell7RefCellTAINtNtB*_6option6OptionTINtNtCs*_5alloc4sync4WeakeENtNtCs*_8clj_eval4coll7StrScanEEj4_jEEEB*_*)
    *(.text*.rt_n_str_ascii)
    *(.text*._RNvNtCs*_8clj_eval4coll8str_scan*)
    *(.text*._RNvMs*_NtCs*_9clj_value3seqNtB*_13SplitVecValue3nth*)
    *(.text*._RNvMs*_NtCs*_9clj_value3seqNtB*_13SplitVecValue9with_meta*)
    *(.text*._RINvNtCs*_4core3ptr9drop_glueNtNtCs*_8clj_eval4coll12StrScanEntryEB*_*)
    *(.text*.rt_n_math_log)
    *(.text*.rt_n_math_exp)
    *(.text*._RNvNtCs*_8clj_eval4core20native_unchecked_add*)
    *(.text*._RNvNtCs*_8clj_eval4core25native_unchecked_multiply*)
    *(.text*.rt_n_math_pow)
    *(.text*._RNvMNtNtCs*_4rpds3map13hash_trie_mapINtB*_4NodeNtNtCs*_9clj_value5value5ValueuNtNtNtNtCs*_7archery14shared_pointer4kind4arct5ArcTKE6insertB*_*)
    *(.text*._RNvMs*_NtCs*_8triomphe3arcINtB*_3ArcINtNtNtCs*_4rpds3map13hash_trie_map4NodeNtNtCs*_9clj_value5value5ValueuNtNtNtNtCs*_7archery14shared_pointer4kind4arct5ArcTKEE9drop_slowB*_*)
    *(.text*._RNvNtCs*_8clj_eval4seqs15native_distinct*)
    *(.text*._RINvNtCs*_4core3ptr9drop_glueINtNtCs*_5alloc3vec3VecINtNtCs*_7archery14shared_pointer13SharedPointerINtNtNtCs*_4rpds3map13hash_trie_map4NodeNtNtCs*_9clj_value5value5ValueuNtNtNtB*_4kind4arct5ArcTKEB*_EEEB*_*)
    *(.text*._RNvMs*_NtCs*_8triomphe3arcINtB*_3ArcINtNtNtCs*_4rpds3map5entry5EntryNtNtCs*_9clj_value5value5ValueuEE9drop_slowB*_*)
    *(.text*._RINvNtNtNtNtCs*_4core5slice4sort6stable9quicksort9quicksortNtNtCs*_9clj_value5value5ValueNCINvMNtCs*_5alloc5sliceSB*_7sort_byNCINvNtCs*_8clj_eval4seqs15sort_by_checkedNvNtB*_4core11jvm_compareE0E0EB*_*)
    *(.text*._RINvNtNtNtNtCs*_4core5slice4sort6shared9smallsort12sort4_stableNtNtCs*_9clj_value5value5ValueNCINvMNtCs*_5alloc5sliceSB*_7sort_byNCINvNtCs*_8clj_eval4seqs15sort_by_checkedNvNtB*_4core11jvm_compareE0E0EB*_*)
    *(.text*._RINvNtNtNtNtCs*_4core5slice4sort6shared5pivot11median3_recNtNtCs*_9clj_value5value5ValueNCINvMNtCs*_5alloc5sliceSB*_7sort_byNCINvNtCs*_8clj_eval4seqs15sort_by_checkedNvNtB*_4core11jvm_compareE0E0EB*_*)
    *(.text*._RINvNtNtNtNtCs*_4core5slice4sort6stable5drift4sortNtNtCs*_9clj_value5value5ValueNCINvMNtCs*_5alloc5sliceSB*_7sort_byFG0_RL1_B*_RL0_B*_ENtNtB*_3cmp8OrderingE0ECs*_8clj_eval*)
    *(.text*._RINvNtNtNtNtCs*_4core5slice4sort6stable9quicksort9quicksortNtNtCs*_9clj_value5value5ValueNCINvMNtCs*_5alloc5sliceSB*_7sort_byFG0_RL1_B*_RL0_B*_ENtNtB*_3cmp8OrderingE0ECs*_8clj_eval*)
    *(.text*._RINvNtNtNtCs*_4core5slice4sort6stable14driftsort_mainNtNtCs*_9clj_value5value5ValueNCINvMNtCs*_5alloc5sliceSB*_7sort_byNCINvNtCs*_8clj_eval4seqs15sort_by_checkedNvNtB*_4core11jvm_compareE0E0INtNtB*_3vec3VecB*_EEB*_*)
    *(.text*._RINvNtNtNtCs*_4core5slice4sort6stable14driftsort_mainNtNtCs*_9clj_value5value5ValueNCINvMNtCs*_5alloc5sliceSB*_7sort_byFG0_RL1_B*_RL0_B*_ENtNtB*_3cmp8OrderingE0INtNtB*_3vec3VecB*_EECs*_8clj_eval*)
    *(.text*._RINvNtNtNtNtCs*_4core5slice4sort6stable5drift4sortNtNtCs*_9clj_value5value5ValueNCINvMNtCs*_5alloc5sliceSB*_7sort_byNCINvNtCs*_8clj_eval4seqs15sort_by_checkedNvNtB*_4core11jvm_compareE0E0EB*_*)
    *(.text*._RNvXs*_NtCs*_8clj_eval6vm_opsNtB*_3SubNtB*_3Op25apply*)
    *(.text*._RNvXs*_Cs*_12num_rationalINtB*_5RatioNtNtCs*_10num_bigint6bigint6BigIntENtNtNtCs*_4core3ops5arith3Sub3subCs*_8clj_eval*)
    *(.text*._RNCINvNtCs*_8clj_eval5xform8xf_outerNCNvB*_9mapcat_xf0E0B*_*)
    *(.text*._RNvNtCs*_8clj_eval4core11bigint_long*)
    *(.text*._RNvXs*_NtNtCs*_10num_bigint7biguint8additionNtB*_7BigUintINtNtNtCs*_4core3ops5arith3AddmE3add*)
    *(.text*._RNCNvNtCs*_8clj_eval5xform25native_preserving_reduced0B*_*)
    *(.text*._RNvXs*_NtNtCs*_10num_bigint6bigint11subtractionNtB*_6BigIntNtNtNtCs*_4core3ops5arith3Sub3sub*)
    *(.text*._RNvNtCs*_8clj_eval5xform25native_preserving_reduced*)
    *(.text*._RNvXNtNtCs*_10num_bigint7biguint11subtractionNtB*_7BigUintINtNtNtCs*_4core3ops5arith3SubRB*_E3sub*)
    *(.text*._RNvNtCs*_8clj_eval5xform10native_cat*)
    *(.text*._RNvXs*_NtCs*_8clj_eval6vm_opsNtB*_3IncNtB*_3Op15apply*)
    *(.text*._RNCNvNtCs*_8clj_eval5xform10native_cat0B*_*)
    *(.text*._RNvXs*_NtNtCs*_10num_bigint6bigint8additionNtB*_6BigIntINtNtNtCs*_4core3ops5arith3AddlE3add*)
    *(.text*._RNvNtNtCs*_10num_bigint7biguint5shift12biguint_shl2*)
    *(.text*._RNvMNtCs*_10num_bigint9big_digitNtB*_9BigDigits9normalize*)
    *(.text*._RNvMs*_NtCs*_5alloc4syncINtB*_3ArcNtNtCs*_10num_bigint6bigint6BigIntE9drop_slowCs*_9clj_value*)
    *(.text*._RNvXs*_NtNtCs*_10num_bigint7biguint5shiftNtB*_7BigUintINtNtNtCs*_4core3ops3bit9ShrAssignyE10shr_assign*)
    *(.text*._RNvNtNtCs*_10num_bigint7biguint5shift12biguint_shr2*)
    *(.text*._RNvNtCs*_8clj_eval4core13native_bigint*)
    *(.text*._RNvXs*_NtCs*_10num_bigint7biguintNtB*_7BigUintNtCs*_11num_integer7Integer3gcd*)
    *(.text*._RNvMs*_Cs*_12num_rationalINtB*_5RatioNtNtCs*_10num_bigint6bigint6BigIntE3newCs*_9clj_value*)
    *(.text*._RNvNtNtCs*_10num_bigint7biguint8division11div_rem_cow*)
    *(.text*._RNvXs*_NtCs*_8clj_eval6vm_opsNtB*_3MulNtB*_3Op25apply*)
    *(.text*._RNvNtCs*_8clj_eval4core9num_ratio*)
    *(.text*._RNvXs*_NtCs*_10num_bigint6bigintNtB*_6BigIntNtCs*_11num_integer7Integer7div_rem*)
    *(.text*._RNvXs*_NtNtCs*_10num_bigint6bigint8divisionNtB*_6BigIntNtNtNtCs*_4core3ops5arith3Div3div.2078*)
    *(.text*._RNvNtNtCs*_10num_bigint7biguint11subtraction4sub2*)
    *(.text*._RNvNtNtCs*_10num_bigint7biguint14multiplication10scalar_mul*)
    *(.text*._RNvXs*_Cs*_12num_rationalINtB*_5RatioNtNtCs*_10num_bigint6bigint6BigIntENtNtNtCs*_4core3ops5arith3Mul3mulCs*_8clj_eval*)
    *(.text*._RNvXs*_NtNtCs*_10num_bigint6bigint14multiplicationNtB*_6BigIntNtNtNtCs*_4core3ops5arith3Mul3mul*)
    *(.text*._RNvNtCs*_8clj_eval4coll14subvector_conj*)
    *(.text*.rt_n_math_sin)
    *(.text*.rt_n_math_cos)
    *(.text*._RINvNtCs*_4core3ptr9drop_glueINtNtB*_6option6OptionNtNtCs*_8clj_eval4coll11MapConjPlanEEB*_*)
    *(.text*._RNvNtCs*_8clj_eval4seqs18call_checked_owned*)
    *(.text*._RNCINvNtCs*_8clj_eval5xform8xf_outerNCNvB*_6map_xf0E0B*_*)
    *(.text*._RINvNtCs*_4core3ptr9drop_glueNCNvNtCs*_8clj_eval4seqs11native_comp0EB*_*)
    *(.text*._RNvNtCs*_8clj_eval4coll12native_count*)
    *(.text*._RNvYNCNvMs*_NtNtCs*_4rpds3map13hash_trie_mapINtB*_11HashTrieMapNtNtCs*_9clj_value5value5ValueB*_NtNtNtNtCs*_7archery14shared_pointer4kind4arct5ArcTKINtNtCs*_4core4hash18BuildHasherDefaultNtCs*_10rustc_hash8FxHasherEE4iter0INtNtNtB*_3ops8function6FnOnceTRINtB*_13SharedPointerINtNtB*_5entry5EntryB*_B*_EB*_EEE9call_onceB*_*)
    *(.text*._RINvNtCs*_4core3ptr9drop_glueNCNCNvNtCs*_8clj_eval5xform9filter_xf00EB*_*)
    *(.text*._RNvYNCNvNtCs*_8clj_eval4core10native_lte0INtNtNtCs*_4core3ops8function6FnOnceTddEE9call_onceB*_*)
    *(.text*.rt_n_math_tanh)
    *(.text*.rt_bc_1_count)
    *(.text*._RNvNtCs*_8clj_eval4core10native_pos*)
    *(.text*._RNvXs*_NtCs*_8clj_eval6vm_opsNtB*_3PosNtB*_3Op15apply*)
    *(.text*._RNvNtCs*_8clj_eval4core12npe_getclass*)
    *(.text*._RNvNtCs*_8clj_eval4lazy11native_cons*)
    *(.text*._RNvNtCs*_8clj_eval4lazy15step_cons_value*)
    *(.text*._RNvXs*_NtCs*_8clj_eval8collmiscNtB*_13MatcherHandleNtNtCs*_9clj_value9extension14ExtensionValue6as_any*)
    *(.text*._RINvNtCs*_4core3ptr9drop_glueNtNtNtCs*_14regex_automata6hybrid5regex5RegexEB*_*)
    *(.text*._RNvMs*_NtNtCs*_12regex_syntax3hir9translateNtB*_11TranslatorI3pop*)
    *(.text*._RNvMs*_NtCs*_12regex_syntax3astNtB*_3Ast10repetition*)
    *(.text*._RNvMs*_NtNtNtCs*_14regex_automata3nfa8thompson7builderNtB*_7Builder3add*)
    *(.text*._RNvMs*_NtNtNtCs*_14regex_automata3nfa8thompson7builderNtB*_7Builder5patch*)
    *(.text*._RNvMs*_NtNtCs*_14regex_automata6hybrid3dfaNtB*_4Lazy10init_cache*)
    *(.text*._RINvNtCs*_4core3ptr9drop_glueNtNtCs*_8clj_eval8collmisc13MatcherHandleEB*_*)
    *(.text*._RNvMs*_NtNtCs*_14regex_automata4util8capturesNtB*_14GroupInfoInner15add_first_group*)
    *(.text*._RNvMs*_NtNtNtCs*_14regex_automata3nfa8thompson8compilerNtB*_8Compiler3new*)
    *(.text*._RINvNtCs*_4core3ptr9drop_glueNtNtNtCs*_12regex_syntax3hir9translate10TranslatorECs*_14regex_automata*)
    *(.text*._RNvMs*_NtNtNtCs*_14regex_automata3nfa8thompson8compilerNtB*_8Compiler5c_cap*)
    *(.text*._RINvNtCs*_4core3ptr9drop_glueNtNtNtCs*_14regex_automata4meta8strategy4CoreEB*_*)
    *(.text*._RINvNtCs*_4core3ptr9drop_glueNtNtNtCs*_12regex_syntax3hir9translate8HirFrameEB*_*)
    *(.text*._RINvNtCs*_4core3ptr9drop_glueNtNtNtCs*_12regex_syntax3ast7visitor11HeapVisitorEB*_*)
    *(.text*._RINvNtCs*_4core3ptr9drop_glueNtNtNtNtCs*_14regex_automata3nfa8thompson3nfa5InnerEB*_*)
    *(.text*._RNvXNtCs*_4core3anyNtNtCs*_8clj_eval8collmisc13MatcherHandleNtB*_3Any7type_idB*_*)
    *(.text*._RINvNtCs*_4core3ptr9drop_glueINtNtB*_4cell7RefCellNtNtNtNtCs*_14regex_automata3nfa8thompson8compiler9Utf8StateEEB*_*)
    *(.text*._RNvNtCs*_8clj_eval8classemu14is_instance_of*)
    *(.text*._RINvNtCs*_4core3ptr9drop_glueINtNtCs*_5alloc3vec3VecINtNtB*_6option6OptionINtNtB*_4sync3ArceEEEECs*_14regex_automata*)
    *(.text*._RINvMs*_NtCs*_5alloc3vecINtB*_3VecNtNtCs*_12regex_syntax3ast3AstE14extend_trustedINtNtB*_5drain5DrainB*_EEB*_*)
    *(.text*._RNvMs*_NtNtCs*_14regex_automata6hybrid3dfaNtB*_7Builder9configure*)
    *(.text*._RNvMs*_NtNtCs*_12regex_syntax3hir9translateNtB*_11TranslatorI9push_char*)
    *(.text*._RINvNtCs*_4core3ptr9drop_glueNtNtNtNtCs*_14regex_automata3nfa8thompson3nfa5StateEB*_*)
    *(.text*._RNvMs*_NtCs*_5alloc4syncINtB*_3ArcNtNtNtCs*_14regex_automata4meta5regex10RegexInfoIE9drop_slowB*_*)
    *(.text*._RNvMs*_NtNtNtCs*_14regex_automata4util11determinize5stateNtB*_5State4dead*)
    *(.text*._RINvMs*_NtCs*_9hashbrown3mapINtB*_7HashMapNtNtNtNtCs*_14regex_automata4util11determinize5state5StateNtNtNtB*_6hybrid2id11LazyStateIDNtNtNtCs*_3std4hash6random11RandomStateE3getShEB*_*)
    *(.text*._RNvXs*_NtNtCs*_5alloc3vec5drainINtB*_5DrainNtNtCs*_12regex_syntax3ast3AstENtNtNtCs*_4core3ops4drop4Drop4dropB*_*)
    *(.text*._RINvNtCs*_4core3ptr9drop_glueNtNtNtCs*_14regex_automata6hybrid3dfa7BuilderEB*_*)
    *(.text*._RINvNtCs*_4core3ptr9drop_glueNtNtNtCs*_14regex_automata4util8captures8CapturesEB*_*)
    *(.text*._RNvMs*_NtNtNtCs*_14regex_automata3nfa8thompson8compilerNtB*_8Compiler17add_union_reverse*)
    *(.text*._RINvNtCs*_4core3ptr9drop_glueINtNtCs*_5alloc3vec3VecINtNtNtNtCs*_14regex_automata4util4pool5inner9CacheLineINtNtNtNtCs*_3std4sync6poison5mutex5MutexIB*_INtNtB*_5boxed3BoxNtNtNtB*_4meta5regex5CacheEEEEEECs*_8clj_eval*)
    *(.text*._RNvXs*_NtCs*_12regex_syntax3hirNtB*_3HirNtNtNtCs*_4core3ops4drop4Drop4drop*)
    *(.text*._RNvXs*_NtNtCs*_5alloc3vec5drainINtB*_5DrainNtNtCs*_12regex_syntax3hir3HirENtNtNtCs*_4core3ops4drop4Drop4dropB*_*)
    *(.text*._RNvMs*_NtCs*_5alloc7raw_vecINtB*_6RawVecINtNtCs*_4core6option6OptionINtNtB*_4sync3ArceEEE8grow_oneCs*_14regex_automata*)
    *(.text*._RINvNtCs*_4core3ptr9drop_glueSNtNtCs*_12regex_syntax3hir3HirEB*_*)
    *(.text*._RNvNtCs*_8clj_eval2re14compile_source*)
    *(.text*._RINvNtCs*_4core3ptr9drop_glueINtNtCs*_5alloc3vec3VecNtNtCs*_12regex_syntax3ast3AstEEB*_*)
    *(.text*._RINvNtCs*_4core3ptr9drop_glueNtNtNtNtCs*_14regex_automata3nfa8thompson9backtrack18BoundedBacktrackerEB*_*)
    *(.text*._RNvMs*_NtCs*_9hashbrown3mapINtB*_7HashMapNtNtNtNtCs*_14regex_automata4util11determinize5state5StateNtNtNtB*_6hybrid2id11LazyStateIDNtNtNtCs*_3std4hash6random11RandomStateE6insertB*_*)
    *(.text*._RINvNtCs*_4core3ptr9drop_glueINtNtB*_4cell7RefCellINtNtCs*_5alloc3vec3VecNtNtCs*_12regex_syntax3ast11CaptureNameEEECs*_14regex_automata*)
    *(.text*._RINvNtCs*_4core3ptr9drop_glueINtNtNtNtCs*_3std11collections4hash3map7HashMapNtNtNtNtCs*_14regex_automata4util11determinize5state5StateNtNtNtB*_6hybrid2id11LazyStateIDEEB*_*)
    *(.text*._RINvNtCs*_4core3ptr9drop_glueINtNtCs*_5alloc5boxed3BoxNtNtCs*_12regex_syntax3ast3AstEEB*_*)
    *(.text*._RNvMs*_NtCs*_5alloc4syncINtB*_3ArcNtNtNtCs*_14regex_automata4util8captures14GroupInfoInnerE9drop_slowB*_*)
    *(.text*._RINvMs*_NtNtNtNtCs*_3std3sys12thread_local6native4lazyINtB*_7StorageINtNtCs*_4core4cell7RefCellINtNtNtNtB*_11collections4hash3map7HashMapNtNtCs*_5alloc6string6StringINtNtB*_4sync3ArcNtNtNtCs*_5regex5regex6string5RegexEINtNtB*_4hash18BuildHasherDefaultNtCs*_10rustc_hash8FxHasherEEEuE16get_or_init_slowNvNvNvNtCs*_8clj_eval2re14compile_source8COMPILED27___rust_std_internal_init_fnEB*_*)
    *(.text*._RINvNtCs*_4core3ptr9drop_glueNCINvMs*_NtNtCs*_14regex_automata4meta5regexNtB*_7Builder19build_many_from_hirNtNtCs*_12regex_syntax3hir3HirEs*_0EB*_*)
    *(.text*._RINvNtCs*_4core3ptr9drop_glueNtNtNtNtCs*_14regex_automata3nfa8thompson10range_trie9RangeTrieEB*_*)
    *(.text*._RNvXs*_NtNtCs*_5regex5regex6stringNtB*_7MatchesNtNtNtNtCs*_4core4iter6traits8iterator8Iterator4next*)
    *(.text*._RINvNtNtNtNtCs*_3std3sys12thread_local6native4lazy7destroyINtNtCs*_4core4cell7RefCellINtNtNtNtB*_11collections4hash3map7HashMapNtNtCs*_5alloc6string6StringINtNtB*_4sync3ArcNtNtNtCs*_5regex5regex6string5RegexEINtNtB*_4hash18BuildHasherDefaultNtCs*_10rustc_hash8FxHasherEEEECs*_8clj_eval*)
    *(.text*._RINvYNtNtNtCs*_3std4hash6random11RandomStateNtNtCs*_4core4hash11BuildHasher8hash_oneRNtNtNtNtCs*_14regex_automata4util11determinize5state5StateEB*_*)
    *(.text*._RNvNtCs*_8clj_eval8classemu14class_of_value*)
    *(.text*._RNvNtNtCs*_14regex_automata6hybrid3dfa22minimum_cache_capacity*)
    *(.text*._RNvYNCNvNCNvMs*_NtNtCs*_14regex_automata4meta5regexNtB*_6Config17get_pool_capacity021AVAILABLE_PARALLELISM0INtNtNtCs*_4core3ops8function6FnOnceuE9call_onceB*_*)
    *(.text*._RINvNtCs*_4core3ptr9drop_glueNtNtNtCs*_12regex_syntax3ast5parse6ParserECs*_14regex_automata*)
    *(.text*._RINvNtCs*_4core3ptr9drop_glueNtNtNtCs*_14regex_automata4meta8wrappers23BoundedBacktrackerCacheEB*_*)
    *(.text*._RNvMs*_NtNtNtCs*_14regex_automata3nfa8thompson8compilerNtB*_8Compiler10c_at_least*)
    *(.text*._RINvNtCs*_4core3ptr9drop_glueNtNtCs*_12regex_syntax3ast3AstEB*_*)
    *(.text*._RNvMs*_NtCs*_12regex_syntax3hirNtB*_3Hir10into_parts*)
    *(.text*._RNvNtCs*_8clj_eval8classemu15native_instance*)
    *(.text*._RNvMs*_NtNtCs*_14regex_automata6hybrid3dfaNtB*_4Lazy17cache_start_group*)
    *(.text*._RNvXs*_NtNtCs*_4core3str7patternReNtB*_7Pattern15is_contained_in*)
    *(.text*._RINvNtCs*_4core3ptr9drop_glueNtNtCs*_12regex_syntax3hir7HirKindEB*_*)
    *(.text*._RINvNtCs*_4core3ptr9drop_glueINtNtCs*_5alloc3vec3VecNtNtCs*_12regex_syntax3hir10PropertiesEECs*_14regex_automata*)
    *(.text*._RINvNtCs*_4core3ptr9drop_glueNtNtNtNtCs*_14regex_automata3nfa8thompson6pikevm7BuilderEB*_*)
    *(.text*._RNvMs*_NtCs*_5alloc4syncINtB*_3ArcNtNtNtCs*_14regex_automata4meta5regex6RegexIE9drop_slowB*_*)
    *(.text*._RINvNtCs*_4core3ptr9drop_glueNtNtCs*_12regex_syntax3hir3HirECs*_14regex_automata*)
    *(.text*._RINvNtCs*_4core3ptr9drop_glueINtNtNtCs*_5alloc3vec9into_iter8IntoIterNtNtCs*_12regex_syntax3hir3HirEEB*_*)
    *(.text*._RNvMs*_NtNtNtCs*_14regex_automata3nfa8thompson8compilerNtB*_8Compiler9add_union*)
    *(.text*._RNvXs*_NtNtCs*_12regex_syntax3hir9translateNtB*_11TranslatorINtNtNtB*_3ast7visitor7Visitor10visit_post*)
    *(.text*._RINvNtCs*_4core3ptr9drop_glueNtNtNtCs*_14regex_automata6hybrid3dfa5CacheECs*_8clj_eval*)
    *(.text*._RINvNtCs*_4core3ptr9drop_glueINtNtCs*_5alloc5boxed3BoxNtNtCs*_12regex_syntax3ast10RepetitionEEB*_*)
    *(.text*._RNvMs*_NtCs*_5alloc7raw_vecINtB*_6RawVecINtNtB*_3vec3VecINtNtCs*_4core6option6OptionINtNtB*_4sync3ArceEEEE8grow_oneCs*_14regex_automata*)
    *(.text*._RINvMs*_NtCs*_9hashbrown3rawINtB*_8RawTableTNtNtNtNtCs*_14regex_automata4util11determinize5state5StateNtNtNtB*_6hybrid2id11LazyStateIDEE14reserve_rehashNCINvNtB*_3map11make_hasherB*_B*_NtNtNtCs*_3std4hash6random11RandomStateE0EB*_*)
    *(.text*._RNvMs*_NtNtCs*_12regex_syntax3ast5parseINtB*_11NestLimiterQNtB*_6ParserE5checkB*_*)
    *(.text*._RINvMs*_NtCs*_5alloc3vecINtB*_3VecNtNtCs*_12regex_syntax3hir3HirE14extend_trustedINtNtB*_5drain5DrainB*_EEB*_*)
    *(.text*._RINvNtCs*_4core3ptr9drop_glueNtNtCs*_12regex_syntax3hir3HirEB*_*)
    *(.text*._RNvMs*_NtCs*_5alloc7raw_vecINtB*_6RawVecTRNtNtCs*_12regex_syntax3ast3AstNtNtB*_7visitor5FrameEE8grow_oneB*_*)
    *(.text*._RNvMs*_NtNtNtCs*_14regex_automata4util11determinize5stateNtB*_19StateBuilderMatches8into_nfa*)
    *(.text*._RNvXs*_NtNtCs*_14regex_automata4meta8strategyNtB*_4CoreNtB*_8Strategy12create_cache*)
    *(.text*._RNvMs*_NtCs*_5alloc4syncINtB*_3ArcINtNtNtNtCs*_3std4sync6poison5mutex5MutexNtNtCs*_8clj_eval8collmisc12MatcherStateEE9drop_slowB*_*)
    *(.text*._RNvMs*_NtNtNtCs*_14regex_automata3nfa8thompson8compilerNtB*_8Compiler5patch*)
    *(.text*._RINvMs*_NtCs*_9hashbrown3rawINtB*_8RawTableTNtNtCs*_5alloc6string6StringINtNtB*_4sync3ArcNtNtNtCs*_5regex5regex6string5RegexEEE14reserve_rehashNCINvNtB*_3map11make_hasherB*_B*_INtNtCs*_4core4hash18BuildHasherDefaultNtCs*_10rustc_hash8FxHasherEE0ECs*_8clj_eval*)
    *(.text*._RNvMs*_NtNtCs*_12regex_syntax3ast5parseINtB*_7ParserIQNtB*_6ParserE4charB*_*)
    *(.text*._RINvNtCs*_4core3ptr9drop_glueNtNtCs*_12regex_syntax3hir7HirKindECs*_14regex_automata*)
    *(.text*._RINvNtCs*_4core3ptr9drop_glueNtNtNtCs*_14regex_automata4util8captures14GroupInfoInnerEB*_*)
    *(.text*._RINvNtCs*_4core3ptr9drop_glueNtNtNtCs*_14regex_automata6hybrid3dfa3DFAEB*_*)
    *(.text*._RINvNtCs*_4core3ptr9drop_glueINtNtCs*_5alloc5boxed3BoxNtNtCs*_12regex_syntax3hir3HirEEB*_*)
    *(.text*._RNvMs*_NtNtNtCs*_14regex_automata3nfa8thompson8compilerNtB*_8Compiler9add_empty*)
    *(.text*._RINvNtCs*_4core3ptr9drop_glueINtNtCs*_5alloc3vec3VecNtNtCs*_12regex_syntax3ast3AstEECs*_14regex_automata*)
    *(.text*._RINvNvMs*_NtCs*_5alloc7raw_vecINtB*_11RawVecInnerpE7reserve21do_reserve_and_handleNtNtB*_5alloc6GlobalECs*_5regex*)
    *(.text*._RINvNtCs*_4core3ptr9drop_glueNtNtNtCs*_5regex5regex6string5RegexECs*_8clj_eval*)
    *(.text*._RNvXs*_NtCs*_12regex_syntax3astNtB*_3AstNtNtNtCs*_4core3ops4drop4Drop4drop*)
    *(.text*._RNvMs*_NtCs*_12regex_syntax3astNtB*_6Concat8into_ast*)
    *(.text*._RNvMs*_NtNtCs*_14regex_automata6hybrid3dfaNtB*_4Lazy14set_transition*)
    *(.text*._RNvMs*_NtCs*_5alloc7raw_vecINtB*_6RawVecNtNtCs*_12regex_syntax3hir10PropertiesE8grow_oneCs*_14regex_automata*)
    *(.text*._RNCINvMs*_NtNtCs*_14regex_automata4meta5regexNtB*_7Builder19build_many_from_hirNtNtCs*_12regex_syntax3hir3HirEs*_0B*_*)
    *(.text*._RNvMs*_NtNtCs*_12regex_syntax3ast5parseINtB*_7ParserIQNtB*_6ParserE13pop_group_endB*_*)
    *(.text*._RNvMs*_NtCs*_5alloc7raw_vecINtB*_6RawVecNtNtNtNtCs*_14regex_automata3nfa8thompson7builder5StateE8grow_oneB*_*)
    *(.text*._RINvNtCs*_4core3ptr9drop_glueNtNtNtCs*_14regex_automata4meta5regex10RegexInfoIEB*_*)
    *(.text*._RINvNtCs*_4core3ptr9drop_glueINtNtNtNtCs*_3std11collections4hash3map7HashMapINtNtCs*_5alloc4sync3ArceENtNtNtCs*_14regex_automata4util10primitives10SmallIndexEEB*_*)
    *(.text*._RNvNtCs*_8clj_eval8collmisc17native_re_matcher*)
    *(.text*._RINvNtCs*_4core3ptr9drop_glueNtNtNtNtCs*_14regex_automata3nfa8thompson7builder5StateEB*_*)
    *(.text*._RNvYNCNvNtCs*_8clj_eval4core10native_gte0INtNtNtCs*_4core3ops8function6FnOnceTddEE9call_onceB*_*)
    *(.text*._RNvNtCs*_8clj_eval4lazy10equiv_fill*)
    *(.text*._RNvNtCs*_8clj_eval4lazy13equiv_drained*)
    *(.text*._RINvNtCs*_4core3ptr9drop_glueINtNtNtCs*_3std4sync6poison11PoisonErrorINtNtB*_5mutex10MutexGuardINtNtB*_6option6OptionINtNtB*_4mpsc6SenderINtNtCs*_5alloc5boxed3BoxDINtNtNtB*_3ops8function6FnOnceuEp6OutputuNtNtB*_6marker4SendEL_EEEEEECs*_5cljrt*)
    *(.text*._RNvNtCs*_8clj_eval4seqs19native_partition_by*)
    *(.text*._RNvNtCs*_8clj_eval4lazy17step_partition_by*)
    *(.text*._RINvNtCs*_4core3ptr9drop_glueINtNtCs*_5alloc3vec3VecINtNtB*_4sync3ArcINtNtCs*_9clj_value4trie4NodeNtNtB*_5value5ValueEEEEB*_*)
    *(.text*._RINvNtNtNtNtCs*_4core5slice4sort6stable5drift4sortNtNtCs*_9clj_value5value5ValueNCINvMNtCs*_5alloc5sliceSB*_7sort_byNCINvNtCs*_8clj_eval4seqs15sort_by_checkedNCNvB*_20native_sort_by_owned0E0E0EB*_*)
    *(.text*._RINvNtCs*_4core3ptr9drop_glueINtNtCs*_9clj_value4trie6PackedNtNtB*_5value5ValueEEB*_*)
    *(.text*._RINvXs*_NtCs*_9clj_value4trieNtB*_4PVecINtNtNtNtCs*_4core4iter6traits7collect12FromIteratorNtNtB*_5value5ValueE9from_iterINtNtNtB*_8adapters6cloned6ClonedINtNtNtB*_5slice4iter4IterB*_EEEB*_*)
    *(.text*._RINvNtNtNtCs*_4core5slice4sort6stable14driftsort_mainNtNtCs*_9clj_value5value5ValueNCINvMNtCs*_5alloc5sliceSB*_7sort_byNCINvNtCs*_8clj_eval4seqs15sort_by_checkedNCNvB*_20native_sort_by_owned0E0E0INtNtB*_3vec3VecB*_EEB*_*)
    *(.text*._RNvNtCs*_8clj_eval4core7intcast*)
    *(.text*._RINvNtNtNtNtCs*_4core5slice4sort6stable9quicksort9quicksortNtNtCs*_9clj_value5value5ValueNCINvMNtCs*_5alloc5sliceSB*_7sort_byNCINvNtCs*_8clj_eval4seqs15sort_by_checkedNCNvB*_20native_sort_by_owned0E0E0EB*_*)
    *(.text*._RNvMs*_NtCs*_5alloc4syncINtB*_3ArcINtNtCs*_9clj_value4trie4NodeNtNtB*_5value5ValueEE8make_mutB*_*)
    *(.text*._RINvNtCs*_9clj_value4trie8new_pathNtNtB*_5value5ValueEB*_*)
    *(.text*._RNvXNtNtCs*_5alloc3vec21spec_from_iter_nestedINtB*_3VectEINtB*_18SpecFromIterNestedtNtNtNtCs*_4core3str4iter11EncodeUtf16E9from_iterCs*_8clj_eval*)
    *(.text*._RNvNtCs*_8clj_eval4seqs20native_partition_all*)
    *(.text*._RNvNtCs*_8clj_eval8classemu16str_index_search*)
    *(.text*._RNvNtCs*_8clj_eval8classemu10str_needle*)
    *(.text*._RNvMs*_NtCs*_5alloc4syncINtB*_3ArcINtNtCs*_9clj_value4trie4NodeNtNtB*_5value5ValueEE9drop_slowB*_*)
    *(.text*._RNvMs*_NtCs*_9clj_value4trieNtB*_4PVec13push_back_mutB*_*)
    *(.text*._RNvMs*_NtCs*_9clj_value4trieNtB*_4PVec8from_vecB*_*)
    *(.text*._RNvXs*_NtCs*_9clj_value5valueNtB*_11OrderedIterNtNtNtNtCs*_4core4iter6traits8iterator8Iterator4next*)
    *(.text*._RINvMs*_NtCs*_5alloc3vecINtB*_3VecNtNtCs*_9clj_value5value5ValueE16extend_desugaredINtNtNtNtCs*_4core4iter8adapters6cloned6ClonedNtNtB*_4trie4IterEEB*_*)
    *(.text*._RNvMs*_NtCs*_5alloc4syncINtB*_3ArcNtNtCs*_9clj_value4trie4PVecE9drop_slowB*_*)
    *(.text*._RNvNtCs*_8clj_eval4coll17sorted_lookup_map*)
    *(.text*._RNvNtCs*_8clj_eval4coll17native_sorted_map*)
    *(.text*._RNvMs*_NtCs*_9clj_value5valueNtB*_3Map20with_ordered_entries*)
    *(.text*._RNvMs*_NtCs*_9clj_value5valueNtB*_3Map9with_sort*)
    *(.text*._RNvNtCs*_8clj_eval4coll12map_position*)
    *(.text*._RNvNtCs*_8clj_eval4coll15sorted_map_from*)
    *(.text*._RNvNtCs*_8clj_eval4coll16sorted_assoc_map*)
    *(.text*._RNvNtCs*_8clj_eval4coll13native_dissoc*)
    *(.text*._RNvMs*_NtCs*_9clj_value5valueNtB*_3Map7without*)
    *(.text*._RNvXs*_NtCs*_8clj_eval6vm_opsNtB*_6DissocNtB*_3Op25apply*)
    *(.text*._RINvMNtNtCs*_4rpds3map13hash_trie_mapINtB*_4NodeNtNtCs*_9clj_value5value5ValueB*_NtNtNtNtCs*_7archery14shared_pointer4kind4arct5ArcTKE6removeB*_EB*_*)
    *(.text*._RNvMNtNtNtCs*_4rpds3map13hash_trie_map18sparse_array_usizeINtB*_16SparseArrayUsizeINtNtCs*_7archery14shared_pointer13SharedPointerINtB*_4NodeNtNtCs*_9clj_value5value5ValueB*_NtNtNtB*_4kind4arct5ArcTKEB*_EE6removeB*_*)
    *(.text*._RNvMNtNtCs*_4rpds3map13hash_trie_mapINtB*_4NodeNtNtCs*_9clj_value5value5ValueB*_NtNtNtNtCs*_7archery14shared_pointer4kind4arct5ArcTKE8compressB*_*)
    *(.text*._RNCINvMNtCs*_5alloc5sliceSNtNtCs*_9clj_value5value5Value7sort_byNCINvNtCs*_8clj_eval4seqs15sort_by_checkedNCNvB*_17native_sort_owned0E0E0B*_*)
    *(.text*._RNvNtCs*_8clj_eval4seqs21native_group_by_owned*)
    *(.text*._RNCNvNtCs*_8clj_eval4seqs21native_group_by_owned0B*_*)
    *(.text*._RNvNtCs*_8clj_eval4core9native_gt*)
    *(.text*._RNvNtCs*_8clj_eval4seqs15native_identity*)
    *(.text*._RINvNtCs*_4core3ptr9drop_glueNtNtCs*_8clj_eval4lazy11ConcatFrameEB*_*)
    *(.text*._RNvXs*_NtCs*_8clj_eval4lazyNtB*_11ConcatFrameNtNtNtCs*_4core3ops4drop4Drop4drop*)
    *(.text*._RNvMs*_NtCs*_5alloc4syncINtB*_3ArcNtNtCs*_8clj_eval4lazy11ConcatFrameE9drop_slowB*_*)
    *(.text*._RINvNtCs*_4core3ptr9drop_glueINtNtCs*_5alloc3vec3VecINtNtB*_4sync3ArcINtNtCs*_9clj_value4trie4NodeINtNtB*_6option6OptionNtNtB*_5value5ValueEEEEEB*_*)
    *(.text*._RNvMs*_NtCs*_5alloc4syncINtB*_3ArcINtNtCs*_9clj_value4trie4NodeINtNtCs*_4core6option6OptionNtNtB*_5value5ValueEEE9drop_slowB*_*)
    *(.text*._RNvXNtNtCs*_5alloc3vec21spec_from_iter_nestedINtB*_3VecNtNtCs*_9clj_value5value5ValueEINtB*_18SpecFromIterNestedB*_NtB*_10VectorIterE9from_iterB*_*)
    *(.text*._RNvXs*_NtCs*_9clj_value3seqNtB*_3SeqNtNtCs*_4core5clone5Clone5clone*)
    *(.text*._RNvCs*_7stacker15remaining_stack*)
    *(.text*._RINvMs*_NtNtNtNtCs*_3std3sys12thread_local6native4lazyINtB*_7StorageINtNtCs*_4core4cell4CellINtNtB*_6option6OptionjEEzE16get_or_init_slowNvNvCs*_7stacker11STACK_LIMIT27___rust_std_internal_init_fnEB*_*)
    *(.text*._RNvNtCs*_9clj_value5value17seq_ext_with_meta*)
    *(.text*._RINvNtCs*_4core3ptr9drop_glueNtNtCs*_9clj_value3seq14SubVectorValueEB*_*)
    *(.text*.systrim.constprop.0)
    *(.text*._RNvXs*_NtCs*_8clj_eval6vm_opsNtB*_5BitOrNtB*_3Op25apply*)
    *(.text*._RNvNtCs*_8clj_eval14stdlib_natives9lite_join*)
    *(.text*._RNCNvNtCs*_8clj_eval4seqs11native_comp0B*_*)
    *(.text*._RNvNtCs*_8clj_eval4seqs11native_comp*)
    *(.text*._RNCINvNtCs*_8clj_eval5xform8xf_outerNCNvB*_9filter_xf0E0B*_*)
    *(.text*._RNvNtCs*_8clj_eval5xform9filter_xf*)
    *(.text*._RNCNCNvNtCs*_8clj_eval5xform9filter_xf00B*_*)
    *(.text*._RNvMs*_NtCs*_9clj_value5valueNtB*_3Map12contains_key*)
    *(.text*._RNvNtCs*_8clj_eval4seqs11native_vals*)
    *(.text*._RNvNtCs*_8clj_eval4coll22native_update_in_owned*)
    *(.text*._RNvNtCs*_8clj_eval4coll12update_in_up*)
    *(.text*._RNCNvNtCs*_8clj_eval4seqs24native_frequencies_owned0B*_*)
    *(.text*._RNvNtCs*_8clj_eval4core9chain_cmp*)
    *(.text*._RNvNtCs*_8clj_eval4core10native_gte*)
    *(.text*._RNvNtCs*_8clj_eval4core10native_lte*)
    *(.text*._RNvNtCs*_8clj_eval4seqs14native_max_key*)
    *(.text*._RNvYNCNvNtCs*_8clj_eval4core10native_ltes*_0INtNtNtCs*_4core3ops8function6FnOnceTxxEE9call_onceB*_*)
    *(.text*._RNvNtCs*_8clj_eval4seqs19native_keep_indexed*)
    *(.text*._RNvNtCs*_8clj_eval4lazy17step_repeat_value*)
    *(.text*._RNvNtCs*_8clj_eval4lazy11native_rest*)
    *(.text*._RNvNtCs*_8clj_eval4coll19native_emptyp_owned*)
    *(.text*._RNvMs*_NtCs*_5alloc4syncINtB*_3ArcINtNtB*_3vec3VeccEE8make_mutCs*_9clj_value*)
    *(.text*._RNvMs*_NtCs*_5alloc7raw_vecINtB*_6RawVeccE8grow_oneCs*_9clj_value*)
    *(.text*._RNvMs*_NtCs*_9clj_value5valueNtB*_6Vector14push_to_string*)
    *(.text*._RNvNtCs*_8clj_eval4core11native_char*)
    *(.text*._RINvNtCs*_4core3ptr9drop_glueNCNvMs*_NtCs*_8clj_eval2vmNtB*_8Compiler17compile_data_forms*_0EB*_*)
    *(.text*._RNvMs*_NtNtNtCs*_14regex_automata3nfa8thompson8compilerNtB*_8Compiler1c*)
    *(.text*._RNvNtNtCs*_14regex_automata6hybrid6search8find_fwd*)
    *(.text*._RINvNtCs*_4core3ptr9drop_glueNtNtNtNtCs*_14regex_automata3nfa8thompson7builder7BuilderEB*_*)
    *(.text*._RNvMNtNtNtCs*_14regex_automata3nfa8thompson10range_trieNtB*_9RangeTrie9add_empty*)
    *(.text*._RINvMs*_NtNtNtCs*_14regex_automata3nfa8thompson8compilerNtB*_8Compiler19build_many_from_hirRNtNtCs*_12regex_syntax3hir3HirEB*_*)
    *(.text*._RNvMs*_NtCs*_12regex_syntax3hirNtB*_3Hir5class*)
    *(.text*._RINvNtCs*_4core3ptr9drop_glueINtNtNtNtCs*_14regex_automata4util4pool5inner9CacheLineINtNtNtNtCs*_3std4sync6poison5mutex5MutexINtNtCs*_5alloc3vec3VecINtNtB*_5boxed3BoxNtNtNtB*_4meta5regex5CacheEEEEECs*_8clj_eval*)
    *(.text*._RINvNtCs*_4core3ptr9drop_glueNtNtNtNtCs*_14regex_automata3nfa8thompson8compiler8CompilerEB*_*)
    *(.text*._RINvNtCs*_4core3ptr9drop_glueINtNtCs*_5alloc5boxed3BoxNtNtCs*_12regex_syntax3ast6ConcatEEB*_*)
    *(.text*._RNvMs*_NtNtNtCs*_14regex_automata3nfa8thompson3nfaNtB*_5Inner3add*)
    *(.text*._RNvMs*_NtCs*_12regex_syntax3hirNtB*_10Properties5empty*)
    *(.text*._RINvMs*_NtCs*_9hashbrown3rawINtB*_8RawTableTReINtNtCs*_5alloc4sync3ArcINtNtNtNtCs*_3std11collections4hash3set7HashSetB*_EEEE14reserve_rehashNCINvNtB*_3map11make_hasherB*_B*_NtNtNtB*_4hash6random11RandomStateE0ECs*_8clj_eval*)
    *(.text*._RNvMs*_NtNtCs*_14regex_automata6hybrid3dfaNtB*_7Builder14build_from_nfa*)
    *(.text*._RINvYNtNtNtCs*_3std4hash6random11RandomStateNtNtCs*_4core4hash11BuildHasher8hash_oneReECs*_14regex_automata*)
    *(.text*._RINvNtCs*_4core3ptr9drop_glueINtNtCs*_5alloc3vec3VecNtNtCs*_12regex_syntax3hir3HirEEB*_*)
    *(.text*._RNvMs*_NtCs*_5alloc7raw_vecINtB*_6RawVecNtNtCs*_12regex_syntax3ast3AstE8grow_oneB*_*)
    *(.text*._RNvMs*_NtNtCs*_12regex_syntax3hir9translateNtB*_11TranslatorI4push*)
    *(.text*._RINvNtCs*_4core3ptr9drop_glueNtNtNtCs*_14regex_automata4meta5regex5CacheECs*_8clj_eval*)
    *(.text*._RINvNtCs*_4core3ptr9drop_glueINtNtB*_4cell7RefCellINtNtCs*_5alloc3vec3VecNtNtNtCs*_12regex_syntax3ast5parse10ClassStateEEECs*_14regex_automata*)
    *(.text*._RNvMs*_NtNtCs*_12regex_syntax3ast5parseINtB*_7ParserIQNtB*_6ParserE10bump_spaceB*_*)
    *(.text*._RINvMs*_NtCs*_5regex8buildersNtB*_7Builder3newARej1_B*_EB*_*)
    *(.text*._RINvNtCs*_4core3ptr9drop_glueINtNtCs*_5alloc3vec3VecNtNtNtNtCs*_14regex_automata4util11determinize5state5StateEEB*_*)
    *(.text*._RNvMs*_NtCs*_5alloc4syncINtB*_3ArcNtNtNtCs*_5regex5regex6string5RegexE9drop_slowCs*_8clj_eval*)
    *(.text*._RNvMs*_NtNtCs*_14regex_automata6hybrid3dfaNtB*_5Cache3new*)
    *(.text*._RNvMs*_NtNtNtCs*_14regex_automata3nfa8thompson8compilerNtB*_8Compiler9configure*)
    *(.text*._RNvNtNtCs*_14regex_automata4util11determinize15epsilon_closure*)
    *(.text*._RNvMs*_NtCs*_12regex_syntax3hirNtB*_10Properties10repetition*)
    *(.text*._RNvMs*_NtCs*_12regex_syntax3astNtB*_3Ast5empty*)
    *(.text*._RNvMs*_NtCs*_5alloc4syncINtB*_3ArcNtNtNtNtCs*_14regex_automata3nfa8thompson3nfa5InnerE9drop_slowB*_*)
    *(.text*._RNvMs*_NtCs*_12regex_syntax3hirNtB*_10Properties7literal*)
    *(.text*._RINvMs*_NtCs*_9hashbrown3rawINtB*_8RawTableTReuEE14reserve_rehashNCINvNtB*_3map11make_hasherB*_uNtNtNtCs*_3std4hash6random11RandomStateE0ECs*_8clj_eval*)
    *(.text*._RINvNtCs*_4core3ptr9drop_glueNtNtNtNtCs*_14regex_automata3nfa8thompson9backtrack7BuilderEB*_*)
    *(.text*._RNvMs*_NtNtCs*_12regex_syntax3ast5parseINtB*_7ParserIQNtB*_6ParserE4bumpB*_*)
    *(.text*._RNvMs*_NtCs*_5alloc7raw_vecINtB*_6RawVecINtNtNtNtCs*_3std11collections4hash3map7HashMapINtNtB*_4sync3ArceENtNtNtCs*_14regex_automata4util10primitives10SmallIndexEE8grow_oneB*_*)
    *(.text*._RNvNtNtCs*_14regex_automata4util11determinize14add_nfa_states*)
    *(.text*._RINvNtCs*_4core3ptr9drop_glueSNtNtCs*_12regex_syntax3hir3HirECs*_14regex_automata*)
    *(.text*._RINvNtCs*_4core3ptr9drop_glueNtNtNtCs*_14regex_automata4meta8wrappers11PikeVMCacheEB*_*)
    *(.text*._RINvNtCs*_4core3ptr9drop_glueINtNtCs*_5alloc3vec3VecNtNtCs*_12regex_syntax3hir3HirEECs*_14regex_automata*)
    *(.text*._RINvNtCs*_4core3ptr9drop_glueNtNtCs*_9clj_value3seq3SeqEB*_*)
    *(.text*._RNCNvNtCs*_8clj_eval4seqs11native_juxt0B*_*)
    *(.text*._RNvNtCs*_8clj_eval4seqs11native_juxt*)
    *(.text*._RNvNtCs*_8clj_eval4core13compare_utf16*)
    *(.text*._RNvMs*_NtCs*_9clj_value3seqNtB*_10RangeValue10walked_len*)
    *(.text*._RNCINvNtCs*_8clj_eval4seqs13walk_sole_mapNCNvB*_24native_frequencies_owned0E0B*_*)
    *(.text*._RNvNtNtCs*_14regex_automata4meta8strategy3new*)
    *(.text*._RNvXs*_NtNtNtCs*_4core4iter8adapters3mapINtB*_3MapINtNtNtB*_5slice4iter4IterRNtNtCs*_12regex_syntax3hir3HirENCINvMs*_NtNtNtCs*_14regex_automata3nfa8thompson8compilerNtB*_8Compiler7compileB*_Es*_0ENtNtNtB*_6traits8iterator8Iterator4nextB*_*)
    *(.text*._RNvMs*_NtNtCs*_14regex_automata4meta5regexNtB*_7Builder5build*)
    *(.text*._RINvNtCs*_4core3ptr9drop_glueNtNtNtNtCs*_14regex_automata3nfa8thompson6pikevm6PikeVMEB*_*)
    *(.text*._RNvXs*_NtNtCs*_14regex_automata4meta8strategyNtB*_4CoreNtB*_8Strategy6search*)
    *(.text*._RNvMs*_NtCs*_12regex_syntax3hirNtB*_3Hir6concat*)
    *(.text*._RNvMs*_NtNtCs*_12regex_syntax3ast5parseINtB*_7ParserIQNtB*_6ParserE26parse_uncounted_repetitionB*_*)
    *(.text*._RINvNtCs*_4core3ptr9drop_glueINtNtCs*_5alloc3vec3VecNtNtNtNtCs*_14regex_automata3nfa8thompson3nfa5StateEEB*_*)
    *(.text*._RNvMs*_NtCs*_9clj_value3seqNtB*_10RangeValue12step_inexact*)
    *(.text*._RNvNtCs*_8clj_eval4core15native_integerp*)
    *(.text*._RNvYNtNtNtNtCs*_3std3sys5stdio4unix6StdoutNtNtNtCs*_4core2io5write5Write9write_allB*_*)
    *(.text*.rt_bc_3_nth)
    *(.text*._RNvNtCs*_8clj_eval4lazy7as_vals*)
    *(.text*._RNvNtNtCs*_4core5slice6memchr14memchr_aligned*)
    *(.text*._RNvNtCs*_8clj_eval4coll13str_utf16_len*)
    *(.text*._RNvNtCs*_8clj_eval4seqs24native_frequencies_owned*)
    *(.text*._RNvNtCs*_8clj_eval4seqs11native_keep*)
    *(.text*._RNvNtCs*_8clj_eval4core11bit_operand*)
    *(.text*._RNvNtCs*_8clj_eval4core14native_bit_xor*)
    *(.text*._RNvNtCs*_8clj_eval4core13native_bit_or*)
    *(.text*._RNvNtCs*_8clj_eval4lazy11native_next*)
    *(.text*._RNvNtCs*_8clj_eval4seqs14reduce_kv_step*)
    *(.text*.rt_n_core_ref)
    *(.text*._RNvNtCs*_8clj_eval4core15native_bit_test*)
    *(.text*._RNvNtCs*_8clj_eval4seqs16native_reduce_kv*)
    *(.text*._RNvXs*_NtCs*_8clj_eval6vm_opsNtB*_6BitXorNtB*_3Op25apply*)
    *(.text*._RNvNtCs*_8clj_eval4seqs22native_reduce_kv_owned*)
    *(.text*.rt_n_enter_fn)
    *(.text*._RNvNtCs*_8clj_eval4coll6merge2*)
    *(.text*._RNvNtCs*_8clj_eval4coll12native_merge*)
    *(.text*._RNvNtCs*_8clj_eval8classemu21static_call_character*)
    *(.text*._RNvMs*_NtNtCs*_12regex_syntax3ast5parseINtB*_11NestLimiterQNtB*_6ParserE15increment_depthB*_*)
    *(.text*._RNvNtCs*_8clj_eval8classemu14class_position*)
    *(.text*._RNvMs*_NtNtCs*_5regex5regex6stringNtB*_5Regex3new*)
    *(.text*._RNvMs*_NtNtCs*_14regex_automata6hybrid3dfaNtB*_4Lazy16cache_next_state*)
    *(.text*._RINvNtCs*_4core3ptr9drop_glueNtNtCs*_12regex_syntax3ast3AstECs*_14regex_automata*)
    *(.text*._RNvNtCs*_9clj_value3jvm12jvm_class_of*)
    *(.text*._RNvNtCs*_9clj_value3jvm17jvm_class_of_host*)
    *(.text*._RNvNtCs*_8clj_eval4coll18native_dissoc_bang*)
    *(.text*._RNvNtCs*_9clj_value5value12map_value_eq*)
    *(.text*._RNvNtCs*_8clj_eval4lazy10keys_first*)
    *(.text*._RNvNtCs*_8clj_eval4lazy9keys_rest*)
    *(.text*._RNvNtCs*_8clj_eval4coll13native_update*)
    *(.text*._RNvNtCs*_9clj_value5value12set_value_eq*)
    *(.text*._RNvNtCs*_9clj_value5value10entry_hash*)
    *(.text*._RINvXs*_NtCs*_9clj_value5valueNtB*_5ValueNtNtCs*_4core4hash4Hash4hashNtNtNtCs*_3std4hash6random13DefaultHasherEB*_*)
    *(.text*._RNvNtCs*_8clj_eval4lazy12iterate_seed*)
    *(.text*._RNvNtCs*_8clj_eval4lazy18step_iterate_value*)
    *(.text*._RNvNtCs*_8clj_eval4seqs14native_iterate*)
    *(.text*._RNvNtCs*_8clj_eval8classemu13equals_member*)
    *(.text*._RNvXs*_NtCs*_8clj_eval6vm_opsNtB*_3LteNtB*_3Op25apply*)
    *(.text*._RNvXs*_NtNtCs*_4rpds3map13hash_trie_mapINtB*_7IterPtrNtNtCs*_9clj_value5value5ValueB*_NtNtNtNtCs*_7archery14shared_pointer4kind4arct5ArcTKENtNtNtNtCs*_4core4iter6traits8iterator8Iterator4nextB*_*)
    *(.text*._RINvNtCs*_4core3ptr9drop_glueINtNtB*_4cell10UnsafeCellNtNtCs*_9clj_value4atom9AtomStateEEB*_*)
    *(.text*._RNvNtCs*_8clj_eval8classemu19static_call_integer*)
    *(.text*.rt_bc_2_nth)
    *(.text*._RINvNtCs*_6clj_bc3ops9apply2_eqINtNtNtCs*_4core3mem12maybe_uninit11MaybeUninitNtNtCs*_9clj_value5value5ValueEEB*_*)
    *(.text*._RNvNtCs*_8clj_eval6arrays20native_boolean_array*)
    *(.text*._RINvNtCs*_8clj_eval6arrays8zero_vecbEB*_*)
    *(.text*._RNvNtCs*_8clj_eval6arrays12check_bounds*)
    *(.text*._RNvNtCs*_8clj_eval6arrays11native_aset*)
    *(.text*._RNvNtCs*_8clj_eval6arrays10array_read*)
    *(.text*._RNvNtCs*_8clj_eval6arrays11native_aget*)
    *(.text*._RNvNtCs*_8clj_eval6arrays10ctor_array*)
    *(.text*.rt_n_clone)
    *(.text*._RNvNtCs*_8clj_eval6arrays14native_alength*)
    *(.text*._RNvNtCs*_8clj_eval6arrays8ctor_seq*)
    *(.text*._RNvNtCs*_8clj_eval6arrays15num_long_narrow*)
    *(.text*._RNvNtCs*_8clj_eval6arrays10fill_store*)
    *(.text*._RINvNtCs*_8clj_eval6arrays8zero_vecxEB*_*)
    *(.text*._RNvNtCs*_8clj_eval6arrays10zero_store*)
    *(.text*._RNvNtCs*_8clj_eval6arrays17native_long_array*)
    *(.text*._RNvXs*_NtCs*_8clj_eval6vm_opsNtB*_7IntCastNtB*_3Op15apply*)
    *(.text*.rt_n_math_ceil)
    *(.text*._RNvNtCs*_8clj_eval4coll16native_conj_bang*)
    *(.text*._RNvNtCs*_8clj_eval4core11native_quot*)
    *(.text*._RNvXs*_NtNtCs*_10num_bigint6bigint14multiplicationRNtB*_6BigIntNtNtNtCs*_4core3ops5arith3Mul3mul*)
    *(.text*._RNvXs*_NtCs*_8clj_eval6vm_opsNtB*_4QuotNtB*_3Op25apply*)
    *(.text*._RNvNtCs*_8clj_eval4seqs17native_take_while*)
    *(.text*._RNvNtCs*_8clj_eval11concurrency13native_vreset*)
    *(.text*._RNvNtCs*_8clj_eval4coll11subseq_walk*)
    *(.text*._RNvNtCs*_8clj_eval4coll16bound_take_while*)
    *(.text*._RNvNtCs*_8clj_eval4coll13native_subseq*)
    *(.text*._RNvNtCs*_8clj_eval4core14native_vectorp*)
    *(.text*._RNvNtCs*_8clj_eval4coll9seq_items*)
    *(.text*._RNvNtCs*_8clj_eval4core9native_lt*)
    *(.text*._RNvNtCs*_8clj_eval4coll13bound_include*)
    *(.text*._RNvNtCs*_8clj_eval4coll20sorted_subseq_source*)
    *(.text*._RNvNtCs*_8clj_eval11concurrency15native_volatile*)
    *(.text*._RNvMs*_NtCs*_9clj_value5valueNtB*_3Map12ordered_keys*)
    *(.text*._RNvNtCs*_8clj_eval4coll20native_sorted_set_by*)
    *(.text*._RNvNtCs*_8clj_eval4coll17native_last_owned*)
    *(.text*._RNvNtCs*_8clj_eval4coll11native_into*)
    *(.text*._RNvNtCs*_8clj_eval4coll12contains_map*)
    *(.text*._RNvMs*_NtCs*_9clj_value3seqNtB*_10RangeValue4done*)
    *(.text*._RNvMs*_NtCs*_9clj_value3seqNtB*_10RangeValue7advance*)
    *(.text*._RNvMs*_NtCs*_9clj_value3seqNtB*_8RangeNum5value*)
    *(.text*._RNCINvXs*_NtNtNtCs*_7archery14shared_pointer4kind4arctNtB*_5ArcTKNtB*_17SharedPointerKind8make_mutINtNtNtCs*_4rpds3map13hash_trie_map4NodeNtNtCs*_9clj_value5value5ValueB*_B*_EE0B*_*)
    *(.text*._RINvXs*_NtNtNtCs*_4core4iter8adapters4takeINtB*_4TakeINtNtB*_4skip4SkipNtNtCs*_9clj_value5value10VectorIterEENtB*_8SpecTake9spec_foldINtNtB*_6option6OptionNtB*_5ValueEINvNvNtNtNtB*_6traits8iterator8Iterator4last4someB*_EECs*_8clj_eval*)
    *(.text*._RNvNtCs*_8clj_eval4core9add_prime*)
    *(.text*._RNvNtCs*_8clj_eval4core16native_add_prime*)
    *(.text*._RNvNtCs*_8clj_eval4lazy15step_reductions*)
    *(.text*._RNvNtCs*_8clj_eval4lazy16reductions_thunk*)
    *(.text*._RNvNtCs*_8clj_eval4seqs17native_reductions*)
    *(.text*._RNvNtCs*_8clj_eval4core10is_counted*)
    *(.text*.rt_n_equiv)
    *(.text*._RNvNtCs*_5cljrt6native7ints_at*)
    *(.text*.rt_n_case)
    *(.text*._RNvNtCs*_9clj_value6hasheq9hash_code*)
    *(.text*._RNvNtCs*_9clj_value6hasheq12str_hashcode*)
    *(.text*._RNCINvNtCs*_8clj_eval4seqs13walk_sole_mapNCNvB*_20native_every_p_owned0E0B*_*)
    *(.text*._RNvNtCs*_8clj_eval4core11native_name*)
    *(.text*._RNvNtCs*_8clj_eval4core12native_truep*)
    *(.text*._RNvNtCs*_8clj_eval4core13native_not_eq*)
    *(.text*._RINvMs*_NtNtNtNtCs*_3std3sys12thread_local6native4lazyINtB*_7StorageINtNtCs*_5alloc2rc2RcINtNtCs*_4core4cell10UnsafeCellINtNtNtCs*_4rand4rngs9reseeding12ReseedingRngNtNtCs*_11rand_chacha6chacha12ChaCha12CoreNtNtCs*_9rand_core2os5OsRngEEEuE16get_or_init_slowNvNvNtB*_6thread14THREAD_RNG_KEY27___rust_std_internal_init_fnEB*_*)
    *(.text*._RNvMs*_NtCs*_5alloc2rcINtB*_2RcINtNtCs*_4core4cell10UnsafeCellINtNtNtCs*_4rand4rngs9reseeding12ReseedingRngNtNtCs*_11rand_chacha6chacha12ChaCha12CoreNtNtCs*_9rand_core2os5OsRngEEE9drop_slowB*_*)
    *(.text*._RNvNtNtCs*_4rand4rngs6thread3rng*)
    *(.text*._RINvYNtNtNtCs*_4rand4rngs6thread9ThreadRngNtNtB*_3rng3Rng12random_rangedINtNtNtCs*_4core3ops5range5RangedEECs*_8clj_eval*)
    *(.text*._RNvNtCs*_8clj_eval3rng9bound_f64*)
    *(.text*._RINvNtNtNtNtCs*_3std3sys12thread_local6native4lazy7destroyINtNtCs*_5alloc2rc2RcINtNtCs*_4core4cell10UnsafeCellINtNtNtCs*_4rand4rngs9reseeding12ReseedingRngNtNtCs*_11rand_chacha6chacha12ChaCha12CoreNtNtCs*_9rand_core2os5OsRngEEEEB*_*)
    *(.text*._RNvNtCs*_8clj_eval3rng15native_rand_int*)
    *(.text*._RINvNtCs*_9clj_value4trie8new_pathxEB*_*)
    *(.text*._RNvMs*_NtCs*_9clj_value4trieINtB*_4PVecxE13push_back_mutB*_*)
    *(.text*._RINvXs*_NtCs*_9clj_value4trieINtB*_4PVecxEINtNtNtNtCs*_4core4iter6traits7collect12FromIteratorxE9from_iterINtNtNtB*_8adapters6cloned6ClonedINtNtNtB*_5slice4iter4IterxEEEB*_*)
    *(.text*._RNvMs*_NtCs*_5alloc4syncINtB*_3ArcINtNtCs*_9clj_value4trie4NodexEE8make_mutB*_*)
    *(.text*._RINvNtCs*_4core3ptr9drop_glueNtNtCs*_9clj_value9extension9ThrowableEB*_*)
    *(.text*._RNvMs*_NtCs*_8clj_eval5errorNtB*_11NativeError3new*)
    *(.text*._RNvXs*_NtCs*_9clj_value9extensionNtB*_9ThrowableNtNtCs*_4core5clone5Clone5clone.2328*)
    *(.text*._RINvNtNtNtNtCs*_3std3sys12thread_local6native5eager7destroyINtNtCs*_4core4cell7RefCellINtNtB*_6option6OptionNtNtCs*_8clj_eval5error6SignalEEECs*_5cljrt*)
    *(.text*._RNvNtCs*_9clj_value5print18java_double_string*)
    *(.text*._RNvNtCs*_9clj_value5print18java_finite_digits*)
    *(.text*._RNvNtCs*_9clj_value5print9ryu_parts*)
    *(.text*._RNvNtNtCs*_3ryu6pretty8mantissa19write_mantissa_long*)
    *(.text*._RNCINvNtCs*_8clj_eval4seqs11walk_directNCNvB*_22native_not_any_p_owned0E0B*_*)
    *(.text*._RNvNtCs*_8clj_eval4seqs22native_not_any_p_owned*)
    *(.text*._RNvNtCs*_8clj_eval4coll14assoc_bang_one*)
    *(.text*._RNvNtCs*_8clj_eval4core11native_intp*)
    *(.text*._RNvNtCs*_8clj_eval4lazy11as_splitvec*)
    *(.text*._RNvXs*_NtCs*_8clj_eval6vm_opsNtB*_4Nth3NtB*_3Op35apply*)
    *(.text*._RNvNtCs*_8clj_eval4seqs17native_repeatedly*)
    *(.text*._RNvNtCs*_8clj_eval4coll10native_key*)
    *(.text*._RNvNtCs*_8clj_eval4coll9entry_key*)
    *(.text*._RNvMs*_NtCs*_9clj_value5valueNtB*_3Map4size*)
    *(.text*._RNCINvNtCs*_8clj_eval4seqs13walk_sole_mapNCNvB*_17native_mapv_owneds*_0E0B*_*)
    *(.text*._RNvNtCs*_8clj_eval4core13native_double*)
    *(.text*.rt_n_first)
    *(.text*.rt_n_gseq)
    *(.text*.rt_n_next_mut)
    *(.text*._RINvNtNtNtCs*_4core5slice4sort6stable14driftsort_mainjNCINvMNtCs*_5alloc5sliceSj7sort_byNCNvNtCs*_8clj_eval4seqs15sort_int_tupless*_0E0INtNtB*_3vec3VecjEEB*_*)
    *(.text*._RINvNtNtNtNtCs*_4core5slice4sort6shared9smallsort12sort4_stablejNCINvMNtCs*_5alloc5sliceSj7sort_byNCNvNtCs*_8clj_eval4seqs15sort_int_tupless*_0E0EB*_*)
    *(.text*._RINvNtNtNtNtCs*_4core5slice4sort6stable5drift4sortjNCINvMNtCs*_5alloc5sliceSj7sort_byNCNvNtCs*_8clj_eval4seqs15sort_int_tupless*_0E0EB*_*)
    *(.text*._RINvNtNtNtNtCs*_4core5slice4sort6shared5pivot11median3_recjNCINvMNtCs*_5alloc5sliceSj7sort_byNCNvNtCs*_8clj_eval4seqs15sort_int_tupless*_0E0EB*_*)
    *(.text*._RINvNtNtNtNtCs*_4core5slice4sort6shared9smallsort19bidirectional_mergejNCINvMNtCs*_5alloc5sliceSj7sort_byNCNvNtCs*_8clj_eval4seqs15sort_int_tupless*_0E0EB*_*)
    *(.text*._RINvNtNtNtNtCs*_4core5slice4sort6stable9quicksort9quicksortjNCINvMNtCs*_5alloc5sliceSj7sort_byNCNvNtCs*_8clj_eval4seqs15sort_int_tupless*_0E0EB*_*)
    *(.text*._RNvNtCs*_8clj_eval4core14native_reduced*)
    *(.text*._RNvXNtCs*_4core3anyNtNtCs*_8clj_eval4core7ReducedNtB*_3Any7type_idB*_*)
    *(.text*._RNvXs*_NtCs*_8clj_eval4coreNtB*_7ReducedNtNtCs*_9clj_value9extension14ExtensionValue6as_any*)
    *(.text*._RNvNtCs*_8clj_eval4core10native_dec*)
    *(.text*._RNvNtCs*_8clj_eval4core7dec_one*)
    *(.text*._RNvNtCs*_8clj_eval4core10native_neg*)
    *(.text*._RNvNtCs*_8clj_eval4core11native_zero*)
    *(.text*._RINvMs*_NtCs*_9hashbrown3rawINtB*_8RawTableTNtNtCs*_9clj_value5value5ValueB*_EE14reserve_rehashNCINvNtB*_3map11make_hasherB*_B*_INtNtCs*_4core4hash18BuildHasherDefaultNtCs*_10rustc_hash8FxHasherEE0EB*_*)
    *(.text*._RNvMs*_NtCs*_9hashbrown3mapINtB*_7HashMapNtNtCs*_9clj_value5value5ValueB*_INtNtCs*_4core4hash18BuildHasherDefaultNtCs*_10rustc_hash8FxHasherEE6insertB*_*)
    *(.text*._RNvNtCs*_8clj_eval4coll13transient_get*)
    *(.text*._RNvXs*_NtCs*_5alloc3vecINtB*_3VecNtNtCs*_9clj_value5value5ValueENtNtCs*_4core5clone5Clone5cloneCs*_8clj_eval*)
    *(.text*.rt_n_math_hypot)
    *(.text*._RNvNtCs*_8clj_eval4seqs16cmp_str_int_pair*)
    *(.text*._RNvNtCs*_8clj_eval8classemu16identical_values*)
    *(.text*._RNvNtCs*_8clj_eval8classemu16native_identical*)
    *(.text*._RINvNtCs*_4core3ptr9drop_glueNtNtCs*_9clj_value3seq13SplitVecValueEB*_*)
    *(.text*._RNvXs*_NtCs*_9clj_value3seqNtB*_13SplitVecValueNtNtCs*_4core5clone5Clone5clone*)
  }
}
INSERT BEFORE .text;
